[part 3 of 3: package /ActiveEcuC]
AUTOSAR XML (schema 3.0.2)
package /ActiveEcuC  (continued)
  module config Rte: implementation-config-variant=VARIANT-PRE-COMPILE, module-description=Rte_Impl  # Configuration of the Rte (Runtime Environment) module.
    RteGeneration: RteMeasurementSupport=true, RteXcpEventSupport=false, RteA2LVersion=V151, RteCalibrationSupport=NONE, RteOptimizationMode=MEMORY, RteVfbTrace=0
    96 x SwComponentInstance:
      AbsHwPos_Ap_AbsHwPos_ECU_Composition: SoftwareComponentInstanceRef=AbsHwPos, ImplementationRef=Ap_AbsHwPos_Implementation
        5 x RunnableEntityMapping, all with ActivationOffset=0, RteCyclicTriggerImplementation=Auto:
          Task_Init_10_21_Timer0: PositionInTask=21, RTEEventRef=AbsHwPos_Init1_InitEvent, MappedToTaskRef=Task_Init_10
          Task_10ms_10_3_Timer0: PositionInTask=3, RTEEventRef=TMT_AbsHwPos_Per4, MappedToTaskRef=Task_10ms_10
          Task_2ms_10_51_Timer0: PositionInTask=51, RTEEventRef=TMT_AbsHwPos_Per2, MappedToTaskRef=Task_2ms_10
          Task_2ms_10_49_Timer0: PositionInTask=49, RTEEventRef=TMT_AbsHwPos_Per1, MappedToTaskRef=Task_2ms_10
          Task_4ms_10_3_Timer0: PositionInTask=3, RTEEventRef=TMT_AbsHwPos_Per3, MappedToTaskRef=Task_4ms_10
        MAP_Rte_NvmBlock_AbsHwPos_EOLVehCntrOffset (NVRamAllocation): SwNvRamMappingReference=AbsHwPos.EOLVehCntrOffsetBlock, NvmBlockRef=Rte_NvmBlock_AbsHwPos_EOLVehCntrOffset
      ActivePull_Ap_ActivePull_ECU_Composition: SoftwareComponentInstanceRef=ActivePull, ImplementationRef=Ap_ActivePull_Implementation
        5 x RunnableEntityMapping, all with ActivationOffset=0, RteCyclicTriggerImplementation=Auto:
          Task_Init_9_7_Timer0: PositionInTask=7, RTEEventRef=ActivePull_Init1_InitEvent, MappedToTaskRef=Task_Init_9
          Task_2ms_9_2_Timer0: PositionInTask=2, RTEEventRef=TMT_ActivePull_Per1, MappedToTaskRef=Task_2ms_9
          Task_Trns_9_4_TrigModeSwitch0: PositionInTask=4, RTEEventRef=MST_ActivePull_Trns1_0, MappedToTaskRef=Task_Trns_9
          Task_100ms_9_3_Timer0: PositionInTask=3, RTEEventRef=TMT_ActivePull_Per3, MappedToTaskRef=Task_100ms_9
          Task_2ms_9_3_Timer0: PositionInTask=3, RTEEventRef=TMT_ActivePull_Per2, MappedToTaskRef=Task_2ms_9
      ApXcp_Ap_ApXcp_ECU_Composition: SoftwareComponentInstanceRef=ApXcp, ImplementationRef=Ap_ApXcp_Implementation
        Task_2ms_9_12_Timer0 (RunnableEntityMapping): PositionInTask=12, ActivationOffset=0, RteCyclicTriggerImplementation=Auto, RTEEventRef=TMT_DAQ_2msTL, MappedToTaskRef=Task_2ms_9
        Task_10ms_9_5_Timer0 (RunnableEntityMapping): PositionInTask=5, ActivationOffset=0, RteCyclicTriggerImplementation=Auto, RTEEventRef=TMT_ApXcp_Per1, MappedToTaskRef=Task_10ms_9
      Assist_Ap_Assist_ECU_Composition: SoftwareComponentInstanceRef=Assist, ImplementationRef=Ap_Assist_Implementation
        Task_2ms_10_13_Timer0 (RunnableEntityMapping): PositionInTask=13, ActivationOffset=0, RteCyclicTriggerImplementation=Auto, RTEEventRef=TMT_Assist_Per1, MappedToTaskRef=Task_2ms_10
      AssistFirewall_Ap_AssistFirewall_ECU_Composition: SoftwareComponentInstanceRef=AssistFirewall, ImplementationRef=Ap_AssistFirewall_Implementation
        Task_Init_10_25_Timer0 (RunnableEntityMapping): PositionInTask=25, ActivationOffset=0, RteCyclicTriggerImplementation=Auto, RTEEventRef=AssistFirewall_Init1_InitEvent, MappedToTaskRef=Task_Init_10
        Task_2ms_10_17_Timer0 (RunnableEntityMapping): PositionInTask=17, ActivationOffset=0, RteCyclicTriggerImplementation=Auto, RTEEventRef=TMT_AssistFirewall_Per1, MappedToTaskRef=Task_2ms_10
      AstLmt_Ap_AstLmt_ECU_Composition: SoftwareComponentInstanceRef=AstLmt, ImplementationRef=Ap_AstLmt_Implementation
        Task_2ms_10_22_Timer0 (RunnableEntityMapping): PositionInTask=22, ActivationOffset=0, RteCyclicTriggerImplementation=Auto, RTEEventRef=TMT_AstLmt_Per1, MappedToTaskRef=Task_2ms_10
        Task_Init_10_27_Timer0 (RunnableEntityMapping): PositionInTask=27, ActivationOffset=0, RteCyclicTriggerImplementation=Auto, RTEEventRef=AstLmt_InitEvent, MappedToTaskRef=Task_Init_10
        MAP_Rte_NvmBlock_AstLmt_SteerAsstDefeat (NVRamAllocation): SwNvRamMappingReference=AstLmt.SteeringAsstDefeat, NvmBlockRef=Rte_NvmBlock_AstLmt_SteerAsstDefeat
      AvgFricLrn_Ap_AvgFricLrn_ECU_Composition: SoftwareComponentInstanceRef=AvgFricLrn, ImplementationRef=Ap_AvgFricLrn_Implementation
        3 x RunnableEntityMapping, all with ActivationOffset=0, RteCyclicTriggerImplementation=Auto:
          Task_Init_9_6_Timer0: PositionInTask=6, RTEEventRef=AvgFricLrn_Init1_InitEvent, MappedToTaskRef=Task_Init_9
          Task_Trns_9_5_TrigModeSwitch0: PositionInTask=5, RTEEventRef=MST_AvgFricLrn_Trns1_0, MappedToTaskRef=Task_Trns_9
          Task_10ms_9_3_Timer0: PositionInTask=3, RTEEventRef=TMT_AvgFricLrn_Per1, MappedToTaskRef=Task_10ms_9
        MAP_Rte_NvmBlock_AvgFricLrn_AvgFricLrnData (NVRamAllocation): SwNvRamMappingReference=AvgFricLrn.AvgFricLrnBlk, NvmBlockRef=Rte_NvmBlock_AvgFricLrn_AvgFricLrnData
      BVDiag_Ap_BVDiag_ECU_Composition: SoftwareComponentInstanceRef=BVDiag, ImplementationRef=Ap_BVDiag_Implementation
        Task_10ms_9_6_Timer0 (RunnableEntityMapping): PositionInTask=6, ActivationOffset=0, RteCyclicTriggerImplementation=Auto, RTEEventRef=TMT_BVDiag_Per1, MappedToTaskRef=Task_10ms_9
      BatteryVoltage_Ap_BatteryVoltage_ECU_Composition: SoftwareComponentInstanceRef=BatteryVoltage, ImplementationRef=Ap_BatteryVoltage_Implementation
        3 x RunnableEntityMapping, all with ActivationOffset=0, RteCyclicTriggerImplementation=Auto:
          Task_Init_9_9_Timer0: PositionInTask=9, RTEEventRef=BatteryVoltage_Init1_InitEvent, MappedToTaskRef=Task_Init_9
          Task_4ms_9_1_Timer0: PositionInTask=1, RTEEventRef=TMT_BatteryVoltage_Per2, MappedToTaskRef=Task_4ms_9
          Task_2ms_9_1_Timer0: PositionInTask=1, RTEEventRef=TMT_BatteryVoltage_Per1, MappedToTaskRef=Task_2ms_9
        MAP_Rte_NvmBlock_BatteryVoltage_OvervoltageData (NVRamAllocation): SwNvRamMappingReference=BatteryVoltage.OvervoltageBlock, NvmBlockRef=Rte_NvmBlock_BatteryVoltage_OvervoltageData
      BkCpPc_Sa_BkCpPc_ECU_Composition: SoftwareComponentInstanceRef=BkCpPc, ImplementationRef=Sa_BkCpPc_Implementation
        3 x RunnableEntityMapping, all with ActivationOffset=0, RteCyclicTriggerImplementation=Auto:
          Task_2ms_9_8_Timer0: PositionInTask=8, RTEEventRef=TMT_BkCpPc_Per1, MappedToTaskRef=Task_2ms_9
          Task_Trns_9_3_TrigModeSwitch0: PositionInTask=3, RTEEventRef=MST_BkCpPc_Trns1_0, MappedToTaskRef=Task_Trns_9
          Task_Trns_9_2_TrigModeSwitch0: PositionInTask=2, RTEEventRef=MST_BkCpPc_Trns2_0, MappedToTaskRef=Task_Trns_9
      CDD_CDD_ECU_Composition: ServiceComponentPrototypeRef=CDD, ImplementationRef=CDD_Implementation
        Task_SchM_2ms_9_3_Timer0 (RunnableEntityMapping): PositionInTask=3, ActivationOffset=0, RteCyclicTriggerImplementation=Auto, RTEEventRef=TMT_Cdd_DummyFunction, MappedToTaskRef=Task_SchM_2ms_9
      CDDInterface_Sa_CDDInterface_ECU_Composition: SoftwareComponentInstanceRef=CDDInterface, ImplementationRef=Sa_CDDInterface_Implementation
        5 x RunnableEntityMapping, all with ActivationOffset=0, RteCyclicTriggerImplementation=Auto:
          Task_2ms_10_3_Timer0: PositionInTask=3, RTEEventRef=TMT_CDDInterface_Per1, MappedToTaskRef=Task_2ms_10
          Task_10ms_10_2_Timer0: PositionInTask=2, RTEEventRef=TMT_CDDInterface_Per4, MappedToTaskRef=Task_10ms_10
          Task_Init_10_30_Timer0: PositionInTask=30, RTEEventRef=CDDInterface_Init2_InitEvent, MappedToTaskRef=Task_Init_10
          Task_Init_10_0_Timer0: PositionInTask=0, RTEEventRef=CDDInterface_Init1_InitEvent, MappedToTaskRef=Task_Init_10
          Task_2ms_10_31_Timer0: PositionInTask=31, RTEEventRef=TMT_CDDInterface_Per2, MappedToTaskRef=Task_2ms_10
      ChkPtAp10_Ap_ChkPtAp10_ECU_Composition: SoftwareComponentInstanceRef=ChkPtAp10, ImplementationRef=Ap_ChkPtAp10_Implementation
        8 x RunnableEntityMapping, all with ActivationOffset=0, RteCyclicTriggerImplementation=Auto:
          Task_2ms_10_0_Timer0: PositionInTask=0, RTEEventRef=TMT_ChkPtAp10_2msStart_Per, MappedToTaskRef=Task_2ms_10
          Task_10ms_10_0_Timer0: PositionInTask=0, RTEEventRef=TMT_ChkPtAp10_10msStart_Per, MappedToTaskRef=Task_10ms_10
          Task_4ms_10_4_Timer0: PositionInTask=4, RTEEventRef=TMT_ChkPtAp10_4msEnd_Per, MappedToTaskRef=Task_4ms_10
          Task_10ms_10_10_Timer0: PositionInTask=10, RTEEventRef=TMT_ChkPtAp10_10msEnd_Per, MappedToTaskRef=Task_10ms_10
          Task_100ms_10_0_Timer0: PositionInTask=0, RTEEventRef=TMT_ChkPtAp10_100msStart_Per, MappedToTaskRef=Task_100ms_10
          Task_4ms_10_0_Timer0: PositionInTask=0, RTEEventRef=TMT_ChkPtAp10_4msStart_Per, MappedToTaskRef=Task_4ms_10
          Task_100ms_10_9_Timer0: PositionInTask=9, RTEEventRef=TMT_ChkPtAp10_100msEnd_Per, MappedToTaskRef=Task_100ms_10
          Task_2ms_10_60_Timer0: PositionInTask=60, RTEEventRef=TMT_ChkPtAp10_2msEnd_Per, MappedToTaskRef=Task_2ms_10
      ChkPtAp8_Ap_ChkPtAp8_ECU_Composition: SoftwareComponentInstanceRef=ChkPtAp8, ImplementationRef=Ap_ChkPtAp8_Implementation
        4 x RunnableEntityMapping, all with ActivationOffset=0, RteCyclicTriggerImplementation=Auto:
          Task_2ms_8_0_Timer0: PositionInTask=0, RTEEventRef=TMT_ChkPtAp8_2msStart_Per, MappedToTaskRef=Task_2ms_8
          Task_100ms_8_2_Timer0: PositionInTask=2, RTEEventRef=TMT_ChkPtAp8_100msEnd_Per, MappedToTaskRef=Task_100ms_8
          Task_2ms_8_5_Timer0: PositionInTask=5, RTEEventRef=TMT_ChkPtAp8_2msEnd_Per, MappedToTaskRef=Task_2ms_8
          Task_100ms_8_0_Timer0: PositionInTask=0, RTEEventRef=TMT_ChkPtAp8_100msStart_Per, MappedToTaskRef=Task_100ms_8
      ChkPtAp9_Ap_ChkPtAp9_ECU_Composition: SoftwareComponentInstanceRef=ChkPtAp9, ImplementationRef=Ap_ChkPtAp9_Implementation
        8 x RunnableEntityMapping, all with ActivationOffset=0, RteCyclicTriggerImplementation=Auto:
          Task_2ms_9_11_Timer0: PositionInTask=11, RTEEventRef=TMT_ChkPtAp9_2msEnd_Per, MappedToTaskRef=Task_2ms_9
          Task_2ms_9_0_Timer0: PositionInTask=0, RTEEventRef=TMT_ChkPtAp9_2msStart_Per, MappedToTaskRef=Task_2ms_9
          Task_10ms_9_8_Timer0: PositionInTask=8, RTEEventRef=TMT_ChkPtAp9_10msEnd_Per, MappedToTaskRef=Task_10ms_9
          Task_100ms_9_7_Timer0: PositionInTask=7, RTEEventRef=TMT_ChkPtAp9_100msEnd_Per, MappedToTaskRef=Task_100ms_9
          Task_4ms_9_0_Timer0: PositionInTask=0, RTEEventRef=TMT_ChkPtAp9_4msStart_Per, MappedToTaskRef=Task_4ms_9
          Task_100ms_9_0_Timer0: PositionInTask=0, RTEEventRef=TMT_ChkPtAp9_100msStart_Per, MappedToTaskRef=Task_100ms_9
          Task_4ms_9_2_Timer0: PositionInTask=2, RTEEventRef=TMT_ChkPtAp9_4msEnd_Per, MappedToTaskRef=Task_4ms_9
          Task_10ms_9_0_Timer0: PositionInTask=0, RTEEventRef=TMT_ChkPtAp9_10msStart_Per, MappedToTaskRef=Task_10ms_9
      CmMtrCurr_Sa_CmMtrCurr_ECU_Composition: SoftwareComponentInstanceRef=CmMtrCurr, ImplementationRef=Sa_CmMtrCurr_Implementation
        4 x RunnableEntityMapping, all with ActivationOffset=0, RteCyclicTriggerImplementation=Auto:
          Task_2ms_10_28_Timer0: PositionInTask=28, RTEEventRef=TMT_CmMtrCurr_Per3, MappedToTaskRef=Task_2ms_10
          Task_Init_10_8_Timer0: PositionInTask=8, RTEEventRef=CmMtrCurr_InitEvent, MappedToTaskRef=Task_Init_10
          Task_2ms_10_27_Timer0: PositionInTask=27, RTEEventRef=TMT_CmMtrCurr_Per2, MappedToTaskRef=Task_2ms_10
          Task_100ms_10_4_Timer0: PositionInTask=4, RTEEventRef=TMT_CmMtrCurr_Per1, MappedToTaskRef=Task_100ms_10
        MAP_Rte_NvmBlock_CmMtrCurr_CurrTempOffset (NVRamAllocation): SwNvRamMappingReference=CmMtrCurr.CurrTempOffsetBlk, NvmBlockRef=Rte_NvmBlock_CmMtrCurr_CurrTempOffset
        MAP_Rte_NvmBlock_CmMtrCurr_ShCurrCal (NVRamAllocation): SwNvRamMappingReference=CmMtrCurr.ShCurrCalBlk, NvmBlockRef=Rte_NvmBlock_CmMtrCurr_ShCurrCal
      ComM_ComM_ECU_Composition: ServiceComponentPrototypeRef=ComM, ImplementationRef=ComM_Implementation
        Task_SchM_2ms_9_5_Timer0 (RunnableEntityMapping): PositionInTask=5, ActivationOffset=0, RteCyclicTriggerImplementation=Auto, RTEEventRef=TMT_ComM_MainFunction_0, MappedToTaskRef=Task_SchM_2ms_9
      ComplErr_Ap_ComplErr_ECU_Composition: SoftwareComponentInstanceRef=ComplErr, ImplementationRef=Ap_ComplErr_Implementation
        Task_2ms_10_48_Timer0 (RunnableEntityMapping): PositionInTask=48, ActivationOffset=0, RteCyclicTriggerImplementation=Auto, RTEEventRef=TMT_ComplErr_Per1, MappedToTaskRef=Task_2ms_10
      CtrlTemp_Sa_CtrlTemp_ECU_Composition: SoftwareComponentInstanceRef=CtrlTemp, ImplementationRef=Sa_CtrlTemp_Implementation
        3 x RunnableEntityMapping, all with ActivationOffset=0, RteCyclicTriggerImplementation=Auto:
          Task_Init_9_2_Timer0: PositionInTask=2, RTEEventRef=CtrlTemp_Init1_InitEvent, MappedToTaskRef=Task_Init_9
          Task_100ms_9_1_Timer0: PositionInTask=1, RTEEventRef=TMT_CtrlTemp_Per2, MappedToTaskRef=Task_100ms_9
          Task_2ms_9_5_Timer0: PositionInTask=5, RTEEventRef=TMT_CtrlTemp_Per1, MappedToTaskRef=Task_2ms_9
      CtrldDisShtdn_Ap_CtrldDisShtdn_ECU_Composition: SoftwareComponentInstanceRef=CtrldDisShtdn, ImplementationRef=Ap_CtrldDisShtdn_Implementation
        Task_2ms_10_24_Timer0 (RunnableEntityMapping): PositionInTask=24, ActivationOffset=0, RteCyclicTriggerImplementation=Auto, RTEEventRef=TMT_CtrldDisShtdn_Per1, MappedToTaskRef=Task_2ms_10
      CurrCmd_Ap_CurrCmd_ECU_Composition: SoftwareComponentInstanceRef=CurrCmd, ImplementationRef=Ap_CurrCmd_Implementation
        Task_2ms_10_30_Timer0 (RunnableEntityMapping): PositionInTask=30, ActivationOffset=0, RteCyclicTriggerImplementation=Auto, RTEEventRef=TMT_CurrCmd_Per1, MappedToTaskRef=Task_2ms_10
        Task_Init_10_9_Timer0 (RunnableEntityMapping): PositionInTask=9, ActivationOffset=0, RteCyclicTriggerImplementation=Auto, RTEEventRef=CurrCmd_InitEvent, MappedToTaskRef=Task_Init_10
      CurrParamComp_Ap_CurrParamComp_ECU_Composition: SoftwareComponentInstanceRef=CurrParamComp, ImplementationRef=Ap_CurrParamComp_Implementation
        3 x RunnableEntityMapping, all with ActivationOffset=0, RteCyclicTriggerImplementation=Auto:
          Task_100ms_10_2_Timer0: PositionInTask=2, RTEEventRef=TMT_CurrParamComp_Per2, MappedToTaskRef=Task_100ms_10
          Task_2ms_10_42_Timer0: PositionInTask=42, RTEEventRef=TMT_CurrParamComp_Per1, MappedToTaskRef=Task_2ms_10
          Task_Init_10_10_Timer0: PositionInTask=10, RTEEventRef=CurrParamComp_InitEvent, MappedToTaskRef=Task_Init_10
        MAP_Rte_NvmBlock_CurrParamComp_EOLNomMtrParam (NVRamAllocation): SwNvRamMappingReference=CurrParamComp.EOLNomMtrParamBlk, NvmBlockRef=Rte_NvmBlock_CurrParamComp_EOLNomMtrParam
      Damping_Ap_Damping_ECU_Composition: SoftwareComponentInstanceRef=Damping, ImplementationRef=Ap_Damping_Implementation
        Task_Init_10_14_Timer0 (RunnableEntityMapping): PositionInTask=14, ActivationOffset=0, RteCyclicTriggerImplementation=Auto, RTEEventRef=Damping_Init1_InitEvent, MappedToTaskRef=Task_Init_10
        Task_2ms_10_15_Timer0 (RunnableEntityMapping): PositionInTask=15, ActivationOffset=0, RteCyclicTriggerImplementation=Auto, RTEEventRef=TMT_Damping_Per1, MappedToTaskRef=Task_2ms_10
      DampingFirewall_Ap_DampingFirewall_ECU_Composition: SoftwareComponentInstanceRef=DampingFirewall, ImplementationRef=Ap_DampingFirewall_Implementation
        Task_2ms_10_19_Timer0 (RunnableEntityMapping): PositionInTask=19, ActivationOffset=0, RteCyclicTriggerImplementation=Auto, RTEEventRef=TMT_DampingFirewall_Per1, MappedToTaskRef=Task_2ms_10
        Task_Init_10_16_Timer0 (RunnableEntityMapping):
          PositionInTask = 16
          ActivationOffset = 0
          RteCyclicTriggerImplementation = Auto
          RTEEventRef = DampingFirewall_Init1_InitEvent
          MappedToTaskRef = Task_Init_10
      Dcm_Dcm_ECU_Composition: ServiceComponentPrototypeRef=Dcm, ImplementationRef=Dcm_Implementation
        Task_SchM_2ms_9_1_Timer0 (RunnableEntityMapping): PositionInTask=1, ActivationOffset=0, RteCyclicTriggerImplementation=Auto, RTEEventRef=TMT_Dcm_MainFunction, MappedToTaskRef=Task_SchM_2ms_9
      Dem_Dem_ECU_Composition: ServiceComponentPrototypeRef=Dem, ImplementationRef=Dem_Implementation
        Task_SchM_2ms_9_0_Timer0 (RunnableEntityMapping): PositionInTask=0, ActivationOffset=0, RteCyclicTriggerImplementation=Auto, RTEEventRef=TMT_Dem_MainFunction, MappedToTaskRef=Task_SchM_2ms_9
      DemIf_Ap_DemIf_ECU_Composition: SoftwareComponentInstanceRef=DemIf, ImplementationRef=Ap_DemIf_Implementation
        Task_SchM_2ms_9_7_Timer0 (RunnableEntityMapping): PositionInTask=7, ActivationOffset=0, RteCyclicTriggerImplementation=Auto, RTEEventRef=TMT_DemIf_DummyFunction, MappedToTaskRef=Task_SchM_2ms_9
      DiagMgr10_Ap_DiagMgr10_ECU_Composition: SoftwareComponentInstanceRef=DiagMgr10, ImplementationRef=Ap_DiagMgr10_Implementation
        4 x RunnableEntityMapping, all with ActivationOffset=0, RteCyclicTriggerImplementation=Auto:
          Task_100ms_10_8_Timer0: PositionInTask=8, RTEEventRef=TMT_DiagMgr10_Per, MappedToTaskRef=Task_100ms_10
          Task_Trns_10_0_TrigModeSwitch0: PositionInTask=0, RTEEventRef=MST_DiagMgr10_Trns_0, MappedToTaskRef=Task_Trns_10
          Task_Init_10_1_Timer0: PositionInTask=1, RTEEventRef=DiagMgr10_InitEvent, MappedToTaskRef=Task_Init_10
          Task_2ms_10_58_Timer0: PositionInTask=58, RTEEventRef=TMT_DiagMgr_Per1, MappedToTaskRef=Task_2ms_10
      DiagMgr8_Ap_DiagMgr8_ECU_Composition: SoftwareComponentInstanceRef=DiagMgr8, ImplementationRef=Ap_DiagMgr8_Implementation
        3 x RunnableEntityMapping, all with ActivationOffset=0, RteCyclicTriggerImplementation=Auto:
          Task_Init_8_0_Timer0: PositionInTask=0, RTEEventRef=DiagMgr8_InitEvent, MappedToTaskRef=Task_Init_8
          Task_Trns_8_0_TrigModeSwitch0: PositionInTask=0, RTEEventRef=MST_DiagMgr8_Trns_0, MappedToTaskRef=Task_Trns_8
          Task_100ms_8_1_Timer0: PositionInTask=1, RTEEventRef=TMT_DiagMgr8_Per, MappedToTaskRef=Task_100ms_8
      DiagMgr9_Ap_DiagMgr9_ECU_Composition: SoftwareComponentInstanceRef=DiagMgr9, ImplementationRef=Ap_DiagMgr9_Implementation
        6 x RunnableEntityMapping, all with ActivationOffset=0, RteCyclicTriggerImplementation=Auto:
          Task_100ms_9_6_Timer0: PositionInTask=6, RTEEventRef=TMT_DiagMgr_Per2, MappedToTaskRef=Task_100ms_9
          Task_Trns_9_1_TrigModeSwitch0: PositionInTask=1, RTEEventRef=MST_DiagMgr_Trns1_0, MappedToTaskRef=Task_Trns_9
          Task_100ms_9_5_Timer0: PositionInTask=5, RTEEventRef=TMT_DiagMgr9_Per, MappedToTaskRef=Task_100ms_9
          Task_Init_9_0_Timer0: PositionInTask=0, RTEEventRef=DiagMgr9_InitEvent, MappedToTaskRef=Task_Init_9
          Task_Init_9_1_Timer0: PositionInTask=1, RTEEventRef=DiagMgr_Init1_InitEvent, MappedToTaskRef=Task_Init_9
          Task_Trns_9_0_TrigModeSwitch0: PositionInTask=0, RTEEventRef=MST_DiagMgr9_Trns_0, MappedToTaskRef=Task_Trns_9
      DiagSvc_Ap_DiagSvc_ECU_Composition: SoftwareComponentInstanceRef=DiagSvc, ImplementationRef=Ap_DiagSvc_Implementation
        Task_Init_9_12_Timer0 (RunnableEntityMapping): PositionInTask=12, ActivationOffset=0, RteCyclicTriggerImplementation=Auto, RTEEventRef=DiagSvc_Init1_InitEvent, MappedToTaskRef=Task_Init_9
        3 x NVRamAllocation:
          MAP_Rte_NvmBlock_DiagSvc_SparePartNumberData: SwNvRamMappingReference=DiagSvc.SparePartNumber, NvmBlockRef=Rte_NvmBlock_DiagSvc_SparePartNumberData
          MAP_Rte_NvmBlock_DiagSvc_TuningSetSelectData: SwNvRamMappingReference=DiagSvc.TuningSetSelect, NvmBlockRef=Rte_NvmBlock_DiagSvc_TuningSetSelectData
          MAP_Rte_NvmBlock_DiagSvc_SupplierIdentifierData: SwNvRamMappingReference=DiagSvc.SupplierIdentifier, NvmBlockRef=Rte_NvmBlock_DiagSvc_SupplierIdentifierData
      DigHwTrqSENT_Sa_DigHwTrqSENT_ECU_Composition: SoftwareComponentInstanceRef=DigHwTrqSENT, ImplementationRef=Sa_DigHwTrqSENT_Implementation
        4 x RunnableEntityMapping, all with ActivationOffset=0, RteCyclicTriggerImplementation=Auto:
          Task_4ms_10_2_Timer0: PositionInTask=2, RTEEventRef=TMT_DigHwTrqSENT_Per2, MappedToTaskRef=Task_4ms_10
          Task_Init_10_19_Timer0: PositionInTask=19, RTEEventRef=DigHwTrqSENT_Init1_InitEvent, MappedToTaskRef=Task_Init_10
          Task_100ms_10_5_Timer0: PositionInTask=5, RTEEventRef=TMT_DigHwTrqSENT_Per3, MappedToTaskRef=Task_100ms_10
          Task_2ms_10_7_Timer0: PositionInTask=7, RTEEventRef=TMT_DigHwTrqSENT_Per1, MappedToTaskRef=Task_2ms_10
        MAP_Rte_NvmBlock_DigHwTrqSENT_DigTrqTrim (NVRamAllocation): SwNvRamMappingReference=DigHwTrqSENT.DigHwTrqSENTTrim, NvmBlockRef=Rte_NvmBlock_DigHwTrqSENT_DigTrqTrim
      DigMSB_Sa_DigMSB_ECU_Composition: SoftwareComponentInstanceRef=DigMSB, ImplementationRef=Sa_DigMSB_Implementation
        3 x RunnableEntityMapping, all with ActivationOffset=0, RteCyclicTriggerImplementation=Auto:
          Task_Init_10_22_Timer0: PositionInTask=22, RTEEventRef=DigMSB_InitEvent, MappedToTaskRef=Task_Init_10
          Task_2ms_10_5_Timer0: PositionInTask=5, RTEEventRef=TMT_DigMSB_Per2, MappedToTaskRef=Task_2ms_10
          Task_100ms_10_1_Timer0: PositionInTask=1, RTEEventRef=TMT_DigMSB_Per3, MappedToTaskRef=Task_100ms_10
        MAP_Rte_NvmBlock_DigMSB_DigMSBEOLData (NVRamAllocation): SwNvRamMappingReference=DigMSB.DigMSBEOLBlk, NvmBlockRef=Rte_NvmBlock_DigMSB_DigMSBEOLData
      DigPhsReasDiag_Ap_DigPhsReasDiag_ECU_Composition: SoftwareComponentInstanceRef=DigPhsReasDiag, ImplementationRef=Ap_DigPhsReasDiag_Implementation
        3 x RunnableEntityMapping, all with ActivationOffset=0, RteCyclicTriggerImplementation=Auto:
          Task_Init_10_7_Timer0: PositionInTask=7, RTEEventRef=DigPhsReasDiag_InitEvent, MappedToTaskRef=Task_Init_10
          Task_2ms_10_47_Timer0: PositionInTask=47, RTEEventRef=TMT_DigPhsReasDiag_Per1, MappedToTaskRef=Task_2ms_10
          Task_Trns_10_9_TrigModeSwitch0: PositionInTask=9, RTEEventRef=MST_DigPhsReasDiag_Trans1_0, MappedToTaskRef=Task_Trns_10
      EOTActuatorMng_Ap_EOTActuatorMng_ECU_Composition: SoftwareComponentInstanceRef=EOTActuatorMng, ImplementationRef=Ap_EOTActuatorMng_Implementation
        Task_2ms_10_52_Timer0 (RunnableEntityMapping): PositionInTask=52, ActivationOffset=0, RteCyclicTriggerImplementation=Auto, RTEEventRef=TMT_EOTActuatorMng_Per1, MappedToTaskRef=Task_2ms_10
      EcuM_EcuM_ECU_Composition: ServiceComponentPrototypeRef=EcuM, ImplementationRef=EcuM_Implementation
      ElePwr_Ap_ElePwr_ECU_Composition: SoftwareComponentInstanceRef=ElePwr, ImplementationRef=Ap_ElePwr_Implementation
        Task_10ms_9_7_Timer0 (RunnableEntityMapping): PositionInTask=7, ActivationOffset=0, RteCyclicTriggerImplementation=Auto, RTEEventRef=TMT_ElePwr_Per1, MappedToTaskRef=Task_10ms_9
      EtDmpFw_Ap_EtDmpFw_ECU_Composition: SoftwareComponentInstanceRef=EtDmpFw, ImplementationRef=Ap_EtDmpFw_Implementation
        Task_2ms_10_53_Timer0 (RunnableEntityMapping): PositionInTask=53, ActivationOffset=0, RteCyclicTriggerImplementation=Auto, RTEEventRef=TMT_EtDmpFw_Per1, MappedToTaskRef=Task_2ms_10
      FltInjection_Ap_FltInjection_ECU_Composition: SoftwareComponentInstanceRef=FltInjection, ImplementationRef=Ap_FltInjection_Implementation
        Task_2ms_10_57_Timer0 (RunnableEntityMapping): PositionInTask=57, ActivationOffset=0, RteCyclicTriggerImplementation=Auto, RTEEventRef=TMT_FltInjection_Per1, MappedToTaskRef=Task_2ms_10
      FrqDepDmpnInrtCmp_Ap_FrqDepDmpnInrtCmp_ECU_Composition: SoftwareComponentInstanceRef=FrqDepDmpnInrtCmp, ImplementationRef=Ap_FrqDepDmpnInrtCmp_Implementation
        Task_Init_10_13_Timer0 (RunnableEntityMapping): PositionInTask=13, ActivationOffset=0, RteCyclicTriggerImplementation=Auto, RTEEventRef=FrqDepDmpnInrtCmp_InitEvent, MappedToTaskRef=Task_Init_10
        Task_2ms_10_16_Timer0 (RunnableEntityMapping): PositionInTask=16, ActivationOffset=0, RteCyclicTriggerImplementation=Auto, RTEEventRef=TMT_FrqDepDmpnInrtCmp_Per1, MappedToTaskRef=Task_2ms_10
      Gsod_Ap_Gsod_ECU_Composition: SoftwareComponentInstanceRef=Gsod, ImplementationRef=Ap_Gsod_Implementation
        Task_2ms_10_56_Timer0 (RunnableEntityMapping): PositionInTask=56, ActivationOffset=0, RteCyclicTriggerImplementation=Auto, RTEEventRef=TMT_Gsod_Per1, MappedToTaskRef=Task_2ms_10
      HaitecTrqCmd_Ap_HaitecTrqCmd_ECU_Composition: SoftwareComponentInstanceRef=HaitecTrqCmd, ImplementationRef=Ap_HaitecTrqCmd_Implementation
        Task_2ms_10_21_Timer0 (RunnableEntityMapping): PositionInTask=21, ActivationOffset=0, RteCyclicTriggerImplementation=Auto, RTEEventRef=TMT_HaitecTrqCmd_Per1, MappedToTaskRef=Task_2ms_10
        Task_Init_10_26_Timer0 (RunnableEntityMapping): PositionInTask=26, ActivationOffset=0, RteCyclicTriggerImplementation=Auto, RTEEventRef=HaitecTrqCmd_Init1_InitEvent, MappedToTaskRef=Task_Init_10
      HiLoadStall_Ap_HiLoadStall_ECU_Composition: SoftwareComponentInstanceRef=HiLoadStall, ImplementationRef=Ap_HiLoadStall_Implementation
        Task_2ms_9_7_Timer0 (RunnableEntityMapping): PositionInTask=7, ActivationOffset=0, RteCyclicTriggerImplementation=Auto, RTEEventRef=TMT_HiLoadStall_Per1, MappedToTaskRef=Task_2ms_9
      HighFreqAssist_Ap_HighFreqAssist_ECU_Composition: SoftwareComponentInstanceRef=HighFreqAssist, ImplementationRef=Ap_HighFreqAssist_Implementation
        Task_2ms_10_40_Timer0 (RunnableEntityMapping): PositionInTask=40, ActivationOffset=0, RteCyclicTriggerImplementation=Auto, RTEEventRef=TMT_HighFreqAssist_Per1, MappedToTaskRef=Task_2ms_10
      HwPwUp_Ap_HwPwUp_ECU_Composition: SoftwareComponentInstanceRef=HwPwUp, ImplementationRef=Ap_HwPwUp_Implementation
        4 x RunnableEntityMapping, all with ActivationOffset=0, RteCyclicTriggerImplementation=Auto:
          Task_Trns_10_2_TrigModeSwitch1: PositionInTask=2, RTEEventRef=MST_HwPwUp_Trns1_1, MappedToTaskRef=Task_Trns_10
          Task_Trns_10_2_TrigModeSwitch0: PositionInTask=2, RTEEventRef=MST_HwPwUp_Trns1_0, MappedToTaskRef=Task_Trns_10
          Task_2ms_10_37_Timer0: PositionInTask=37, RTEEventRef=TMT_HwPwUp_Per1, MappedToTaskRef=Task_2ms_10
          Task_Trns_10_6_TrigModeSwitch0: PositionInTask=6, RTEEventRef=MST_HwPwUp_Trns2_0, MappedToTaskRef=Task_Trns_10
      HystComp_Ap_HystComp_ECU_Composition: SoftwareComponentInstanceRef=HystComp, ImplementationRef=Ap_HystComp_Implementation
        Task_2ms_10_14_Timer0 (RunnableEntityMapping): PositionInTask=14, ActivationOffset=0, RteCyclicTriggerImplementation=Auto, RTEEventRef=TMT_HystComp_Per1, MappedToTaskRef=Task_2ms_10
        Task_Init_10_12_Timer0 (RunnableEntityMapping): PositionInTask=12, ActivationOffset=0, RteCyclicTriggerImplementation=Auto, RTEEventRef=HystComp_Init1_InitEvent, MappedToTaskRef=Task_Init_10
      IoHwAbsDigSig_IoHwAbstraction_ECU_Composition: SoftwareComponentInstanceRef=IoHwAbsDigSig, ImplementationRef=IoHwAbstraction_Implementation
        Task_SchM_2ms_9_8_Timer0 (RunnableEntityMapping): PositionInTask=8, ActivationOffset=0, RteCyclicTriggerImplementation=Auto, RTEEventRef=TMT_IoHwAb_Dummy, MappedToTaskRef=Task_SchM_2ms_9
      IoHwAbstractionUsr_IoHwAbstractionUsr_ECU_Composition: SoftwareComponentInstanceRef=IoHwAbstractionUsr, ImplementationRef=IoHwAbstractionUsr_Implementation
        3 x RunnableEntityMapping, all with ActivationOffset=0, RteCyclicTriggerImplementation=Auto:
          Task_2ms_10_35_Timer0: PositionInTask=35, RTEEventRef=TMT_IoHwAb_ReadAdc, MappedToTaskRef=Task_2ms_10
          Task_Init_10_5_Timer0: PositionInTask=5, RTEEventRef=IoHwAb_InitEvent, MappedToTaskRef=Task_Init_10
          Task_2ms_10_2_Timer0: PositionInTask=2, RTEEventRef=TMT_IoHwAb_StartAdc, MappedToTaskRef=Task_2ms_10
      LmtCod_Ap_LmtCod_ECU_Composition: SoftwareComponentInstanceRef=LmtCod, ImplementationRef=Ap_LmtCod_Implementation
        Task_2ms_9_6_Timer0 (RunnableEntityMapping): PositionInTask=6, ActivationOffset=0, RteCyclicTriggerImplementation=Auto, RTEEventRef=TMT_LmtCod_Per1, MappedToTaskRef=Task_2ms_9
      LrnEOT_Ap_LrnEOT_ECU_Composition: SoftwareComponentInstanceRef=LrnEOT, ImplementationRef=Ap_LrnEOT_Implementation
        Task_Init_9_8_Timer0 (RunnableEntityMapping): PositionInTask=8, ActivationOffset=0, RteCyclicTriggerImplementation=Auto, RTEEventRef=LrnEOT_Init1_InitEvent, MappedToTaskRef=Task_Init_9
        Task_10ms_9_4_Timer0 (RunnableEntityMapping): PositionInTask=4, ActivationOffset=0, RteCyclicTriggerImplementation=Auto, RTEEventRef=TMT_LrnEOT_Per1, MappedToTaskRef=Task_10ms_9
        MAP_Rte_NvmBlock_LrnEOT_LearnedEOT (NVRamAllocation): SwNvRamMappingReference=LrnEOT.EOTLearnedBlk, NvmBlockRef=Rte_NvmBlock_LrnEOT_LearnedEOT
      MtrDrvDiag_Sa_MtrDrvDiag_ECU_Composition: SoftwareComponentInstanceRef=MtrDrvDiag, ImplementationRef=Sa_MtrDrvDiag_Implementation
        3 x RunnableEntityMapping, all with ActivationOffset=0, RteCyclicTriggerImplementation=Auto:
          Task_2ms_10_39_Timer0: PositionInTask=39, RTEEventRef=TMT_MtrDrvDiag_Per2, MappedToTaskRef=Task_2ms_10
          Task_2ms_10_38_Timer0: PositionInTask=38, RTEEventRef=TMT_MtrDrvDiag_Per1, MappedToTaskRef=Task_2ms_10
          Task_Trns_10_4_TrigModeSwitch0: PositionInTask=4, RTEEventRef=MST_MtrDrvDiag_Trns1_0, MappedToTaskRef=Task_Trns_10
      MtrTempEst_Ap_MtrTempEst_ECU_Composition: SoftwareComponentInstanceRef=MtrTempEst, ImplementationRef=Ap_MtrTempEst_Implementation
        Task_Init_9_3_Timer0 (RunnableEntityMapping): PositionInTask=3, ActivationOffset=0, RteCyclicTriggerImplementation=Auto, RTEEventRef=MtrTempEst_Init1_InitEvent, MappedToTaskRef=Task_Init_9
        Task_100ms_9_2_Timer0 (RunnableEntityMapping): PositionInTask=2, ActivationOffset=0, RteCyclicTriggerImplementation=Auto, RTEEventRef=TMT_MtrTempEst_Per1, MappedToTaskRef=Task_100ms_9
      MtrVel_Sa_MtrVel_ECU_Composition: SoftwareComponentInstanceRef=MtrVel, ImplementationRef=Sa_MtrVel_Implementation
        3 x RunnableEntityMapping, all with ActivationOffset=0, RteCyclicTriggerImplementation=Auto:
          Task_2ms_10_9_Timer0: PositionInTask=9, RTEEventRef=TMT_MtrVel_Per2, MappedToTaskRef=Task_2ms_10
          Task_Init_10_23_Timer0: PositionInTask=23, RTEEventRef=MtrVel_InitEvent, MappedToTaskRef=Task_Init_10
          Task_2ms_10_10_Timer0: PositionInTask=10, RTEEventRef=TMT_MtrVel_Per1, MappedToTaskRef=Task_2ms_10
      MtrVel2_Sa_MtrVel2_ECU_Composition: SoftwareComponentInstanceRef=MtrVel2, ImplementationRef=Sa_MtrVel2_Implementation
        3 x RunnableEntityMapping, all with ActivationOffset=0, RteCyclicTriggerImplementation=Auto:
          Task_Init_8_2_Timer0: PositionInTask=2, RTEEventRef=MtrVel2_InitEvent, MappedToTaskRef=Task_Init_8
          Task_2ms_8_2_Timer0: PositionInTask=2, RTEEventRef=TMT_MtrVel2_Per1, MappedToTaskRef=Task_2ms_8
          Task_2ms_8_3_Timer0: PositionInTask=3, RTEEventRef=TMT_MtrVel2_Per2, MappedToTaskRef=Task_2ms_8
      MtrVel3_Sa_MtrVel3_ECU_Composition: SoftwareComponentInstanceRef=MtrVel3, ImplementationRef=Sa_MtrVel3_Implementation
        Task_Init_10_24_Timer0 (RunnableEntityMapping): PositionInTask=24, ActivationOffset=0, RteCyclicTriggerImplementation=Auto, RTEEventRef=MtrVel3_InitEvent, MappedToTaskRef=Task_Init_10
      NexteerLibs_NexteerLibs_ECU_Composition: ServiceComponentPrototypeRef=NexteerLibs, ImplementationRef=NexteerLibs_Implementation
        Task_2ms_10_34_Timer0 (RunnableEntityMapping): PositionInTask=34, ActivationOffset=0, RteCyclicTriggerImplementation=Auto, RTEEventRef=TMT_SystemTime_Per1, MappedToTaskRef=Task_2ms_10
      Nhet1_Cd_Nhet1_ECU_Composition: SoftwareComponentInstanceRef=Nhet1, ImplementationRef=Cd_Nhet1_Implementation
        Task_2ms_10_6_Timer0 (RunnableEntityMapping): PositionInTask=6, ActivationOffset=0, RteCyclicTriggerImplementation=Auto, RTEEventRef=TMT_Nhet1_Per2, MappedToTaskRef=Task_2ms_10
        Task_2ms_10_4_Timer0 (RunnableEntityMapping): PositionInTask=4, ActivationOffset=0, RteCyclicTriggerImplementation=Auto, RTEEventRef=TMT_Nhet1_Per1, MappedToTaskRef=Task_2ms_10
      NtWrap_NtWrap_ECU_Composition: SoftwareComponentInstanceRef=NtWrap, ImplementationRef=NtWrap_Implementation
        Task_100ms_10_7_Timer0 (RunnableEntityMapping): PositionInTask=7, ActivationOffset=0, RteCyclicTriggerImplementation=Auto, RTEEventRef=TMT_NtWrap_Per1, MappedToTaskRef=Task_100ms_10
      NvM_NvM_ECU_Composition: ServiceComponentPrototypeRef=NvM, ImplementationRef=NvM_Implementation
        Task_SchM_2ms_9_6_Timer0 (RunnableEntityMapping): PositionInTask=6, ActivationOffset=0, RteCyclicTriggerImplementation=Auto, RTEEventRef=TMT_NvM_MainFunction, MappedToTaskRef=Task_SchM_2ms_9
      NvMProxy_NvMProxy_ECU_Composition: ServiceComponentPrototypeRef=NvMProxy, ImplementationRef=NvMProxy_Implementation
        Task_SchM_2ms_9_4_Timer0 (RunnableEntityMapping): PositionInTask=4, ActivationOffset=0, RteCyclicTriggerImplementation=Auto, RTEEventRef=TMT_NvMProxy_MainFunction, MappedToTaskRef=Task_SchM_2ms_9
      OvrVoltMon_Sa_OvrVoltMon_ECU_Composition: SoftwareComponentInstanceRef=OvrVoltMon, ImplementationRef=Sa_OvrVoltMon_Implementation
        Task_2ms_10_55_Timer0 (RunnableEntityMapping): PositionInTask=55, ActivationOffset=0, RteCyclicTriggerImplementation=Auto, RTEEventRef=TMT_OvrVoltMon_Per1, MappedToTaskRef=Task_2ms_10
      PICurrCntrl_Ap_PICurrCntrl_ECU_Composition: SoftwareComponentInstanceRef=PICurrCntrl, ImplementationRef=Ap_PICurrCntrl_Implementation
        Task_2ms_10_46_Timer0 (RunnableEntityMapping): PositionInTask=46, ActivationOffset=0, RteCyclicTriggerImplementation=Auto, RTEEventRef=TMT_PICurrCntrl_Per2, MappedToTaskRef=Task_2ms_10
      PeakCurrEst_Ap_PeakCurrEst_ECU_Composition: SoftwareComponentInstanceRef=PeakCurrEst, ImplementationRef=Ap_PeakCurrEst_Implementation
        Task_100ms_10_3_Timer0 (RunnableEntityMapping): PositionInTask=3, ActivationOffset=0, RteCyclicTriggerImplementation=Auto, RTEEventRef=TMT_PeakCurrEst_Per2, MappedToTaskRef=Task_100ms_10
        Task_2ms_10_44_Timer0 (RunnableEntityMapping): PositionInTask=44, ActivationOffset=0, RteCyclicTriggerImplementation=Auto, RTEEventRef=TMT_PeakCurrEst_Per1, MappedToTaskRef=Task_2ms_10
      Polarity_Ap_Polarity_ECU_Composition: SoftwareComponentInstanceRef=Polarity, ImplementationRef=Ap_Polarity_Implementation
        Task_10ms_10_7_Timer0 (RunnableEntityMapping): PositionInTask=7, ActivationOffset=0, RteCyclicTriggerImplementation=Auto, RTEEventRef=TMT_Polarity_Per1, MappedToTaskRef=Task_10ms_10
        Task_Init_10_3_Timer0 (RunnableEntityMapping): PositionInTask=3, ActivationOffset=0, RteCyclicTriggerImplementation=Auto, RTEEventRef=Polarity_Init1_InitEvent, MappedToTaskRef=Task_Init_10
        MAP_Rte_NvmBlock_Polarity_Polarity_Cnt_Str (NVRamAllocation): SwNvRamMappingReference=Polarity.PolarityBlock, NvmBlockRef=Rte_NvmBlock_Polarity_Polarity_Cnt_Str
      PwrLmtFuncCr_Ap_PwrLmtFuncCr_ECU_Composition: SoftwareComponentInstanceRef=PwrLmtFuncCr, ImplementationRef=Ap_PwrLmtFuncCr_Implementation
        3 x RunnableEntityMapping, all with ActivationOffset=0, RteCyclicTriggerImplementation=Auto:
          Task_Init_10_18_Timer0: PositionInTask=18, RTEEventRef=PwrLmtFuncCr_Init1_InitEvent, MappedToTaskRef=Task_Init_10
          Task_10ms_10_4_Timer0: PositionInTask=4, RTEEventRef=TMT_PwrLmtFuncCr_Per2, MappedToTaskRef=Task_10ms_10
          Task_2ms_10_25_Timer0: PositionInTask=25, RTEEventRef=TMT_PwrLmtFuncCr_Per1, MappedToTaskRef=Task_2ms_10
      QuadDet_Ap_QuadDet_ECU_Composition: SoftwareComponentInstanceRef=QuadDet, ImplementationRef=Ap_QuadDet_Implementation
        Task_2ms_10_41_Timer0 (RunnableEntityMapping): PositionInTask=41, ActivationOffset=0, RteCyclicTriggerImplementation=Auto, RTEEventRef=TMT_QuadDet_Per1, MappedToTaskRef=Task_2ms_10
      Return_Ap_Return_ECU_Composition: SoftwareComponentInstanceRef=Return, ImplementationRef=Ap_Return_Implementation
        Task_2ms_10_11_Timer0 (RunnableEntityMapping): PositionInTask=11, ActivationOffset=0, RteCyclicTriggerImplementation=Auto, RTEEventRef=TMT_Return_Per1, MappedToTaskRef=Task_2ms_10
      ReturnFirewall_Ap_ReturnFirewall_ECU_Composition: SoftwareComponentInstanceRef=ReturnFirewall, ImplementationRef=Ap_ReturnFirewall_Implementation
        Task_2ms_10_12_Timer0 (RunnableEntityMapping): PositionInTask=12, ActivationOffset=0, RteCyclicTriggerImplementation=Auto, RTEEventRef=TMT_ReturnFirewall_Per1, MappedToTaskRef=Task_2ms_10
      RteErrata_RteErrata10_ECU_Composition: SoftwareComponentInstanceRef=RteErrata, ImplementationRef=RteErrata10_Implementation
        4 x RunnableEntityMapping, all with PositionInTask=11, ActivationOffset=0, RteCyclicTriggerImplementation=Auto, MappedToTaskRef=Task_Trns_10:
          Task_Trns_10_11_TrigModeSwitch3: RTEEventRef=MST_RteErrata10_Trns_3
          Task_Trns_10_11_TrigModeSwitch2: RTEEventRef=MST_RteErrata10_Trns_2
          Task_Trns_10_11_TrigModeSwitch1: RTEEventRef=MST_RteErrata10_Trns_1
          Task_Trns_10_11_TrigModeSwitch0: RTEEventRef=MST_RteErrata10_Trns_0
      RteErrata8_RteErrata8_ECU_Composition: SoftwareComponentInstanceRef=RteErrata8, ImplementationRef=RteErrata8_Implementation
        4 x RunnableEntityMapping, all with PositionInTask=1, ActivationOffset=0, RteCyclicTriggerImplementation=Auto, MappedToTaskRef=Task_Trns_8:
          Task_Trns_8_1_TrigModeSwitch3: RTEEventRef=MST_RteErrata8_Trns_3
          Task_Trns_8_1_TrigModeSwitch2: RTEEventRef=MST_RteErrata8_Trns_2
          Task_Trns_8_1_TrigModeSwitch1: RTEEventRef=MST_RteErrata8_Trns_1
          Task_Trns_8_1_TrigModeSwitch0: RTEEventRef=MST_RteErrata8_Trns_0
      RteErrata9_RteErrata9_ECU_Composition: SoftwareComponentInstanceRef=RteErrata9, ImplementationRef=RteErrata9_Implementation
        4 x RunnableEntityMapping, all with PositionInTask=6, ActivationOffset=0, RteCyclicTriggerImplementation=Auto, MappedToTaskRef=Task_Trns_9:
          Task_Trns_9_6_TrigModeSwitch3: RTEEventRef=MST_RteErrata9_Trns_3
          Task_Trns_9_6_TrigModeSwitch2: RTEEventRef=MST_RteErrata9_Trns_2
          Task_Trns_9_6_TrigModeSwitch1: RTEEventRef=MST_RteErrata9_Trns_1
          Task_Trns_9_6_TrigModeSwitch0: RTEEventRef=MST_RteErrata9_Trns_0
      ShtdnMech_Sa_ShtdnMech_ECU_Composition: SoftwareComponentInstanceRef=ShtdnMech, ImplementationRef=Sa_ShtdnMech_Implementation
        Task_10ms_10_9_Timer0 (RunnableEntityMapping): PositionInTask=9, ActivationOffset=0, RteCyclicTriggerImplementation=Auto, RTEEventRef=TMT_ShtdnMech_Per1, MappedToTaskRef=Task_10ms_10
      SignlCondn_Ap_SignlCondn_ECU_Composition: SoftwareComponentInstanceRef=SignlCondn, ImplementationRef=Ap_SignlCondn_Implementation
        Task_2ms_10_54_Timer0 (RunnableEntityMapping): PositionInTask=54, ActivationOffset=0, RteCyclicTriggerImplementation=Auto, RTEEventRef=TMT_SignlCondn_Per1, MappedToTaskRef=Task_2ms_10
      SrlComInput_Ap_SrlComInput_ECU_Composition: SoftwareComponentInstanceRef=SrlComInput, ImplementationRef=Ap_SrlComInput_Implementation
        Task_10ms_9_1_Timer0 (RunnableEntityMapping): PositionInTask=1, ActivationOffset=0, RteCyclicTriggerImplementation=Auto, RTEEventRef=TMT_SrlComInput_Per1, MappedToTaskRef=Task_10ms_9
        Task_Init_9_10_Timer0 (RunnableEntityMapping): PositionInTask=10, ActivationOffset=0, RteCyclicTriggerImplementation=Auto, RTEEventRef=SrlComInput_InitEvent, MappedToTaskRef=Task_Init_9
      SrlComOutput_Ap_SrlComOutput_ECU_Composition: SoftwareComponentInstanceRef=SrlComOutput, ImplementationRef=Ap_SrlComOutput_Implementation
        Task_10ms_9_2_Timer0 (RunnableEntityMapping): PositionInTask=2, ActivationOffset=0, RteCyclicTriggerImplementation=Auto, RTEEventRef=TMT_SrlComOutput_Per1, MappedToTaskRef=Task_10ms_9
        Task_Init_9_11_Timer0 (RunnableEntityMapping): PositionInTask=11, ActivationOffset=0, RteCyclicTriggerImplementation=Auto, RTEEventRef=SrlComOutput_Init1_InitEvent, MappedToTaskRef=Task_Init_9
      StOpCtrl_Ap_StOpCtrl_ECU_Composition: SoftwareComponentInstanceRef=StOpCtrl, ImplementationRef=Ap_StOpCtrl_Implementation
        Task_2ms_10_20_Timer0 (RunnableEntityMapping): PositionInTask=20, ActivationOffset=0, RteCyclicTriggerImplementation=Auto, RTEEventRef=TMT_StOpCtrl_Per1, MappedToTaskRef=Task_2ms_10
      StaMd_Ap_StaMd_ECU_Composition: SoftwareComponentInstanceRef=StaMd, ImplementationRef=Ap_StaMd_Implementation
        Task_Trns_10_8_TrigModeSwitch0 (RunnableEntityMapping): PositionInTask=8, ActivationOffset=0, RteCyclicTriggerImplementation=Auto, RTEEventRef=MST_StaMd_Trns1_0, MappedToTaskRef=Task_Trns_10
        StaMds_MilestoneRqst_WARMINIT_ExclArea (ExclusiveAreaImplementation): ExclusiveAreaImplMechanism=INTERRUPT_BLOCKING, ExclusiveAreaRef=StaMds_MilestoneRqst_WARMINIT_ExclArea
        Task_2ms_10_59_Timer0 (RunnableEntityMapping): PositionInTask=59, ActivationOffset=0, RteCyclicTriggerImplementation=Auto, RTEEventRef=TMT_StaMd_Per1, MappedToTaskRef=Task_2ms_10
        Task_Init_10_2_Timer0 (RunnableEntityMapping): PositionInTask=2, ActivationOffset=0, RteCyclicTriggerImplementation=Auto, RTEEventRef=StaMd_Init1_InitEvent, MappedToTaskRef=Task_Init_10
      StaMd8_Ap_StaMd8_ECU_Composition: SoftwareComponentInstanceRef=StaMd8, ImplementationRef=Ap_StaMd8_Implementation
        Task_2ms_8_4_Timer0 (RunnableEntityMapping): PositionInTask=4, ActivationOffset=0, RteCyclicTriggerImplementation=Auto, RTEEventRef=TMT_StaMd8_Per1, MappedToTaskRef=Task_2ms_8
        StaMds8_MilestoneRqst_WARMINIT_ExclArea (ExclusiveAreaImplementation): ExclusiveAreaImplMechanism=INTERRUPT_BLOCKING, ExclusiveAreaRef=StaMds8_MilestoneRqst_WARMINIT_ExclArea
      StaMd9_Ap_StaMd9_ECU_Composition: SoftwareComponentInstanceRef=StaMd9, ImplementationRef=Ap_StaMd9_Implementation
        Task_SchM_Trns_9_0_Timer0 (RunnableEntityMapping): PositionInTask=0, ActivationOffset=0, RteCyclicTriggerImplementation=Auto, RTEEventRef=TMT_StaMd9_Trns_DemShutdown, MappedToTaskRef=Task_SchM_Trns_9
        StaMds9_MilestoneRqst_WARMINIT_ExclArea (ExclusiveAreaImplementation): ExclusiveAreaImplMechanism=INTERRUPT_BLOCKING, ExclusiveAreaRef=StaMds9_MilestoneRqst_WARMINIT_ExclArea
        Task_2ms_9_10_Timer0 (RunnableEntityMapping): PositionInTask=10, ActivationOffset=0, RteCyclicTriggerImplementation=Auto, RTEEventRef=TMT_StaMd9_Per1, MappedToTaskRef=Task_2ms_9
      StabilityComp_Ap_StabilityComp_ECU_Composition: SoftwareComponentInstanceRef=StabilityComp, ImplementationRef=Ap_StabilityComp_Implementation
        Task_2ms_10_18_Timer0 (RunnableEntityMapping): PositionInTask=18, ActivationOffset=0, RteCyclicTriggerImplementation=Auto, RTEEventRef=TMT_StabilityComp_Per1, MappedToTaskRef=Task_2ms_10
        Task_Init_10_17_Timer0 (RunnableEntityMapping): PositionInTask=17, ActivationOffset=0, RteCyclicTriggerImplementation=Auto, RTEEventRef=StabilityComp_Init1_InitEvent, MappedToTaskRef=Task_Init_10
      StabilityComp2_Ap_StabilityComp2_ECU_Composition: SoftwareComponentInstanceRef=StabilityComp2, ImplementationRef=Ap_StabilityComp2_Implementation
        Task_2ms_8_1_Timer0 (RunnableEntityMapping): PositionInTask=1, ActivationOffset=0, RteCyclicTriggerImplementation=Auto, RTEEventRef=TMT_StabilityComp2_Per1, MappedToTaskRef=Task_2ms_8
        Task_Init_8_1_Timer0 (RunnableEntityMapping): PositionInTask=1, ActivationOffset=0, RteCyclicTriggerImplementation=Auto, RTEEventRef=StabilityComp2_Init1_InitEvent, MappedToTaskRef=Task_Init_8
      Sweep_Ap_Sweep_ECU_Composition: SoftwareComponentInstanceRef=Sweep, ImplementationRef=Ap_Sweep_Implementation
        Task_Init_10_28_Timer0 (RunnableEntityMapping): PositionInTask=28, ActivationOffset=0, RteCyclicTriggerImplementation=Auto, RTEEventRef=Sweep_InitEvent, MappedToTaskRef=Task_Init_10
        Task_2ms_10_8_Timer0 (RunnableEntityMapping): PositionInTask=8, ActivationOffset=0, RteCyclicTriggerImplementation=Auto, RTEEventRef=TMT_Sweep_Per1, MappedToTaskRef=Task_2ms_10
      Sweep2_Ap_Sweep2_ECU_Composition: SoftwareComponentInstanceRef=Sweep2, ImplementationRef=Ap_Sweep2_Implementation
        Task_2ms_10_23_Timer0 (RunnableEntityMapping): PositionInTask=23, ActivationOffset=0, RteCyclicTriggerImplementation=Auto, RTEEventRef=TMT_Sweep2_Per1, MappedToTaskRef=Task_2ms_10
      ThrmlDutyCycle_Ap_ThrmlDutyCycle_ECU_Composition: SoftwareComponentInstanceRef=ThrmlDutyCycle, ImplementationRef=Ap_ThrmlDutyCycle_Implementation
        Task_Init_9_5_Timer0 (RunnableEntityMapping): PositionInTask=5, ActivationOffset=0, RteCyclicTriggerImplementation=Auto, RTEEventRef=ThrmlDutyCycle_Init1_InitEvent, MappedToTaskRef=Task_Init_9
        Task_100ms_9_4_Timer0 (RunnableEntityMapping): PositionInTask=4, ActivationOffset=0, RteCyclicTriggerImplementation=Auto, RTEEventRef=TMT_ThrmlDutyCycle_Per1, MappedToTaskRef=Task_100ms_9
        MAP_Rte_NvmBlock_ThrmlDutyCycle_ThrmlDutyCycle_FltStVal (NVRamAllocation): SwNvRamMappingReference=ThrmlDutyCycle.ThrmlDutyCycle_FltStVar, NvmBlockRef=Rte_NvmBlock_ThrmlDutyCycle_ThrmlDutyCycle_FltStVal
      TmprlMon_Sa_TmprlMon_ECU_Composition: SoftwareComponentInstanceRef=TmprlMon, ImplementationRef=Sa_TmprlMon_Implementation
        5 x RunnableEntityMapping, all with ActivationOffset=0, RteCyclicTriggerImplementation=Auto:
          Task_2ms_10_1_Timer0: PositionInTask=1, RTEEventRef=TMT_TmprlMon_Per1, MappedToTaskRef=Task_2ms_10
          Task_10ms_10_8_Timer0: PositionInTask=8, RTEEventRef=TMT_TmprlMon_Per3, MappedToTaskRef=Task_10ms_10
          Task_Trns_10_5_TrigModeSwitch0: PositionInTask=5, RTEEventRef=MST_TmprlMon_Trns2_0, MappedToTaskRef=Task_Trns_10
          Task_Trns_10_3_TrigModeSwitch0: PositionInTask=3, RTEEventRef=MST_TmprlMon_Trns1_0, MappedToTaskRef=Task_Trns_10
          Task_2ms_10_33_Timer0: PositionInTask=33, RTEEventRef=TMT_TmprlMon_Per2, MappedToTaskRef=Task_2ms_10
      TmprlMon2_Sa_TmprlMon2_ECU_Composition: SoftwareComponentInstanceRef=TmprlMon2, ImplementationRef=Sa_TmprlMon2_Implementation
        Task_2ms_10_32_Timer0 (RunnableEntityMapping): PositionInTask=32, ActivationOffset=0, RteCyclicTriggerImplementation=Auto, RTEEventRef=TMT_TmprlMon2_Per1, MappedToTaskRef=Task_2ms_10
      TqRsDg_Ap_TqRsDg_ECU_Composition: SoftwareComponentInstanceRef=TqRsDg, ImplementationRef=Ap_TqRsDg_Implementation
        Task_Init_10_15_Timer0 (RunnableEntityMapping): PositionInTask=15, ActivationOffset=0, RteCyclicTriggerImplementation=Auto, RTEEventRef=TqRsDg_Init1_InitEvent, MappedToTaskRef=Task_Init_10
        Task_2ms_10_29_Timer0 (RunnableEntityMapping): PositionInTask=29, ActivationOffset=0, RteCyclicTriggerImplementation=Auto, RTEEventRef=TMT_TqRsDg_Per1, MappedToTaskRef=Task_2ms_10
      TrqCanc_Ap_TrqCanc_ECU_Composition: SoftwareComponentInstanceRef=TrqCanc, ImplementationRef=Ap_TrqCanc_Implementation
        Task_2ms_10_45_Timer0 (RunnableEntityMapping): PositionInTask=45, ActivationOffset=0, RteCyclicTriggerImplementation=Auto, RTEEventRef=TMT_TrqCanc_Per1, MappedToTaskRef=Task_2ms_10
        Task_Init_10_11_Timer0 (RunnableEntityMapping): PositionInTask=11, ActivationOffset=0, RteCyclicTriggerImplementation=Auto, RTEEventRef=TrqCanc_InitEvent, MappedToTaskRef=Task_Init_10
        MAP_Rte_NvmBlock_TrqCanc_CogTrqRplComp (NVRamAllocation): SwNvRamMappingReference=TrqCanc.CogTrqRplCompBlk, NvmBlockRef=Rte_NvmBlock_TrqCanc_CogTrqRplComp
        MAP_Rte_NvmBlock_TrqCanc_CogTrqCal (NVRamAllocation): SwNvRamMappingReference=TrqCanc.CogTrqCalBlk, NvmBlockRef=Rte_NvmBlock_TrqCanc_CogTrqCal
      TrqCmdScl_Ap_TrqCmdScl_ECU_Composition: SoftwareComponentInstanceRef=TrqCmdScl, ImplementationRef=Ap_TrqCmdScl_Implementation
        Task_2ms_10_26_Timer0 (RunnableEntityMapping): PositionInTask=26, ActivationOffset=0, RteCyclicTriggerImplementation=Auto, RTEEventRef=TMT_TrqCmdScl_Per1, MappedToTaskRef=Task_2ms_10
        MAP_Rte_NvmBlock_TrqCmdScl_TorqueCmdSF_Uls_f32 (NVRamAllocation): SwNvRamMappingReference=TrqCmdScl.TorqueCmdSF_EOLData, NvmBlockRef=Rte_NvmBlock_TrqCmdScl_TorqueCmdSF_Uls_f32
      TuningSelAuth_Ap_TuningSelAuth_ECU_Composition: SoftwareComponentInstanceRef=TuningSelAuth, ImplementationRef=Ap_TuningSelAuth_Implementation
        Task_10ms_10_1_Timer0 (RunnableEntityMapping): PositionInTask=1, ActivationOffset=0, RteCyclicTriggerImplementation=Auto, RTEEventRef=TMT_TuningSelAuth_Per1, MappedToTaskRef=Task_10ms_10
        Task_Init_10_6_Timer0 (RunnableEntityMapping): PositionInTask=6, ActivationOffset=0, RteCyclicTriggerImplementation=Auto, RTEEventRef=TuningSelAuth_Init1_InitEvent, MappedToTaskRef=Task_Init_10
      VehDyn_Ap_VehDyn_ECU_Composition: SoftwareComponentInstanceRef=VehDyn, ImplementationRef=Ap_VehDyn_Implementation
        3 x RunnableEntityMapping, all with ActivationOffset=0, RteCyclicTriggerImplementation=Auto:
          Task_Init_10_20_Timer0: PositionInTask=20, RTEEventRef=VehDyn_Init1_InitEvent, MappedToTaskRef=Task_Init_10
          Task_Trns_10_7_TrigModeSwitch0: PositionInTask=7, RTEEventRef=MST_VehDyn_Trns1_0, MappedToTaskRef=Task_Trns_10
          Task_2ms_10_50_Timer0: PositionInTask=50, RTEEventRef=TMT_VehDyn_Per1, MappedToTaskRef=Task_2ms_10
        MAP_Rte_NvmBlock_VehDyn_MotPosReset (NVRamAllocation): SwNvRamMappingReference=VehDyn.VehDynReset, NvmBlockRef=Rte_NvmBlock_VehDyn_MotPosReset
      VehPwrMd_Ap_VehPwrMd_ECU_Composition: SoftwareComponentInstanceRef=VehPwrMd, ImplementationRef=Ap_VehPwrMd_Implementation
        Task_2ms_9_9_Timer0 (RunnableEntityMapping): PositionInTask=9, ActivationOffset=0, RteCyclicTriggerImplementation=Auto, RTEEventRef=TMT_VehPwrMd_Per1, MappedToTaskRef=Task_2ms_9
        Task_Init_9_4_Timer0 (RunnableEntityMapping): PositionInTask=4, ActivationOffset=0, RteCyclicTriggerImplementation=Auto, RTEEventRef=VehPwrMd_Init1_InitEvent, MappedToTaskRef=Task_Init_9
      VehSpdLmt_Ap_VehSpdLmt_ECU_Composition: SoftwareComponentInstanceRef=VehSpdLmt, ImplementationRef=Ap_VehSpdLmt_Implementation
        Task_2ms_9_4_Timer0 (RunnableEntityMapping): PositionInTask=4, ActivationOffset=0, RteCyclicTriggerImplementation=Auto, RTEEventRef=TMT_VehSpdLmt_Per1, MappedToTaskRef=Task_2ms_9
      WdgM_WdgM_ECU_Composition: ServiceComponentPrototypeRef=WdgM, ImplementationRef=WdgM_Implementation
        Task_SchM_2ms_9_2_Timer0 (RunnableEntityMapping): PositionInTask=2, ActivationOffset=0, RteCyclicTriggerImplementation=Auto, RTEEventRef=TMT_MainFunction, MappedToTaskRef=Task_SchM_2ms_9
      ePWM2_Ap_ePWM2_ECU_Composition: SoftwareComponentInstanceRef=ePWM2, ImplementationRef=Ap_ePWM2_Implementation
        3 x RunnableEntityMapping, all with ActivationOffset=0, RteCyclicTriggerImplementation=Auto:
          Task_2ms_10_36_Timer0: PositionInTask=36, RTEEventRef=TMT_ePWM2_Per1, MappedToTaskRef=Task_2ms_10
          Task_Trns_10_10_TrigModeSwitch0: PositionInTask=10, RTEEventRef=MST_ePWM2_Trns1_0, MappedToTaskRef=Task_Trns_10
          Task_Trns_10_1_TrigModeSwitch0: PositionInTask=1, RTEEventRef=MST_ePWM2_Trns2_0, MappedToTaskRef=Task_Trns_10
      uDiag_Cd_uDiag_ECU_Composition: SoftwareComponentInstanceRef=uDiag, ImplementationRef=Cd_uDiag_Implementation
        7 x RunnableEntityMapping, all with ActivationOffset=0, RteCyclicTriggerImplementation=Auto:
          Task_10ms_10_5_Timer0: PositionInTask=5, RTEEventRef=TMT_uDiagECC_Per, MappedToTaskRef=Task_10ms_10
          Task_4ms_10_1_Timer0: PositionInTask=1, RTEEventRef=TMT_uDiagLossOfExec_Per3, MappedToTaskRef=Task_4ms_10
          Task_100ms_10_6_Timer0: PositionInTask=6, RTEEventRef=TMT_uDiagStaticRegs_Per, MappedToTaskRef=Task_100ms_10
          Task_2ms_10_43_Timer0: PositionInTask=43, RTEEventRef=TMT_uDiagLossOfExec_Per2, MappedToTaskRef=Task_2ms_10
          Task_Init_10_29_Timer0: PositionInTask=29, RTEEventRef=uDiagPeriphStartup_InitEvent, MappedToTaskRef=Task_Init_10
          Task_10ms_10_6_Timer0: PositionInTask=6, RTEEventRef=TMT_uDiagVIM_Per, MappedToTaskRef=Task_10ms_10
          Task_Init_10_4_Timer0: PositionInTask=4, RTEEventRef=uDiagResetHandler_InitEvent, MappedToTaskRef=Task_Init_10
    69 x ComponentTypeCalibration, all with CalibrationSupportEnabled=false:
      Ap_AbsHwPos: ComponentTypeRef=Ap_AbsHwPos
      Ap_ActivePull: ComponentTypeRef=Ap_ActivePull
      Ap_ApXcp: ComponentTypeRef=Ap_ApXcp
      Ap_Assist: ComponentTypeRef=Ap_Assist
      Ap_AssistFirewall: ComponentTypeRef=Ap_AssistFirewall
      Ap_AstLmt: ComponentTypeRef=Ap_AstLmt
      Ap_AvgFricLrn: ComponentTypeRef=Ap_AvgFricLrn
      Ap_BVDiag: ComponentTypeRef=Ap_BVDiag
      Ap_BatteryVoltage: ComponentTypeRef=Ap_BatteryVoltage
      Ap_ChkPtAp10: ComponentTypeRef=Ap_ChkPtAp10
      Ap_ChkPtAp8: ComponentTypeRef=Ap_ChkPtAp8
      Ap_ChkPtAp9: ComponentTypeRef=Ap_ChkPtAp9
      Ap_ComplErr: ComponentTypeRef=Ap_ComplErr
      Ap_CtrldDisShtdn: ComponentTypeRef=Ap_CtrldDisShtdn
      Ap_CurrCmd: ComponentTypeRef=Ap_CurrCmd
      Ap_CurrParamComp: ComponentTypeRef=Ap_CurrParamComp
      Ap_Damping: ComponentTypeRef=Ap_Damping
      Ap_DampingFirewall: ComponentTypeRef=Ap_DampingFirewall
      Ap_DemIf: ComponentTypeRef=Ap_DemIf
      Ap_DiagMgr10: ComponentTypeRef=Ap_DiagMgr10
      Ap_DiagMgr8: ComponentTypeRef=Ap_DiagMgr8
      Ap_DiagMgr9: ComponentTypeRef=Ap_DiagMgr9
      Ap_DiagSvc: ComponentTypeRef=Ap_DiagSvc
      Ap_DigPhsReasDiag: ComponentTypeRef=Ap_DigPhsReasDiag
      Ap_EOTActuatorMng: ComponentTypeRef=Ap_EOTActuatorMng
      Ap_ElePwr: ComponentTypeRef=Ap_ElePwr
      Ap_EtDmpFw: ComponentTypeRef=Ap_EtDmpFw
      Ap_FltInjection: ComponentTypeRef=Ap_FltInjection
      Ap_FrqDepDmpnInrtCmp: ComponentTypeRef=Ap_FrqDepDmpnInrtCmp
      Ap_Gsod: ComponentTypeRef=Ap_Gsod
      Ap_HaitecTrqCmd: ComponentTypeRef=Ap_HaitecTrqCmd
      Ap_HiLoadStall: ComponentTypeRef=Ap_HiLoadStall
      Ap_HighFreqAssist: ComponentTypeRef=Ap_HighFreqAssist
      Ap_HwPwUp: ComponentTypeRef=Ap_HwPwUp
      Ap_HystComp: ComponentTypeRef=Ap_HystComp
      Ap_LmtCod: ComponentTypeRef=Ap_LmtCod
      Ap_LrnEOT: ComponentTypeRef=Ap_LrnEOT
      Ap_MtrTempEst: ComponentTypeRef=Ap_MtrTempEst
      NtWrap: ComponentTypeRef=NtWrap
      Ap_PICurrCntrl: ComponentTypeRef=Ap_PICurrCntrl
      Ap_PeakCurrEst: ComponentTypeRef=Ap_PeakCurrEst
      Ap_Polarity: ComponentTypeRef=Ap_Polarity
      Ap_PwrLmtFuncCr: ComponentTypeRef=Ap_PwrLmtFuncCr
      Ap_QuadDet: ComponentTypeRef=Ap_QuadDet
      Ap_Return: ComponentTypeRef=Ap_Return
      Ap_ReturnFirewall: ComponentTypeRef=Ap_ReturnFirewall
      RteErrata10: ComponentTypeRef=RteErrata10
      RteErrata8: ComponentTypeRef=RteErrata8
      RteErrata9: ComponentTypeRef=RteErrata9
      Ap_SignlCondn: ComponentTypeRef=Ap_SignlCondn
      Ap_SrlComInput: ComponentTypeRef=Ap_SrlComInput
      Ap_SrlComOutput: ComponentTypeRef=Ap_SrlComOutput
      Ap_StOpCtrl: ComponentTypeRef=Ap_StOpCtrl
      Ap_StaMd: ComponentTypeRef=Ap_StaMd
      Ap_StaMd8: ComponentTypeRef=Ap_StaMd8
      Ap_StaMd9: ComponentTypeRef=Ap_StaMd9
      Ap_StabilityComp: ComponentTypeRef=Ap_StabilityComp
      Ap_StabilityComp2: ComponentTypeRef=Ap_StabilityComp2
      Ap_Sweep: ComponentTypeRef=Ap_Sweep
      Ap_Sweep2: ComponentTypeRef=Ap_Sweep2
      Ap_ThrmlDutyCycle: ComponentTypeRef=Ap_ThrmlDutyCycle
      Ap_TqRsDg: ComponentTypeRef=Ap_TqRsDg
      Ap_TrqCanc: ComponentTypeRef=Ap_TrqCanc
      Ap_TrqCmdScl: ComponentTypeRef=Ap_TrqCmdScl
      Ap_TuningSelAuth: ComponentTypeRef=Ap_TuningSelAuth
      Ap_VehDyn: ComponentTypeRef=Ap_VehDyn
      Ap_VehPwrMd: ComponentTypeRef=Ap_VehPwrMd
      Ap_VehSpdLmt: ComponentTypeRef=Ap_VehSpdLmt
      Ap_ePWM2: ComponentTypeRef=Ap_ePWM2
  module config ShtdnMech: implementation-config-variant=VARIANT-PRE-COMPILE  # Configuration of the Nexteer ShtdnMech module.
    ShtdnMechGeneral
    CommonPublishedInformation: ArMajorVersion=3, ArMinorVersion=2, ArPatchVersion=0, SwMajorVersion=0, SwMinorVersion=0, SwPatchVersion=0, ModuleId=0, VendorId=0
  module config SignlCondn: implementation-config-variant=VARIANT-PRE-COMPILE  # Configuration of the Nexteer SignlCondn module.
    SignlCondnGeneral
    CommonPublishedInformation: ArMajorVersion=3, ArMinorVersion=2, ArPatchVersion=0, SwMajorVersion=0, SwMinorVersion=0, SwPatchVersion=0, ModuleId=0, VendorId=0
  module config StabilityComp: implementation-config-variant=VARIANT-PRE-COMPILE  # Configuration of the Nexteer StabilityComp module.
    StabilityCompGeneral
    CommonPublishedInformation: ArMajorVersion=3, ArMinorVersion=2, ArPatchVersion=0, SwMajorVersion=0, SwMinorVersion=0, SwPatchVersion=0, ModuleId=0, VendorId=0
  module config StabilityComp2: implementation-config-variant=VARIANT-PRE-COMPILE  # Configuration of the Nexteer StabilityComp2 module.
    StabilityComp2General
    CommonPublishedInformation: ArMajorVersion=3, ArMinorVersion=2, ArPatchVersion=0, SwMajorVersion=0, SwMinorVersion=0, SwPatchVersion=0, ModuleId=0, VendorId=0
  module config StaMd: implementation-config-variant=VARIANT-PRE-COMPILE  # Configuration of the Nexteer States and Modes module.
    StaMdGeneral:
      TypeHDataSize = 100
      StaMdTODType = TOD_SteadyState
      StaMdNvMWriteAllAPI = NvMProxy_WriteAll
      StaMdNvMGetErrorStatusAPI = NvMProxy_GetErrorStatus
      StaMdTrnsDiagMgrShtDwnTaskActivation = Task_SchM_Trns_9
      GenerateExcludeOsAppRef = Ap_0
      StaMdCoreOsAppRef = Ap_10
      StaMdSComOsAppRef = Ap_9
      StaMdSysCovOsAppRef = Ap_8
    CommonPublishedInformation: ArMajorVersion=3, ArMinorVersion=2, ArPatchVersion=0, SwMajorVersion=0, SwMinorVersion=0, SwPatchVersion=0, ModuleId=0, VendorId=0
  module config StOpCtrl: implementation-config-variant=VARIANT-PRE-COMPILE  # Configuration of the Nexteer StOpCtrl module.
    StOpCtrlGeneral
    CommonPublishedInformation: ArMajorVersion=3, ArMinorVersion=2, ArPatchVersion=0, SwMajorVersion=0, SwMinorVersion=0, SwPatchVersion=0, ModuleId=0, VendorId=0
  module config ThrmlDutyCycle: implementation-config-variant=VARIANT-PRE-COMPILE  # Configuration of the Nexteer ThrmlDutyCycle module.
    ThrmlDutyCycleGeneral
    CommonPublishedInformation: ArMajorVersion=3, ArMinorVersion=2, ArPatchVersion=0, SwMajorVersion=0, SwMinorVersion=0, SwPatchVersion=0, ModuleId=0, VendorId=0
  module config TmprlMon: implementation-config-variant=VARIANT-PRE-COMPILE  # Configuration of the Nexteer TmprlMon module.
    TmprlMonGeneral
    CommonPublishedInformation: ArMajorVersion=3, ArMinorVersion=2, ArPatchVersion=0, SwMajorVersion=0, SwMinorVersion=0, SwPatchVersion=0, ModuleId=0, VendorId=0
  module config TmprlMon2: implementation-config-variant=VARIANT-PRE-COMPILE  # Configuration of the Nexteer TmprlMon2 module.
    TmprlMon2General
    CommonPublishedInformation: ArMajorVersion=3, ArMinorVersion=2, ArPatchVersion=0, SwMajorVersion=0, SwMinorVersion=0, SwPatchVersion=0, ModuleId=0, VendorId=0
  module config TqRsDg: implementation-config-variant=VARIANT-PRE-COMPILE  # Configuration of the Nexteer TqRsDg module.
    TqRsDgGeneral
    CommonPublishedInformation: ArMajorVersion=3, ArMinorVersion=2, ArPatchVersion=0, SwMajorVersion=0, SwMinorVersion=0, SwPatchVersion=0, ModuleId=0, VendorId=0
  module config TrqCanc: implementation-config-variant=VARIANT-PRE-COMPILE  # Configuration of the Nexteer TrqCanc module.
    TrqCancGeneral
    CommonPublishedInformation: ArMajorVersion=3, ArMinorVersion=2, ArPatchVersion=0, SwMajorVersion=0, SwMinorVersion=0, SwPatchVersion=0, ModuleId=0, VendorId=0
  module config TrqCmdScl: implementation-config-variant=VARIANT-PRE-COMPILE  # Configuration of the Nexteer TrqCmdScl module.
    TrqCmdSclGeneral
    CommonPublishedInformation: ArMajorVersion=3, ArMinorVersion=2, ArPatchVersion=0, SwMajorVersion=0, SwMinorVersion=0, SwPatchVersion=0, ModuleId=0, VendorId=0
  module config TuningSelAuth: implementation-config-variant=VARIANT-PRE-COMPILE  # Configuration of the Nexteer TuningSelAuth module.
    TuningSelAuthGeneral
    CommonPublishedInformation: ArMajorVersion=3, ArMinorVersion=2, ArPatchVersion=0, SwMajorVersion=0, SwMinorVersion=0, SwPatchVersion=0, ModuleId=0, VendorId=0
  module config uDiag: implementation-config-variant=VARIANT-PRE-COMPILE  # Configuration of the Microprocessor diagnostics module
    RuntimeRegCheck (uDiagRegChkConfigSet)
      GHVSRC (uDiagRegCheck): uDiagRegAddress=4294967112, uDiagRegValue=16842753
      FBPARERR (uDiagRegCheckLnk): uDiagRegAddress=4294966776, uDiagRegValueLnk=VIM_Fallback, uDiagRegUseSizeofInOffset=false, uDiagRegValueLnkOffset=0
      205 x uDiagRegCheck:
        RCLKSRC: uDiagRegAddress=4294967120, uDiagRegValue=9
        BMMCR1: uDiagRegAddress=4294967236, uDiagRegValue=10
        CLKCNTL: uDiagRegAddress=4294967248, uDiagRegValue=16843008
        LOGICPDPWRCTRL0: uDiagRegAddress=4294901760, uDiagRegValue=84216325
        MEMPDPWRCTRL0: uDiagRegAddress=4294901776, uDiagRegValue=84541440
        PDCLKDISREG: uDiagRegAddress=4294901792, uDiagRegValue=4
        GLOBALCTRL1: uDiagRegAddress=4294901920, uDiagRegValue=0
        PINMMR00: uDiagRegAddress=4294961936, uDiagRegValue=33685504
        PINMMR01: uDiagRegAddress=4294961940, uDiagRegValue=16843776
        PINMMR02: uDiagRegAddress=4294961944, uDiagRegValue=67174657
        PINMMR03: uDiagRegAddress=4294961948, uDiagRegValue=17039361
        PINMMR04: uDiagRegAddress=4294961952, uDiagRegValue=269484292
        PINMMR05: uDiagRegAddress=4294961956, uDiagRegValue=17302532
        PINMMR06: uDiagRegAddress=4294961960, uDiagRegValue=16843024
        PINMMR07: uDiagRegAddress=4294961964, uDiagRegValue=16843009
        PINMMR08: uDiagRegAddress=4294961968, uDiagRegValue=16843009
        PINMMR09: uDiagRegAddress=4294961972, uDiagRegValue=16843009
        PINMMR10: uDiagRegAddress=4294961976, uDiagRegValue=16843009
        PINMMR11: uDiagRegAddress=4294961980, uDiagRegValue=16843009
        PINMMR12: uDiagRegAddress=4294961984, uDiagRegValue=16843009
        PINMMR13: uDiagRegAddress=4294961988, uDiagRegValue=16843009
        PINMMR14: uDiagRegAddress=4294961992, uDiagRegValue=16843009
        PINMMR15: uDiagRegAddress=4294961996, uDiagRegValue=16843009
        PINMMR16: uDiagRegAddress=4294962000, uDiagRegValue=16843009
        PINMMR17: uDiagRegAddress=4294962004, uDiagRegValue=16843009
        PINMMR18: uDiagRegAddress=4294962008, uDiagRegValue=65537
        PINMMR19: uDiagRegAddress=4294962012, uDiagRegValue=16843009
        PINMMR20: uDiagRegAddress=4294962016, uDiagRegValue=16843009
        PINMMR21: uDiagRegAddress=4294962020, uDiagRegValue=16842753
        PINMMR22: uDiagRegAddress=4294962024, uDiagRegValue=16843009
        PINMMR23: uDiagRegAddress=4294962028, uDiagRegValue=1
        PINMMR24: uDiagRegAddress=4294962032, uDiagRegValue=0
        PINMMR25: uDiagRegAddress=4294962036, uDiagRegValue=0
        PINMMR26: uDiagRegAddress=4294962040, uDiagRegValue=16842752
        PINMMR27: uDiagRegAddress=4294962044, uDiagRegValue=16843009
        PINMMR28: uDiagRegAddress=4294962048, uDiagRegValue=16843009
        PINMMR29: uDiagRegAddress=4294962052, uDiagRegValue=257
        PINMMR30: uDiagRegAddress=4294962056, uDiagRegValue=514
        FRDCNTL: uDiagRegAddress=4294471680, uDiagRegValue=785
        FEDACTRL1: uDiagRegAddress=4294471688, uDiagRegValue=656906
        RAMCTRL_EVEN: uDiagRegAddress=4294965248, uDiagRegValue=327690
        RAMTHRESHOLD_EVEN: uDiagRegAddress=4294965252, uDiagRegValue=1
        RAMINTCTRL_EVEN: uDiagRegAddress=4294965260, uDiagRegValue=1
        RAMTEST_EVEN: uDiagRegAddress=4294965296, uDiagRegValue=5
        RAMCTRL_ODD: uDiagRegAddress=4294965504, uDiagRegValue=327690
        RAMTHRESHOLD_ODD: uDiagRegAddress=4294965508, uDiagRegValue=1
        RAMINTCTRL_ODD: uDiagRegAddress=4294965516, uDiagRegValue=1
        RAMTEST_ODD: uDiagRegAddress=4294965552, uDiagRegValue=5
        PACT: uDiagRegAddress=4294960512, uDiagRegValue=0
        STCGCR1: uDiagRegAddress=4294960644, uDiagRegValue=5
        CCMKEYR: uDiagRegAddress=4294964740, uDiagRegValue=0
        PLLCTL1: uDiagRegAddress=4294967152, uDiagRegValue=352000
        PLLCTL2: uDiagRegAddress=4294967156, uDiagRegValue=29184
        PLLCTL3: uDiagRegAddress=4294959360, uDiagRegValue=1610964736
        DCCGCTRL_DCC1: uDiagRegAddress=4294962176, uDiagRegValue=10
        DCCCNT0SEED_DCC1: uDiagRegAddress=4294962184, uDiagRegValue=9333
        DCCVALID0SEED_DCC1: uDiagRegAddress=4294962188, uDiagRegValue=39666
        DCCCNT1SEED_DCC1: uDiagRegAddress=4294962192, uDiagRegValue=9800
        DCCCNT1CLKSRC_DCC1: uDiagRegAddress=4294962212, uDiagRegValue=40963
        DCCCNT0CLKSRC_DCC1: uDiagRegAddress=4294962216, uDiagRegValue=0
        DCCGCTRL_DCC2: uDiagRegAddress=4294964224, uDiagRegValue=10
        DCCCNT0SEED_DCC2: uDiagRegAddress=4294964232, uDiagRegValue=19417
        DCCVALID0SEED_DCC2: uDiagRegAddress=4294964236, uDiagRegValue=1201
        DCCCNT1SEED_DCC2: uDiagRegAddress=4294964240, uDiagRegValue=80000
        DCCCNT1CLKSRC_DCC2: uDiagRegAddress=4294964260, uDiagRegValue=40968
        DCCCNT0CLKSRC_DCC2: uDiagRegAddress=4294964264, uDiagRegValue=0
        ESMEEPAPR1: uDiagRegAddress=4294964480, uDiagRegValue=0
        ESMIESR1: uDiagRegAddress=4294964488, uDiagRegValue=1411910606
        ESMILSR1: uDiagRegAddress=4294964496, uDiagRegValue=2048
        ESMLTCPR: uDiagRegAddress=4294964532, uDiagRegValue=16383
        ESMIEPSR4: uDiagRegAddress=4294964544, uDiagRegValue=0
        ESMIESR4: uDiagRegAddress=4294964552, uDiagRegValue=1073741860
        ESMILSR4: uDiagRegAddress=4294964560, uDiagRegValue=0
        RTIGCTRL: uDiagRegAddress=4294966272, uDiagRegValue=3
        RTITBCTRL: uDiagRegAddress=4294966276, uDiagRegValue=0
        RTISETINTENA: uDiagRegAddress=4294966400, uDiagRegValue=1
        RTIDWDCTRL: uDiagRegAddress=4294966416, uDiagRegValue=2844088794
        RTIDWDPRLD: uDiagRegAddress=4294966420, uDiagRegValue=57
        RTIWWDRXNCTRL: uDiagRegAddress=4294966436, uDiagRegValue=5
        RTIWWDSIZECTRL: uDiagRegAddress=4294966440, uDiagRegValue=5
        CRC_CTRL1: uDiagRegAddress=4261412872, uDiagRegValue=0
        PARCTL: uDiagRegAddress=4294966768, uDiagRegValue=10
        FIRQPR0_FIQ_IRQ: uDiagRegAddress=4294966800, uDiagRegValue=3
        FIRQPR1_FIQ_IRQ: uDiagRegAddress=4294966804, uDiagRegValue=0
        FIRQPR2_FIQ_IRQ: uDiagRegAddress=4294966808, uDiagRegValue=0
        CHANCTRL0: uDiagRegAddress=4294966912, uDiagRegValue=75779
        CHANCTRL23: uDiagRegAddress=4294967004, uDiagRegValue=50529027
        ADOPMODECR_ADC1: uDiagRegAddress=4294426628, uDiagRegValue=2148794369
        ADCLOCKCR_ADC1: uDiagRegAddress=4294426632, uDiagRegValue=4
        ADCALCR_ADC1: uDiagRegAddress=4294426636, uDiagRegValue=0
        ADEVMODECR_ADC1: uDiagRegAddress=4294426640, uDiagRegValue=65585
        ADG1MODECR_ADC1: uDiagRegAddress=4294426644, uDiagRegValue=65584
        ADG2MODECR_ADC1: uDiagRegAddress=4294426648, uDiagRegValue=65592
        ADEVSRC_ADC1: uDiagRegAddress=4294426652, uDiagRegValue=0
        ADG1SRC_ADC1: uDiagRegAddress=4294426656, uDiagRegValue=0
        ADG2SRC_ADC1: uDiagRegAddress=4294426660, uDiagRegValue=1
        ADEVINTENA_ADC1: uDiagRegAddress=4294426664, uDiagRegValue=0
        ADG1INTENA_ADC1: uDiagRegAddress=4294426668, uDiagRegValue=0
        ADG2INTENA_ADC1: uDiagRegAddress=4294426672, uDiagRegValue=0
        ADBNDCR_ADC1: uDiagRegAddress=4294426712, uDiagRegValue=1966110
        ADBNDEND_ADC1: uDiagRegAddress=4294426716, uDiagRegValue=2
        ADEVSAMP_ADC1: uDiagRegAddress=4294426720, uDiagRegValue=6
        ADG1SAMP_ADC1: uDiagRegAddress=4294426724, uDiagRegValue=6
        ADG2SAMP_ADC1: uDiagRegAddress=4294426728, uDiagRegValue=6
        ADEVSEL_ADC1: uDiagRegAddress=4294426744, uDiagRegValue=0
        ADG1SEL_ADC1: uDiagRegAddress=4294426748, uDiagRegValue=0
        ADG2SEL_ADC1: uDiagRegAddress=4294426752, uDiagRegValue=8481
        ADPARCR_ADC1: uDiagRegAddress=4294427008, uDiagRegValue=10
        ADOPMODECR_ADC2: uDiagRegAddress=4294427140, uDiagRegValue=2148794369
        ADCLOCKCR_ADC2: uDiagRegAddress=4294427144, uDiagRegValue=4
        ADCALCR_ADC2: uDiagRegAddress=4294427148, uDiagRegValue=0
        ADEVMODECR_ADC2: uDiagRegAddress=4294427152, uDiagRegValue=65584
        ADG1MODECR_ADC2: uDiagRegAddress=4294427156, uDiagRegValue=65592
        ADG2MODECR_ADC2: uDiagRegAddress=4294427160, uDiagRegValue=65584
        ADEVSRC_ADC2: uDiagRegAddress=4294427164, uDiagRegValue=0
        ADG1SRC_ADC2: uDiagRegAddress=4294427168, uDiagRegValue=3
        ADG2SRC_ADC2: uDiagRegAddress=4294427172, uDiagRegValue=0
        ADEVINTENA_ADC2: uDiagRegAddress=4294427176, uDiagRegValue=0
        ADG1INTENA_ADC2: uDiagRegAddress=4294427180, uDiagRegValue=0
        ADG2INTENA_ADC2: uDiagRegAddress=4294427184, uDiagRegValue=0
        ADBNDCR_ADC2: uDiagRegAddress=4294427224, uDiagRegValue=2
        ADBNDEND_ADC2: uDiagRegAddress=4294427228, uDiagRegValue=2
        ADEVSAMP_ADC2: uDiagRegAddress=4294427232, uDiagRegValue=6
        ADG1SAMP_ADC2: uDiagRegAddress=4294427236, uDiagRegValue=6
        ADG2SAMP_ADC2: uDiagRegAddress=4294427240, uDiagRegValue=6
        ADEVSEL_ADC2: uDiagRegAddress=4294427256, uDiagRegValue=0
        ADG1SEL_ADC2: uDiagRegAddress=4294427260, uDiagRegValue=8451
        ADG2SEL_ADC2: uDiagRegAddress=4294427264, uDiagRegValue=0
        ADPARCR_ADC2: uDiagRegAddress=4294427520, uDiagRegValue=10
        HETGCR_HET1: uDiagRegAddress=4294424576, uDiagRegValue=393217
        HETPFR_HET1: uDiagRegAddress=4294424580, uDiagRegValue=1792
        HETEXC1_HET1: uDiagRegAddress=4294424604, uDiagRegValue=0
        HETPRY_HET1: uDiagRegAddress=4294424612, uDiagRegValue=0
        HETAND_HET1: uDiagRegAddress=4294424620, uDiagRegValue=0
        HETHRSH_HET1: uDiagRegAddress=4294424628, uDiagRegValue=0
        HETXOR_HET1: uDiagRegAddress=4294424632, uDiagRegValue=0
        HETREQENS_HET1: uDiagRegAddress=4294424636, uDiagRegValue=22
        HETREQDS_HET1: uDiagRegAddress=4294424644, uDiagRegValue=16
        HETPCR_HET1: uDiagRegAddress=4294424692, uDiagRegValue=10
        HETPPR_HET1: uDiagRegAddress=4294424700, uDiagRegValue=0
        HETLBPSEL_HET1: uDiagRegAddress=4294424716, uDiagRegValue=0
        HETLBPDIR_HET1: uDiagRegAddress=4294424720, uDiagRegValue=327680
        HETPINDIS_HET1: uDiagRegAddress=4294424724, uDiagRegValue=0
        HETGCR_HET2: uDiagRegAddress=4294424832, uDiagRegValue=196609
        HETPFR_HET2: uDiagRegAddress=4294424836, uDiagRegValue=1024
        HETEXC1_HET2: uDiagRegAddress=4294424860, uDiagRegValue=0
        HETPRY_HET2: uDiagRegAddress=4294424868, uDiagRegValue=0
        HETAND_HET2: uDiagRegAddress=4294424876, uDiagRegValue=0
        HETHRSH_HET2: uDiagRegAddress=4294424884, uDiagRegValue=244
        HETXOR_HET2: uDiagRegAddress=4294424888, uDiagRegValue=0
        HETREQENS_HET2: uDiagRegAddress=4294424892, uDiagRegValue=0
        HETREQDS_HET2: uDiagRegAddress=4294424900, uDiagRegValue=0
        HETDIR_HET2: uDiagRegAddress=4294424908, uDiagRegValue=0
        HETPCR_HET2: uDiagRegAddress=4294424948, uDiagRegValue=10
        HETPPR_HET2: uDiagRegAddress=4294424956, uDiagRegValue=0
        HETLBPSEL_HET2: uDiagRegAddress=4294424972, uDiagRegValue=0
        HETLBPDIR_HET2: uDiagRegAddress=4294424976, uDiagRegValue=327680
        HETPINDIS_HET2: uDiagRegAddress=4294424980, uDiagRegValue=0
        HTU__GC_HTU1: uDiagRegAddress=4294419456, uDiagRegValue=65792
        HTU__MP1S_HTU1: uDiagRegAddress=4294419532, uDiagRegValue=0
        HTU__MP1E_HTU1: uDiagRegAddress=4294419536, uDiagRegValue=0
        HTU__GC_HTU2: uDiagRegAddress=4294419712, uDiagRegValue=0
        HTU_IHADDRCT_HTU1: uDiagRegAddress=4283301896, uDiagRegValue=0
        HTU_ITCOUNT_HTU1: uDiagRegAddress=4283301900, uDiagRegValue=0
        GIOGCR0: uDiagRegAddress=4294425600, uDiagRegValue=1
        GIOINTDET: uDiagRegAddress=4294425608, uDiagRegValue=0
        GIOPOL: uDiagRegAddress=4294425612, uDiagRegValue=0
        GIODIR_A_: uDiagRegAddress=4294425652, uDiagRegValue=0
        GIODIR_B_: uDiagRegAddress=4294425684, uDiagRegValue=0
        DMA_DMAMPCTRL: uDiagRegAddress=4294963632, uDiagRegValue=252250377
        DMA_DMAMPR0S: uDiagRegAddress=4294963640, uDiagRegValue=4278845440
        DMA_DMAMPR0E: uDiagRegAddress=4294963644, uDiagRegValue=4282859519
        DMA_DMAMPR1S: uDiagRegAddress=4294963648, uDiagRegValue=4244081664
        DMA_DMAMPR1E: uDiagRegAddress=4294963652, uDiagRegValue=4261413375
        DMA_DMAMPR3S: uDiagRegAddress=4294963664, uDiagRegValue=2097152
        DMA_DMAMPR3E: uDiagRegAddress=4294963668, uDiagRegValue=4294967295
        DMA_CP00_IDADDR: uDiagRegAddress=4294443012, uDiagRegValue=4261412968
        DMA_CP00_ITCOUNT: uDiagRegAddress=4294443016, uDiagRegValue=65537
        DMA_CP00_CHCTRL: uDiagRegAddress=4294443024, uDiagRegValue=61440
        DMA_CP01_IDADDR: uDiagRegAddress=4294443044, uDiagRegValue=4261412960
        DMA_CP01_CHCTRL: uDiagRegAddress=4294443056, uDiagRegValue=61704
        DMA_CP02_ISADDR: uDiagRegAddress=4294443072, uDiagRegValue=4278977026
        DMA_CP02_ITCOUNT: uDiagRegAddress=4294443080, uDiagRegValue=65539
        DMA_CP02_CHCTRL: uDiagRegAddress=4294443088, uDiagRegValue=20767
        DMA_CP02_EIOFF: uDiagRegAddress=4294443092, uDiagRegValue=131076
        DMA_CP03_ISADDR: uDiagRegAddress=4294443104, uDiagRegValue=4281991170
        DMA_CP03_ITCOUNT: uDiagRegAddress=4294443112, uDiagRegValue=65540
        DMA_CP03_CHCTRL: uDiagRegAddress=4294443120, uDiagRegValue=20767
        DMA_CP03_EIOFF: uDiagRegAddress=4294443124, uDiagRegValue=131076
        DMA_CP05_IDADDR: uDiagRegAddress=4294443172, uDiagRegValue=4282777832
        DMA_CP05_ITCOUNT: uDiagRegAddress=4294443176, uDiagRegValue=65537
        DMA_CP05_CHCTRL: uDiagRegAddress=4294443184, uDiagRegValue=499969
        DMA_CP06_IDADDR: uDiagRegAddress=4294443204, uDiagRegValue=4244081680
        DMA_CP06_ITCOUNT: uDiagRegAddress=4294443208, uDiagRegValue=262146
        DMA_CP06_CHCTRL: uDiagRegAddress=4294443216, uDiagRegValue=20767
        DMA_CP06_EIOFF: uDiagRegAddress=4294443220, uDiagRegValue=393218
        DMA_CP06_FIOFF: uDiagRegAddress=4294443224, uDiagRegValue=16777220
        DMA_CP09_ISADDR: uDiagRegAddress=4294443296, uDiagRegValue=4282253554
        DMA_CP09_ITCOUNT: uDiagRegAddress=4294443304, uDiagRegValue=65540
        DMA_CP09_CHCTRL: uDiagRegAddress=4294443312, uDiagRegValue=20767
        DMA_CP09_EIOFF: uDiagRegAddress=4294443316, uDiagRegValue=131076
        DMA_CP12_ISADDR: uDiagRegAddress=4294443392, uDiagRegValue=4278845954
        DMA_CP12_ITCOUNT: uDiagRegAddress=4294443400, uDiagRegValue=65539
        DMA_CP12_CHCTRL: uDiagRegAddress=4294443408, uDiagRegValue=20767
        DMA_CP12_EIOFF: uDiagRegAddress=4294443412, uDiagRegValue=131076
      12 x uDiagRegCheckLnk:
        DMA_CP02_IDADDR: uDiagRegAddress=4294443076, uDiagRegValueLnk=DMAData_G_str.FastSPI_Cnt_u16[0], uDiagRegUseSizeofInOffset=false, uDiagRegValueLnkOffset=0
        DMA_CP03_IDADDR: uDiagRegAddress=4294443108, uDiagRegValueLnk=DMAData_G_str.FastADC_Cnt_u16[0], uDiagRegUseSizeofInOffset=false, uDiagRegValueLnkOffset=0
        DMA_CP05_ISADDR: uDiagRegAddress=4294443168, uDiagRegValueLnk=DMAData_G_str.PWMPeriod_Cnt_u32, uDiagRegUseSizeofInOffset=false, uDiagRegValueLnkOffset=0
        DMA_CP06_ISADDR: uDiagRegAddress=4294443200, uDiagRegValueLnk=DMAData_G_str.PWMCmp_Cnt_u16[0][0], uDiagRegUseSizeofInOffset=false, uDiagRegValueLnkOffset=0
        DMA_CP09_IDADDR: uDiagRegAddress=4294443300, uDiagRegValueLnk=DMAData_G_str.SlowADC_Cnt_u16[0], uDiagRegUseSizeofInOffset=false, uDiagRegValueLnkOffset=0
        DMA_CP12_IDADDR: uDiagRegAddress=4294443396, uDiagRegValueLnk=DMAData_G_str.SlowSPI_Cnt_u16[0], uDiagRegUseSizeofInOffset=false, uDiagRegValueLnkOffset=0
        DMA_DMAMPR2S: uDiagRegAddress=4294963656, uDiagRegValueLnk=DMAData_G_str, uDiagRegUseSizeofInOffset=false, uDiagRegValueLnkOffset=0
        DMA_DMAMPR2E: uDiagRegAddress=4294963660, uDiagRegValueLnk=DMAData_G_str, uDiagRegUseSizeofInOffset=true, uDiagRegValueLnkOffset=-1
        HTU__MP0S_HTU1: uDiagRegAddress=4294419572, uDiagRegValueLnk=Nhet_HtuDataTrq_Cnt_G_str, uDiagRegUseSizeofInOffset=false, uDiagRegValueLnkOffset=0
        HTU__MP0E_HTU1: uDiagRegAddress=4294419576, uDiagRegValueLnk=Nhet_HtuDataTrq_Cnt_G_str, uDiagRegUseSizeofInOffset=false, uDiagRegValueLnkOffset=60
        HTU_IFADDRA_HTU1: uDiagRegAddress=4283301904, uDiagRegValueLnk=Nhet_HtuDataTrq_Cnt_G_str.HtuDataTrq1_Cnt_u32[0], uDiagRegUseSizeofInOffset=false, uDiagRegValueLnkOffset=0
        HTU_IFADDRB_HTU1: uDiagRegAddress=4283301920, uDiagRegValueLnk=Nhet_HtuDataTrq_Cnt_G_str.HtuDataTrq2_Cnt_u32[0], uDiagRegUseSizeofInOffset=false, uDiagRegValueLnkOffset=0
    CommonPublishedInformation: ArMajorVersion=1, ArMinorVersion=2, ArPatchVersion=0, SwMajorVersion=1, SwMinorVersion=0, SwPatchVersion=0, ModuleId=104, VendorId=0
    uDiagGeneral:
      uDiagVCLK_kHz = 80000
      uDiagEnableFPUDiag = STD_OFF
      uDiagGladiatorCompatible = STD_OFF
      uDiagVIMPerTrusted = STD_OFF
      uDiagECCPerTrusted = STD_OFF
      uDiagVimTableName = osaIRQTable
      WdgMVersion = TTTech_v2.0.3
      uDiagIncludes = Nhet.h
      uDiagIncludes = Usr_RegCkDefs.h
      uDiagIncludes = Dma.h
  module config VehPwrMd: implementation-config-variant=VARIANT-PRE-COMPILE  # Configuration of the Nexteer VehPwrMd module.
    VehPwrMdGeneral
    CommonPublishedInformation: ArMajorVersion=3, ArMinorVersion=2, ArPatchVersion=0, SwMajorVersion=0, SwMinorVersion=0, SwPatchVersion=0, ModuleId=0, VendorId=0
  module config VehSpdLmt: implementation-config-variant=VARIANT-PRE-COMPILE  # Configuration of the Nexteer VehSpdLmt module.
    VehSpdLmtGeneral
    CommonPublishedInformation: ArMajorVersion=3, ArMinorVersion=2, ArPatchVersion=0, SwMajorVersion=0, SwMinorVersion=0, SwPatchVersion=0, ModuleId=0, VendorId=0
  module config Wdg_internal_TMS570LS3x: definition=Wdg, implementation-config-variant=VARIANT-PRE-COMPILE, module-description=Wdg_Impl  # Configuration of the Wdg (Watchdog driver) module. This is the TMS570LS3x internal watchdog driver.
    WdgGeneral:
      WdgDevErrorDetect = false
      WdgDemReport = false
      WdgDisableAllowed = false
      WdgVersionInfoApi = false
      WdgInternalTickCounter = true
      WdgUseOsSuspendInterrupt = true
      WdgInitialTimeout = 0.006
      WdgGlobalMemoryAppTaskRef = Ap_0
    WdgModeConfig (WdgSettingsConfig): WdgDefaultMode=WDGIF_SLOW_MODE
      WdgWindowStart: Value=0
      WdgRtiKhz: Value=80000
  module config WdgIf: implementation-config-variant=VARIANT-PRE-COMPILE, module-description=WdgIf_Impl  # Configuration of the WdgIf (Watchdog Interface) module.
    Wdg_internal_TMS570LS3x (WdgIfDevice): WdgIfDeviceIndex=0, WdgIfDriverRef=WdgGeneral
    WdgIfGeneral: WdgIfDevErrorDetect=false, WdgIfDemReport=false, WdgIfVersionInfoApi=false, WdgIfInternalTickCounterRef=Wdg_internal_TMS570LS3x
  module config WdgM: implementation-config-variant=VARIANT-PRE-COMPILE, module-description=WdgM_Impl  # Configuration of the WdgM (Watchdog Manager) module.
    WdgM_Runtime (WdgMConfigSet): WdgMInitialMode=WdgMMode
      WdgMMode: WdgMExpiredSupervisionCycleTol=0, WdgMModeId=0, WdgMTicksPerSecond=1000000, WdgMSupervisionCycle=0.004, WdgMInitialTriggerModeId=0
        SE_100ms_Alive0 (WdgMAliveSupervision):
          WdgMExpectedAliveIndications = 1
          WdgMMaxMargin = 0
          WdgMMinMargin = 0
          WdgMSupervisionReferenceCycle = 25
          WdgMAliveSupervisionCheckpointRef = ChkPtAp10_100msStart_CP
        WdgMProgramFlowSupervision: WdgMGlobalCheckpointFinalRef=GlbFinal_CP0, WdgMGlobalCheckpointInitialRef=ChkPtAp10_2msStart_CP
          6 x WdgMGlobalTransition:
            GT_100ms_10_8: WdgMGlobalTransitionDestRef=ChkPtAp8_100msStart_CP, WdgMGlobalTransitionSourceRef=ChkPtAp10_100msEnd_CP
            GT_10ms_10_9: WdgMGlobalTransitionDestRef=ChkPtAp9_10msStart_CP, WdgMGlobalTransitionSourceRef=ChkPtAp10_10msEnd_CP
            GT_2ms_10_8: WdgMGlobalTransitionDestRef=ChkPtAp8_2msStart_CP, WdgMGlobalTransitionSourceRef=ChkPtAp10_2msEnd_CP
            GT_2ms_8_9: WdgMGlobalTransitionDestRef=ChkPtAp9_2msStart_CP, WdgMGlobalTransitionSourceRef=ChkPtAp8_2msEnd_CP
            GT_100ms_8_9: WdgMGlobalTransitionDestRef=ChkPtAp9_100msStart_CP, WdgMGlobalTransitionSourceRef=ChkPtAp8_100msEnd_CP
            GT_4ms_10_9: WdgMGlobalTransitionDestRef=ChkPtAp9_4msStart_CP, WdgMGlobalTransitionSourceRef=ChkPtAp10_4msEnd_CP
        WdgMTrigger: WdgMWatchdogMode=WDGIF_SLOW_MODE, WdgMTriggerConditionValue=6, WdgMTriggerWindowStart=2, WdgMTriggerModeId=0, WdgMTriggerWatchdogRef=WdgMWatchdog
        SE_100ms_10_Status (WdgMLocalStatusParams):
          WdgMFailedSupervisionRefCycleTol = 0
          WdgMSupervisedEntityInitialMode = WDGM_LOCAL_STATUS_OK
          WdgMFailedDeadlineRefCycleTol = 0
          WdgMDeadlineReferenceCycle = 0
          WdgMFailedProgramFlowRefCycleTol = 0
          WdgMProgramFlowReferenceCycle = 0
          WdgMLocalStatusSupervisedEntityRef = SE_100ms_10
        7 x WdgMAliveSupervision, all with WdgMMaxMargin=0, WdgMMinMargin=0:
          SE_100ms_Alive1: WdgMExpectedAliveIndications=1, WdgMSupervisionReferenceCycle=25, WdgMAliveSupervisionCheckpointRef=ChkPtAp9_100msEnd_CP
          SE_10ms_Alive0: WdgMExpectedAliveIndications=2, WdgMSupervisionReferenceCycle=5, WdgMAliveSupervisionCheckpointRef=ChkPtAp10_10msStart_CP
          SE_10ms_Alive1: WdgMExpectedAliveIndications=2, WdgMSupervisionReferenceCycle=5, WdgMAliveSupervisionCheckpointRef=ChkPtAp9_10msEnd_CP
          SE_4ms_Alive0: WdgMExpectedAliveIndications=1, WdgMSupervisionReferenceCycle=1, WdgMAliveSupervisionCheckpointRef=ChkPtAp10_4msStart_CP
          SE_2ms_Alive0: WdgMExpectedAliveIndications=2, WdgMSupervisionReferenceCycle=1, WdgMAliveSupervisionCheckpointRef=ChkPtAp10_2msStart_CP
          SE_2ms_Alive1: WdgMExpectedAliveIndications=2, WdgMSupervisionReferenceCycle=1, WdgMAliveSupervisionCheckpointRef=ChkPtAp9_2msEnd_CP
          SE_4ms_Alive1: WdgMExpectedAliveIndications=1, WdgMSupervisionReferenceCycle=1, WdgMAliveSupervisionCheckpointRef=ChkPtAp9_4msEnd_CP
        9 x WdgMLocalStatusParams, all with WdgMFailedSupervisionRefCycleTol=0, WdgMSupervisedEntityInitialMode=WDGM_LOCAL_STATUS_OK, WdgMFailedDeadlineRefCycleTol=0, WdgMDeadlineReferenceCycle=0, WdgMFailedProgramFlowRefCycleTol=0, WdgMProgramFlowReferenceCycle=0:
          SE_100ms_9_Status: WdgMLocalStatusSupervisedEntityRef=SE_100ms_9
          SE_10ms_10_Status: WdgMLocalStatusSupervisedEntityRef=SE_10ms_10
          SE_10ms_9_Status: WdgMLocalStatusSupervisedEntityRef=SE_10ms_9
          SE_4ms_10_Status: WdgMLocalStatusSupervisedEntityRef=SE_4ms_10
          SE_2ms_10_Status: WdgMLocalStatusSupervisedEntityRef=SE_2ms_10
          SE_2ms_8_Status: WdgMLocalStatusSupervisedEntityRef=SE_2ms_8
          SE_2ms_9_Status: WdgMLocalStatusSupervisedEntityRef=SE_2ms_9
          SE_100ms_8_Status: WdgMLocalStatusSupervisedEntityRef=SE_100ms_8
          SE_4ms_9_Status: WdgMLocalStatusSupervisedEntityRef=SE_4ms_9
    WdgMGeneral:
      WdgMDevErrorDetect = false
      WdgMDemReport = false
      WdgMImmediateReset = true
      WdgMOffModeEnabled = false
      WdgMVersionInfoApi = false
      WdgMDefensiveBehavior = true
      WdgMUseRte = true
      WdgMDemSupervisionReport = false
      WdgMFirstCycleAliveCounterReset = true
      WdgMUseOsSuspendInterrupt = true
      WdgMTimebaseSource = WDGM_INTERNAL_HARDWARE_TICK
      WdgMSecondResetPath = false
      WdgMTickOverrunCorrection = true
      WdgMEntityDeactivationEnabled = false
      WdgMStateChangeNotification = false
      WdgMGlobalMemoryAppTaskRef = Ap_0
      SE_100ms_10 (WdgMSupervisedEntity):
        WdgMSupervisedEntityId = 0
        WdgMEnableEntityDeactivation = false
        WdgMSupportedAutosarAPI = API_4_0
        WdgMLocalCheckpointFinalRef = ChkPtAp10_100msEnd_CP
        WdgMLocalCheckpointInitialRef = ChkPtAp10_100msStart_CP
        WdgMAppTaskRef = Ap_10
        ChkPtAp10_100msStart_CP (WdgMCheckpoint): WdgMCheckpointId=0
        LT_100ms_10 (WdgMLocalTransition): WdgMLocalTransitionDestRef=ChkPtAp10_100msEnd_CP, WdgMLocalTransitionSourceRef=ChkPtAp10_100msStart_CP
        ChkPtAp10_100msEnd_CP (WdgMCheckpoint): WdgMCheckpointId=1
      WdgMWatchdog: WdgMWatchdogName=Watchdog, WdgIfDeviceRef=Wdg_internal_TMS570LS3x
      WdgMCallerIds: WdgMCallerId=0
      9 x WdgMSupervisedEntity, all with WdgMEnableEntityDeactivation=false, WdgMSupportedAutosarAPI=API_4_0:
        SE_100ms_8: WdgMSupervisedEntityId=1, WdgMLocalCheckpointFinalRef=ChkPtAp8_100msEnd_CP, WdgMLocalCheckpointInitialRef=ChkPtAp8_100msStart_CP, WdgMAppTaskRef=Ap_8
          ChkPtAp8_100msStart_CP (WdgMCheckpoint): WdgMCheckpointId=0
          LT_100ms_8 (WdgMLocalTransition): WdgMLocalTransitionDestRef=ChkPtAp8_100msEnd_CP, WdgMLocalTransitionSourceRef=ChkPtAp8_100msStart_CP
          ChkPtAp8_100msEnd_CP (WdgMCheckpoint): WdgMCheckpointId=1
        SE_100ms_9: WdgMSupervisedEntityId=2, WdgMLocalCheckpointFinalRef=ChkPtAp9_100msEnd_CP, WdgMLocalCheckpointInitialRef=ChkPtAp9_100msStart_CP, WdgMAppTaskRef=Ap_9
          ChkPtAp9_100msStart_CP (WdgMCheckpoint): WdgMCheckpointId=0
          LT_100ms_9 (WdgMLocalTransition): WdgMLocalTransitionDestRef=ChkPtAp9_100msEnd_CP, WdgMLocalTransitionSourceRef=ChkPtAp9_100msStart_CP
          ChkPtAp9_100msEnd_CP (WdgMCheckpoint): WdgMCheckpointId=1
        SE_10ms_10: WdgMSupervisedEntityId=3, WdgMLocalCheckpointFinalRef=ChkPtAp10_10msEnd_CP, WdgMLocalCheckpointInitialRef=ChkPtAp10_10msStart_CP, WdgMAppTaskRef=Ap_10
          ChkPtAp10_10msStart_CP (WdgMCheckpoint): WdgMCheckpointId=0
          LT_10ms_10 (WdgMLocalTransition): WdgMLocalTransitionDestRef=ChkPtAp10_10msEnd_CP, WdgMLocalTransitionSourceRef=ChkPtAp10_10msStart_CP
          ChkPtAp10_10msEnd_CP (WdgMCheckpoint): WdgMCheckpointId=1
        SE_10ms_9: WdgMSupervisedEntityId=4, WdgMLocalCheckpointFinalRef=ChkPtAp9_10msEnd_CP, WdgMLocalCheckpointInitialRef=ChkPtAp9_10msStart_CP, WdgMAppTaskRef=Ap_9
          ChkPtAp9_10msStart_CP (WdgMCheckpoint): WdgMCheckpointId=0
          LT_10ms_9 (WdgMLocalTransition): WdgMLocalTransitionDestRef=ChkPtAp9_10msEnd_CP, WdgMLocalTransitionSourceRef=ChkPtAp9_10msStart_CP
          ChkPtAp9_10msEnd_CP (WdgMCheckpoint): WdgMCheckpointId=1
        SE_4ms_10: WdgMSupervisedEntityId=5, WdgMLocalCheckpointFinalRef=ChkPtAp10_4msEnd_CP, WdgMLocalCheckpointInitialRef=ChkPtAp10_4msStart_CP, WdgMAppTaskRef=Ap_10
          ChkPtAp10_4msStart_CP (WdgMCheckpoint): WdgMCheckpointId=0
          LT_4ms_10 (WdgMLocalTransition): WdgMLocalTransitionDestRef=ChkPtAp10_4msEnd_CP, WdgMLocalTransitionSourceRef=ChkPtAp10_4msStart_CP
          ChkPtAp10_4msEnd_CP (WdgMCheckpoint): WdgMCheckpointId=1
        SE_4ms_9: WdgMSupervisedEntityId=6, WdgMLocalCheckpointFinalRef=ChkPtAp9_4msEnd_CP, WdgMLocalCheckpointInitialRef=ChkPtAp9_4msStart_CP, WdgMAppTaskRef=Ap_9
          ChkPtAp9_4msStart_CP (WdgMCheckpoint): WdgMCheckpointId=0
          LT_4ms_9 (WdgMLocalTransition): WdgMLocalTransitionDestRef=ChkPtAp9_4msEnd_CP, WdgMLocalTransitionSourceRef=ChkPtAp9_4msStart_CP
          ChkPtAp9_4msEnd_CP (WdgMCheckpoint): WdgMCheckpointId=1
        SE_2ms_10: WdgMSupervisedEntityId=7, WdgMLocalCheckpointFinalRef=ChkPtAp10_2msEnd_CP, WdgMLocalCheckpointInitialRef=ChkPtAp10_2msStart_CP, WdgMAppTaskRef=Ap_10
          ChkPtAp10_2msStart_CP (WdgMCheckpoint): WdgMCheckpointId=0
          LT_2ms_10 (WdgMLocalTransition): WdgMLocalTransitionDestRef=ChkPtAp10_2msEnd_CP, WdgMLocalTransitionSourceRef=ChkPtAp10_2msStart_CP
          ChkPtAp10_2msEnd_CP (WdgMCheckpoint): WdgMCheckpointId=1
          GlbFinal_CP0 (WdgMCheckpoint): WdgMCheckpointId=2
        SE_2ms_8: WdgMSupervisedEntityId=8, WdgMLocalCheckpointFinalRef=ChkPtAp8_2msEnd_CP, WdgMLocalCheckpointInitialRef=ChkPtAp8_2msStart_CP, WdgMAppTaskRef=Ap_8
          ChkPtAp8_2msStart_CP (WdgMCheckpoint): WdgMCheckpointId=0
          LT_2ms_8 (WdgMLocalTransition): WdgMLocalTransitionDestRef=ChkPtAp8_2msEnd_CP, WdgMLocalTransitionSourceRef=ChkPtAp8_2msStart_CP
          ChkPtAp8_2msEnd_CP (WdgMCheckpoint): WdgMCheckpointId=1
        SE_2ms_9: WdgMSupervisedEntityId=9, WdgMLocalCheckpointFinalRef=ChkPtAp9_2msEnd_CP, WdgMLocalCheckpointInitialRef=ChkPtAp9_2msStart_CP, WdgMAppTaskRef=Ap_9
          ChkPtAp9_2msStart_CP (WdgMCheckpoint): WdgMCheckpointId=0
          LT_2ms_9 (WdgMLocalTransition): WdgMLocalTransitionDestRef=ChkPtAp9_2msEnd_CP, WdgMLocalTransitionSourceRef=ChkPtAp9_2msStart_CP
          ChkPtAp9_2msEnd_CP (WdgMCheckpoint): WdgMCheckpointId=1
  module config EcuM: implementation-config-variant=VARIANT-PRE-COMPILE, module-description=EcuM_Impl  # Configuration of the EcuM (ECU State Manager) module.
    EcuMConfiguration:
      EcuMConfigConsistencyHash = 0
      EcuMNvramReadallTimeout = 0
      EcuMNvramWriteallTimeout = 0
      EcuMRunMinimumDuration = 0.1
      EcuMSleepActivityPeriod = 0
      EcuMComStackTypesIncludeFile = ComStack_Types.h
      EcuMDefaultAppMode = OSDEFAULTAPPMODE
      EcuMModuleConfigurationRef = McuModuleConfiguration
      EcuMModuleConfigurationRef = Gpt_Runtime
      EcuMModuleConfigurationRef = Port_Runtime
      EcuMModuleConfigurationRef = CanConfigSet
      EcuMModuleConfigurationRef = CanIfInitConfiguration
      EcuMModuleConfigurationRef = ComConfig
      EcuMModuleConfigurationRef = ComMConfig
      EcuMModuleConfigurationRef = PduRGlobalConfig
      EcuMModuleConfigurationRef = CanStateManagerConfiguration
      EcuMDefaultShutdownTarget: EcuMDefaultState=EcuMStateOff
      EcuMDriverInitListZero
      EcuMDriverInitListOne
        Code1 (EcuMDriverInitItem): EcuMModuleID=Code, EcuMModuleService=(unset), EcuMAdditionalInitCode=EcuStartup_Init1();
      EcuMDriverInitListTwo
        Code1 (EcuMDriverInitItem): EcuMModuleID=Code, EcuMModuleService=(unset), EcuMAdditionalInitCode=EcuStartup_Init2();
      EcuMDriverInitListThree
        EcuMDriverInitItem: EcuMModuleID=Code, EcuMModuleService=(unset), EcuMAdditionalInitCode=/* Inserted to fix build error */
      EcuMDriverRestartList
        EcuMDriverInitItem: EcuMModuleID=Code, EcuMModuleService=(unset), EcuMAdditionalInitCode=/* Inserted to fix build error */
      InitialEcuMSleepModeEcuMSleepMode (EcuMSleepMode):
        EcuMSleepModeSuspend = false
        EcuMSleepModeId = 0
        EcuMSleepModeName = EcuMSleepMode
        EcuMMcuMode = (unset)
        EcuMWakeupSourceMask = ECUM_WKSOURCE_RESET
        EcuMWakeupSourceMask = ECUM_WKSOURCE_POWER
        EcuMWakeupSourceMask = ECUM_WKSOURCE_INTERNAL_RESET
        EcuMWakeupSourceMask = ECUM_WKSOURCE_INTERNAL_WDG
        EcuMWakeupSourceMask = ECUM_WKSOURCE_EXTERNAL_WDG
        EcuMSleepModeMcuModeRef = McuModeConf
      EcuMTTII: EcuMDivisor=1
      EcuMUsrCfg_EPS (EcuMUserConfig): EcuMUser=1
      ECUM_WKSOURCE_POWER (EcuMWakeupSource): EcuMResetReason=6, EcuMValidationTimeout=0, EcuMWakeupSourceId=1, EcuMWakeupSourcePolling=false
      EcuMWdgM: EcuMWdgMPostRunModeRef=Mode_0, EcuMWdgMRunModeRef=Mode_0, EcuMWdgMShutdownModeRef=Mode_0, EcuMWdgMWakeupModeRef=Mode_0
      8 x EcuMWakeupSource, all with EcuMValidationTimeout=0, EcuMWakeupSourcePolling=false:
        ECUM_WKSOURCE_RESET: EcuMResetReason=-1, EcuMWakeupSourceId=2
        ECUM_WKSOURCE_INTERNAL_RESET: EcuMResetReason=3, EcuMWakeupSourceId=4
        ECUM_WKSOURCE_INTERNAL_WDG: EcuMResetReason=4, EcuMWakeupSourceId=8
        ECUM_WKSOURCE_EXTERNAL_WDG: EcuMResetReason=-1, EcuMWakeupSourceId=16
        ECUM_WKSOURCE_SOFTWARE_RESET: EcuMResetReason=2, EcuMWakeupSourceId=32
        ECUM_WKSOURCE_OSCI_OR_PLLSLIP_RESET: EcuMResetReason=5, EcuMWakeupSourceId=64
        ECUM_WKSOURCE_EXTERNAL_RESET: EcuMResetReason=1, EcuMWakeupSourceId=128
        ECUM_WKSOURCE_RESET_UNDEFINED: EcuMResetReason=7, EcuMWakeupSourceId=256
    EcuMGeneral:
      EcuMMainFunctionPeriod = 0.01
      EcuMIncludeDem = true
      EcuMIncludeDet = true
      EcuMIncludeNvramMgr = true
      EcuMIncludeWdgM = false
      EcuMIncludeComM = true
      EcuMIncludeRte = true
      EcuMIncludeSchM = false
      EcuMTTIIEnabled = false
      EcuMVersionInfoApi = false
      EcuMDevErrorDetect = true
      EcuMCheckParameter = true
      EcuMCheckPointerParameter = true
      EcuMCheckConfigType = true
      EcuMCheckUnInit = true
      EcuMCheckStateParameter = true
      EcuMCheckWkSourceParameter = true
      EcuMCheckBootTargetParameter = true
      EcuMCheckSleepModeParameter = true
      EcuMCheckUserParameter = true
      EcuMEnableProdErrorReporting = false
      EcuMDetErrorhookFunction = Det_ReportError
      EcuMDemSetError = Dem_ReportErrorStatus
      EcuMMcuIncludeFile = Mcu.h
      EcuMWdgMIncludeFile = WdgM.h
      EcuMComMIncludeFile = ComM.h
      EcuMSchMIncludeFile = SchM.h
      EcuMComMCallbackFile = ComM_EcuM.h
      EcuMRteIncludeFile = Rte_Main.h
      EcuMNvmIncludeFile = Nvm.h
      EcuMDetIncludeFile = Det.h
      EcuMDemIncludeFile = Dem.h
      EcuMOsIncludeFile = Os.h
      EcuMProdErrorDetectIncludeFile = Dem.h
      EcuMDevErrorDetectIncludeFile = Det.h
      EcuMAdditionalIncludes = EcuStartup.h
      EcuMNvmTypesFile = Nvm.h
      EcuMNvmCancelWriteAllTimeout = 60
      EcuMIrqHandling = InterruptFunctionSet
      EcuMApiSwitches: EcuMKillAllRUNRequestApi=true, EcuMGetValidatedWakeupEventsApi=true, EcuMGetExpiredWakeupEventsApi=true, EcuMGetStatusOfWakeupSourceApi=true
      EcuMCalloutSwitches:
        EcuMOnRTEStartupCallout = true
        EcuMOnEnterRunCallout = true
        EcuMOnExitRunCallout = true
        EcuMOnExitPostRunCallout = true
        EcuMOnPrepShutdownCallout = true
        EcuMOnGoSleepCallout = true
        EcuMOnGoOffOneCallout = true
        EcuMOnGoOffTwoCallout = true
        EcuMOnWakeupReactionCallout = true
        EcuMGeneratorCompatibilityError = false
      EcuMServicePortConfig:
        EcuMGenStateRequestPort = true
        EcuMGenBootTargetPort = false
        EcuMGenApplicationModePort = false
        EcuMGenShutdownTargetPort = false
        EcuMGenModeSwitchPort = false
        EcuMModeSwitchCbkName = (unset)
        EcuMModeSwitchRteAck = true
        EcuMServiceComponentName = EcuM
    VectorCommonData: BswmdVersion=4.08.00
  module config Dem: implementation-config-variant=VARIANT-LINK-TIME, module-description=Dem_Impl  # Configuration of the Dem (Diagnostic Event Manager) module.
    DemConfigSet: DemActiveDsdServiceTableRef=CommonDiagnostics
      DtcClass0 (DemDTCClass): DemDTC=0, DemDTCKind=DEM_DTC_KIND_ALL_DTCS, DemDTCSeverity=DEM_DTC_SEV_NO_SEVERITY, DemDTCFunctionalUnit=0, DemDTCSupportWarningIndicator=false
      PDUR_E_PDU_INSTANCE_LOST (DemEventParameter):
        DemEventID = 16
        DemInitMonitorName = (unset)
        DemEventKind = DEM_EVENT_KIND_BSW
        DemImportedEvent = false
        DemExtendedDataRef = (unset)
        DemDTCClassRef = DtcClass1
        DemEventClass:
          DemEventPriority = 0
          DemFFPrestorageSupported = false
          DemHealingAllowed = false
          DemHealingCycleCounter = 1
          DemHealingCycleRef = (unset)
          DemOperationCycleRef = DEM_IGNITION
          DemPredebounceAlgorithmClass
            DemPreDebounceCounterBased: DemCountInStepSize=1, DemCountOutStepSize=1, DemJumpDown=false, DemJumpUp=true, DemPreDebounceName=DEM_PRE_DEBOUNCE_COUNTER_BASED
      4 x DemGroupOfDTC:
        DEM_DTC_GROUP_ALL_DTCS: DemGroupDTCs=(unset)
        DEM_DTC_GROUP_CHASSIS_DTCS: DemGroupDTCs=4194304
        DEM_DTC_GROUP_BODY_DTCS: DemGroupDTCs=8388608
        DEM_DTC_GROUP_NETWORK_COM_DTCS: DemGroupDTCs=12582912
      43 x DemDTCClass, all with DemDTCKind=DEM_DTC_KIND_ALL_DTCS, DemDTCSeverity=DEM_DTC_SEV_NO_SEVERITY, DemDTCFunctionalUnit=0:
        DtcClass{1..29}: DemDTC=0, DemDTCSupportWarningIndicator=false
        DtcClass30: DemDTC=5263616, DemDTCSupportWarningIndicator=true
        DtcClass31: DemDTC=5263872, DemDTCSupportWarningIndicator=true
        DtcClass32: DemDTC=5264150, DemDTCSupportWarningIndicator=false
        DtcClass33: DemDTC=5264151, DemDTCSupportWarningIndicator=false
        DtcClass34: DemDTC=5264384, DemDTCSupportWarningIndicator=true
        DtcClass35: DemDTC=5264640, DemDTCSupportWarningIndicator=true
        DtcClass36: DemDTC=5264896, DemDTCSupportWarningIndicator=true
        DtcClass37: DemDTC=5265152, DemDTCSupportWarningIndicator=true
        DtcClass38: DemDTC=5265408, DemDTCSupportWarningIndicator=true
        DtcClass39: DemDTC=5265664, DemDTCSupportWarningIndicator=true
        DtcClass40: DemDTC=13632256, DemDTCSupportWarningIndicator=true
        DtcClass41: DemDTC=13702912, DemDTCSupportWarningIndicator=true
        DtcClass42: DemDTC=13705472, DemDTCSupportWarningIndicator=true
        DtcClass43: DemDTC=13713408, DemDTCSupportWarningIndicator=true
      43 x DemEventParameter, all with DemInitMonitorName=(unset), DemImportedEvent=false, DemExtendedDataRef=(unset):
        PDUR_E_INIT_FAILED: DemEventID=17, DemEventKind=DEM_EVENT_KIND_BSW, DemDTCClassRef=DtcClass2
          DemEventClass:
            DemEventPriority = 0
            DemFFPrestorageSupported = false
            DemHealingAllowed = false
            DemHealingCycleCounter = 1
            DemHealingCycleRef = (unset)
            DemOperationCycleRef = DEM_IGNITION
            DemPredebounceAlgorithmClass
              DemPreDebounceCounterBased: DemCountInStepSize=1, DemCountOutStepSize=1, DemJumpDown=false, DemJumpUp=true, DemPreDebounceName=DEM_PRE_DEBOUNCE_COUNTER_BASED
        CAN_E_TIMEOUT: DemEventID=18, DemEventKind=DEM_EVENT_KIND_BSW, DemDTCClassRef=DtcClass3
          DemEventClass:
            DemEventPriority = 0
            DemFFPrestorageSupported = false
            DemHealingAllowed = false
            DemHealingCycleCounter = 1
            DemHealingCycleRef = (unset)
            DemOperationCycleRef = DEM_IGNITION
            DemPredebounceAlgorithmClass
              DemPreDebounceCounterBased: DemCountInStepSize=1, DemCountOutStepSize=1, DemJumpDown=false, DemJumpUp=true, DemPreDebounceName=DEM_PRE_DEBOUNCE_COUNTER_BASED
        CANIF_E_INVALID_DLC: DemEventID=19, DemEventKind=DEM_EVENT_KIND_BSW, DemDTCClassRef=DtcClass4
          DemEventClass:
            DemEventPriority = 0
            DemFFPrestorageSupported = false
            DemHealingAllowed = false
            DemHealingCycleCounter = 1
            DemHealingCycleRef = (unset)
            DemOperationCycleRef = DEM_IGNITION
            DemPredebounceAlgorithmClass
              DemPreDebounceCounterBased: DemCountInStepSize=1, DemCountOutStepSize=1, DemJumpDown=false, DemJumpUp=true, DemPreDebounceName=DEM_PRE_DEBOUNCE_COUNTER_BASED
        CANSM_E_MODE_CHANGE_NETWORK_0: DemEventID=20, DemEventKind=DEM_EVENT_KIND_BSW, DemDTCClassRef=DtcClass5
          DemEventClass:
            DemEventPriority = 0
            DemFFPrestorageSupported = false
            DemHealingAllowed = false
            DemHealingCycleCounter = 1
            DemHealingCycleRef = (unset)
            DemOperationCycleRef = DEM_IGNITION
            DemPredebounceAlgorithmClass
              DemPreDebounceCounterBased: DemCountInStepSize=1, DemCountOutStepSize=1, DemJumpDown=false, DemJumpUp=true, DemPreDebounceName=DEM_PRE_DEBOUNCE_COUNTER_BASED
        CANSM_E_BUSOFF_NETWORK_0: DemEventID=22, DemEventKind=DEM_EVENT_KIND_BSW, DemDTCClassRef=DtcClass7
          DemEventClass:
            DemEventPriority = 0
            DemFFPrestorageSupported = false
            DemHealingAllowed = false
            DemHealingCycleCounter = 1
            DemHealingCycleRef = (unset)
            DemOperationCycleRef = DEM_IGNITION
            DemPredebounceAlgorithmClass
              DemPreDebounceCounterBased: DemCountInStepSize=1, DemCountOutStepSize=1, DemJumpDown=false, DemJumpUp=true, DemPreDebounceName=DEM_PRE_DEBOUNCE_COUNTER_BASED
        COMM_E_NET_START_IND_CHANNEL_1: DemEventID=26, DemEventKind=DEM_EVENT_KIND_BSW, DemDTCClassRef=DtcClass11
          DemEventClass:
            DemEventPriority = 0
            DemFFPrestorageSupported = false
            DemHealingAllowed = false
            DemHealingCycleCounter = 1
            DemHealingCycleRef = (unset)
            DemOperationCycleRef = DEM_IGNITION
            DemPredebounceAlgorithmClass
              DemPreDebounceCounterBased: DemCountInStepSize=1, DemCountOutStepSize=1, DemJumpDown=false, DemJumpUp=true, DemPreDebounceName=DEM_PRE_DEBOUNCE_COUNTER_BASED
        COMM_E_NET_START_IND_CHANNEL_2: DemEventID=27, DemEventKind=DEM_EVENT_KIND_BSW, DemDTCClassRef=DtcClass12
          DemEventClass:
            DemEventPriority = 0
            DemFFPrestorageSupported = false
            DemHealingAllowed = false
            DemHealingCycleCounter = 1
            DemHealingCycleRef = (unset)
            DemOperationCycleRef = DEM_IGNITION
            DemPredebounceAlgorithmClass
              DemPreDebounceCounterBased: DemCountInStepSize=1, DemCountOutStepSize=1, DemJumpDown=false, DemJumpUp=true, DemPreDebounceName=DEM_PRE_DEBOUNCE_COUNTER_BASED
        ECUM_E_ALL_RUN_REQUESTS_KILLED: DemEventID=28, DemEventKind=DEM_EVENT_KIND_BSW, DemDTCClassRef=DtcClass13
          DemEventClass:
            DemEventPriority = 0
            DemFFPrestorageSupported = false
            DemHealingAllowed = false
            DemHealingCycleCounter = 1
            DemHealingCycleRef = (unset)
            DemOperationCycleRef = DEM_IGNITION
            DemPredebounceAlgorithmClass
              DemPreDebounceCounterBased: DemCountInStepSize=1, DemCountOutStepSize=1, DemJumpDown=false, DemJumpUp=true, DemPreDebounceName=DEM_PRE_DEBOUNCE_COUNTER_BASED
        ECUM_E_RAM_CHECKED_FAILED: DemEventID=29, DemEventKind=DEM_EVENT_KIND_BSW, DemDTCClassRef=DtcClass14
          DemEventClass:
            DemEventPriority = 0
            DemFFPrestorageSupported = false
            DemHealingAllowed = false
            DemHealingCycleCounter = 1
            DemHealingCycleRef = (unset)
            DemOperationCycleRef = DEM_IGNITION
            DemPredebounceAlgorithmClass
              DemPreDebounceCounterBased: DemCountInStepSize=1, DemCountOutStepSize=1, DemJumpDown=false, DemJumpUp=true, DemPreDebounceName=DEM_PRE_DEBOUNCE_COUNTER_BASED
        NVM_E_REQ_FAILED: DemEventID=30, DemEventKind=DEM_EVENT_KIND_BSW, DemDTCClassRef=DtcClass15
          DemEventClass:
            DemEventPriority = 0
            DemFFPrestorageSupported = false
            DemHealingAllowed = false
            DemHealingCycleCounter = 1
            DemHealingCycleRef = (unset)
            DemOperationCycleRef = DEM_IGNITION
            DemPredebounceAlgorithmClass
              DemPreDebounceCounterBased: DemCountInStepSize=1, DemCountOutStepSize=1, DemJumpDown=false, DemJumpUp=true, DemPreDebounceName=DEM_PRE_DEBOUNCE_COUNTER_BASED
        NVM_E_INTEGRITY_FAILED: DemEventID=31, DemEventKind=DEM_EVENT_KIND_BSW, DemDTCClassRef=DtcClass16
          DemEventClass:
            DemEventPriority = 0
            DemFFPrestorageSupported = false
            DemHealingAllowed = false
            DemHealingCycleCounter = 1
            DemHealingCycleRef = (unset)
            DemOperationCycleRef = DEM_IGNITION
            DemPredebounceAlgorithmClass
              DemPreDebounceCounterBased: DemCountInStepSize=1, DemCountOutStepSize=1, DemJumpDown=false, DemJumpUp=true, DemPreDebounceName=DEM_PRE_DEBOUNCE_COUNTER_BASED
        WDGM_E_SET_MODE: DemEventID=40, DemEventKind=DEM_EVENT_KIND_BSW, DemDTCClassRef=DtcClass25
          DemEventClass:
            DemEventPriority = 0
            DemFFPrestorageSupported = false
            DemHealingAllowed = false
            DemHealingCycleCounter = 1
            DemHealingCycleRef = (unset)
            DemOperationCycleRef = DEM_IGNITION
            DemPredebounceAlgorithmClass
              DemPreDebounceCounterBased: DemCountInStepSize=1, DemCountOutStepSize=1, DemJumpDown=false, DemJumpUp=true, DemPreDebounceName=DEM_PRE_DEBOUNCE_COUNTER_BASED
        WDGM_E_ALIVE_SUPERVISION: DemEventID=41, DemEventKind=DEM_EVENT_KIND_BSW, DemDTCClassRef=DtcClass26
          DemEventClass:
            DemEventPriority = 0
            DemFFPrestorageSupported = false
            DemHealingAllowed = false
            DemHealingCycleCounter = 1
            DemHealingCycleRef = (unset)
            DemOperationCycleRef = DEM_IGNITION
            DemPredebounceAlgorithmClass
              DemPreDebounceCounterBased: DemCountInStepSize=1, DemCountOutStepSize=1, DemJumpDown=false, DemJumpUp=true, DemPreDebounceName=DEM_PRE_DEBOUNCE_COUNTER_BASED
        CANIF_E_SLEEP_REQ_FAILED: DemEventID=42, DemEventKind=DEM_EVENT_KIND_BSW, DemDTCClassRef=DtcClass27
          DemEventClass:
            DemEventPriority = 0
            DemFFPrestorageSupported = false
            DemHealingAllowed = false
            DemHealingCycleCounter = 1
            DemHealingCycleRef = (unset)
            DemOperationCycleRef = DEM_IGNITION
            DemPredebounceAlgorithmClass
              DemPreDebounceCounterBased: DemCountInStepSize=1, DemCountOutStepSize=1, DemJumpDown=false, DemJumpUp=true, DemPreDebounceName=DEM_PRE_DEBOUNCE_COUNTER_BASED
        CANIF_E_FULL_TX_BUFFER: DemEventID=43, DemEventKind=DEM_EVENT_KIND_BSW, DemDTCClassRef=DtcClass28
          DemEventClass:
            DemEventPriority = 0
            DemFFPrestorageSupported = false
            DemHealingAllowed = false
            DemHealingCycleCounter = 1
            DemHealingCycleRef = (unset)
            DemOperationCycleRef = DEM_IGNITION
            DemPredebounceAlgorithmClass
              DemPreDebounceCounterBased: DemCountInStepSize=1, DemCountOutStepSize=1, DemJumpDown=false, DemJumpUp=true, DemPreDebounceName=DEM_PRE_DEBOUNCE_COUNTER_BASED
        CANIF_E_STOPPED: DemEventID=44, DemEventKind=DEM_EVENT_KIND_BSW, DemDTCClassRef=DtcClass29
          DemEventClass:
            DemEventPriority = 0
            DemFFPrestorageSupported = false
            DemHealingAllowed = false
            DemHealingCycleCounter = 1
            DemHealingCycleRef = (unset)
            DemOperationCycleRef = DEM_IGNITION
            DemPredebounceAlgorithmClass
              DemPreDebounceCounterBased: DemCountInStepSize=1, DemCountOutStepSize=1, DemJumpDown=false, DemJumpUp=true, DemPreDebounceName=DEM_PRE_DEBOUNCE_COUNTER_BASED
        CTC_0x505100: DemEventID=14, DemEventKind=DEM_EVENT_KIND_SWC, DemDTCClassRef=DtcClass30
          DemEventClass:
            DemEventPriority = 0
            DemFFPrestorageSupported = false
            DemHealingAllowed = false
            DemEventDestination = DEM_DTC_ORIGIN_PRIMARY_MEMORY
            DemHealingCycleCounter = 1
            DemHealingCycleRef = (unset)
            DemOperationCycleRef = DEM_IGNITION
            DemIndicator0 (DemIndicatorAttribute): DemIndicatorBehaviour=1, DemLinkedIndicator=EpasFailed
            DemPredebounceAlgorithmClass
              DemPreDebounceCounterBased: DemCountInStepSize=1, DemCountOutStepSize=1, DemJumpDown=false, DemJumpUp=true, DemPreDebounceName=DEM_PRE_DEBOUNCE_COUNTER_BASED
        CTC_0x505200: DemEventID=13, DemEventKind=DEM_EVENT_KIND_SWC, DemDTCClassRef=DtcClass31
          DemEventClass:
            DemEventPriority = 0
            DemFFPrestorageSupported = false
            DemHealingAllowed = false
            DemEventDestination = DEM_DTC_ORIGIN_PRIMARY_MEMORY
            DemHealingCycleCounter = 1
            DemHealingCycleRef = (unset)
            DemOperationCycleRef = DEM_IGNITION
            DemIndicator0 (DemIndicatorAttribute): DemIndicatorBehaviour=1, DemLinkedIndicator=EpasFailed
            DemPredebounceAlgorithmClass
              DemPreDebounceCounterBased: DemCountInStepSize=1, DemCountOutStepSize=1, DemJumpDown=false, DemJumpUp=true, DemPreDebounceName=DEM_PRE_DEBOUNCE_COUNTER_BASED
        CTC_0x505316: DemEventID=12, DemEventKind=DEM_EVENT_KIND_SWC, DemDTCClassRef=DtcClass32
          DemEventClass:
            DemEventPriority = 0
            DemFFPrestorageSupported = false
            DemHealingAllowed = false
            DemEventDestination = DEM_DTC_ORIGIN_PRIMARY_MEMORY
            DemHealingCycleCounter = 1
            DemHealingCycleRef = (unset)
            DemOperationCycleRef = DEM_IGNITION
            DemPredebounceAlgorithmClass
              DemPreDebounceCounterBased: DemCountInStepSize=1, DemCountOutStepSize=1, DemJumpDown=false, DemJumpUp=true, DemPreDebounceName=DEM_PRE_DEBOUNCE_COUNTER_BASED
            DemIndicator0 (DemIndicatorAttribute): DemIndicatorBehaviour=1, DemLinkedIndicator=EpasFailed
        CTC_0x505317: DemEventID=11, DemEventKind=DEM_EVENT_KIND_SWC, DemDTCClassRef=DtcClass33
          DemEventClass:
            DemEventPriority = 0
            DemFFPrestorageSupported = false
            DemHealingAllowed = false
            DemEventDestination = DEM_DTC_ORIGIN_PRIMARY_MEMORY
            DemHealingCycleCounter = 1
            DemHealingCycleRef = (unset)
            DemOperationCycleRef = DEM_IGNITION
            DemPredebounceAlgorithmClass
              DemPreDebounceCounterBased: DemCountInStepSize=1, DemCountOutStepSize=1, DemJumpDown=false, DemJumpUp=true, DemPreDebounceName=DEM_PRE_DEBOUNCE_COUNTER_BASED
            DemIndicator0 (DemIndicatorAttribute): DemIndicatorBehaviour=1, DemLinkedIndicator=EpasFailed
        CTC_0x505400: DemEventID=10, DemEventKind=DEM_EVENT_KIND_SWC, DemDTCClassRef=DtcClass34
          DemEventClass:
            DemEventPriority = 0
            DemFFPrestorageSupported = false
            DemHealingAllowed = false
            DemEventDestination = DEM_DTC_ORIGIN_PRIMARY_MEMORY
            DemHealingCycleCounter = 1
            DemHealingCycleRef = (unset)
            DemOperationCycleRef = DEM_IGNITION
            DemIndicator0 (DemIndicatorAttribute): DemIndicatorBehaviour=1, DemLinkedIndicator=EpasFailed
            DemPredebounceAlgorithmClass
              DemPreDebounceCounterBased: DemCountInStepSize=1, DemCountOutStepSize=1, DemJumpDown=false, DemJumpUp=true, DemPreDebounceName=DEM_PRE_DEBOUNCE_COUNTER_BASED
        CTC_0x505500: DemEventID=9, DemEventKind=DEM_EVENT_KIND_SWC, DemDTCClassRef=DtcClass35
          DemEventClass:
            DemEventPriority = 0
            DemFFPrestorageSupported = false
            DemHealingAllowed = false
            DemEventDestination = DEM_DTC_ORIGIN_PRIMARY_MEMORY
            DemHealingCycleCounter = 1
            DemHealingCycleRef = (unset)
            DemOperationCycleRef = DEM_IGNITION
            DemIndicator0 (DemIndicatorAttribute): DemIndicatorBehaviour=1, DemLinkedIndicator=EpasFailed
            DemPredebounceAlgorithmClass
              DemPreDebounceCounterBased: DemCountInStepSize=1, DemCountOutStepSize=1, DemJumpDown=false, DemJumpUp=true, DemPreDebounceName=DEM_PRE_DEBOUNCE_COUNTER_BASED
        CTC_0x505600: DemEventID=8, DemEventKind=DEM_EVENT_KIND_SWC, DemDTCClassRef=DtcClass36
          DemEventClass:
            DemEventPriority = 0
            DemFFPrestorageSupported = false
            DemHealingAllowed = false
            DemEventDestination = DEM_DTC_ORIGIN_PRIMARY_MEMORY
            DemHealingCycleCounter = 1
            DemHealingCycleRef = (unset)
            DemOperationCycleRef = DEM_IGNITION
            DemIndicator0 (DemIndicatorAttribute): DemIndicatorBehaviour=1, DemLinkedIndicator=EpasFailed
            DemPredebounceAlgorithmClass
              DemPreDebounceCounterBased: DemCountInStepSize=1, DemCountOutStepSize=1, DemJumpDown=false, DemJumpUp=true, DemPreDebounceName=DEM_PRE_DEBOUNCE_COUNTER_BASED
        CTC_0x505700: DemEventID=7, DemEventKind=DEM_EVENT_KIND_SWC, DemDTCClassRef=DtcClass37
          DemEventClass:
            DemEventPriority = 0
            DemFFPrestorageSupported = false
            DemHealingAllowed = false
            DemEventDestination = DEM_DTC_ORIGIN_PRIMARY_MEMORY
            DemHealingCycleCounter = 1
            DemHealingCycleRef = (unset)
            DemOperationCycleRef = DEM_IGNITION
            DemIndicator0 (DemIndicatorAttribute): DemIndicatorBehaviour=1, DemLinkedIndicator=EpasFailed
            DemPredebounceAlgorithmClass
              DemPreDebounceCounterBased: DemCountInStepSize=1, DemCountOutStepSize=1, DemJumpDown=false, DemJumpUp=true, DemPreDebounceName=DEM_PRE_DEBOUNCE_COUNTER_BASED
        CTC_0x505800: DemEventID=6, DemEventKind=DEM_EVENT_KIND_SWC, DemDTCClassRef=DtcClass38
          DemEventClass:
            DemEventPriority = 0
            DemFFPrestorageSupported = false
            DemHealingAllowed = false
            DemEventDestination = DEM_DTC_ORIGIN_PRIMARY_MEMORY
            DemHealingCycleCounter = 1
            DemHealingCycleRef = (unset)
            DemOperationCycleRef = DEM_IGNITION
            DemIndicator0 (DemIndicatorAttribute): DemIndicatorBehaviour=1, DemLinkedIndicator=EpasFailed
            DemPredebounceAlgorithmClass
              DemPreDebounceCounterBased: DemCountInStepSize=1, DemCountOutStepSize=1, DemJumpDown=false, DemJumpUp=true, DemPreDebounceName=DEM_PRE_DEBOUNCE_COUNTER_BASED
        CTC_0x505900: DemEventID=5, DemEventKind=DEM_EVENT_KIND_SWC, DemDTCClassRef=DtcClass39
          DemEventClass:
            DemEventPriority = 0
            DemFFPrestorageSupported = false
            DemHealingAllowed = false
            DemEventDestination = DEM_DTC_ORIGIN_PRIMARY_MEMORY
            DemHealingCycleCounter = 1
            DemHealingCycleRef = (unset)
            DemOperationCycleRef = DEM_IGNITION
            DemIndicator0 (DemIndicatorAttribute): DemIndicatorBehaviour=1, DemLinkedIndicator=EpasFailed
            DemPredebounceAlgorithmClass
              DemPreDebounceCounterBased: DemCountInStepSize=1, DemCountOutStepSize=1, DemJumpDown=false, DemJumpUp=true, DemPreDebounceName=DEM_PRE_DEBOUNCE_COUNTER_BASED
        CTC_0xD00300: DemEventID=4, DemEventKind=DEM_EVENT_KIND_SWC, DemDTCClassRef=DtcClass40
          DemEventClass:
            DemEventPriority = 0
            DemFFPrestorageSupported = false
            DemHealingAllowed = false
            DemEventDestination = DEM_DTC_ORIGIN_PRIMARY_MEMORY
            DemHealingCycleCounter = 1
            DemHealingCycleRef = (unset)
            DemOperationCycleRef = DEM_IGNITION
            DemIndicator0 (DemIndicatorAttribute): DemIndicatorBehaviour=1, DemLinkedIndicator=EpasFailed
            DemPredebounceAlgorithmClass
              DemPreDebounceCounterBased: DemCountInStepSize=1, DemCountOutStepSize=1, DemJumpDown=false, DemJumpUp=true, DemPreDebounceName=DEM_PRE_DEBOUNCE_COUNTER_BASED
        CTC_0xD11700: DemEventID=3, DemEventKind=DEM_EVENT_KIND_SWC, DemDTCClassRef=DtcClass41
          DemEventClass:
            DemEventPriority = 0
            DemFFPrestorageSupported = false
            DemHealingAllowed = false
            DemEventDestination = DEM_DTC_ORIGIN_PRIMARY_MEMORY
            DemHealingCycleCounter = 1
            DemHealingCycleRef = (unset)
            DemOperationCycleRef = DEM_IGNITION
            DemIndicator0 (DemIndicatorAttribute): DemIndicatorBehaviour=1, DemLinkedIndicator=EpasFailed
            DemPredebounceAlgorithmClass
              DemPreDebounceCounterBased: DemCountInStepSize=1, DemCountOutStepSize=1, DemJumpDown=false, DemJumpUp=true, DemPreDebounceName=DEM_PRE_DEBOUNCE_COUNTER_BASED
        CTC_0xD12100: DemEventID=2, DemEventKind=DEM_EVENT_KIND_SWC, DemDTCClassRef=DtcClass42
          DemEventClass:
            DemEventPriority = 0
            DemFFPrestorageSupported = false
            DemHealingAllowed = false
            DemEventDestination = DEM_DTC_ORIGIN_PRIMARY_MEMORY
            DemHealingCycleCounter = 1
            DemHealingCycleRef = (unset)
            DemOperationCycleRef = DEM_IGNITION
            DemIndicator0 (DemIndicatorAttribute): DemIndicatorBehaviour=1, DemLinkedIndicator=EpasFailed
            DemPredebounceAlgorithmClass
              DemPreDebounceCounterBased: DemCountInStepSize=1, DemCountOutStepSize=1, DemJumpDown=false, DemJumpUp=true, DemPreDebounceName=DEM_PRE_DEBOUNCE_COUNTER_BASED
        CTC_0xD14000: DemEventID=1, DemEventKind=DEM_EVENT_KIND_SWC, DemDTCClassRef=DtcClass43
          DemEventClass:
            DemEventPriority = 0
            DemFFPrestorageSupported = false
            DemHealingAllowed = false
            DemEventDestination = DEM_DTC_ORIGIN_PRIMARY_MEMORY
            DemHealingCycleCounter = 1
            DemHealingCycleRef = (unset)
            DemOperationCycleRef = DEM_IGNITION
            DemIndicator0 (DemIndicatorAttribute): DemIndicatorBehaviour=1, DemLinkedIndicator=EpasFailed
            DemPredebounceAlgorithmClass
              DemPreDebounceCounterBased: DemCountInStepSize=1, DemCountOutStepSize=1, DemJumpDown=false, DemJumpUp=true, DemPreDebounceName=DEM_PRE_DEBOUNCE_COUNTER_BASED
        CANTRCV_E_NO_TRCV_CONTROL: DemEventID=15, DemEventKind=DEM_EVENT_KIND_BSW, DemDTCClassRef=DtcClass0
          DemEventClass:
            DemEventPriority = 0
            DemFFPrestorageSupported = false
            DemHealingAllowed = false
            DemHealingCycleCounter = 1
            DemHealingCycleRef = (unset)
            DemOperationCycleRef = DEM_IGNITION
            DemPredebounceAlgorithmClass
              DemPreDebounceCounterBased: DemCountInStepSize=1, DemCountOutStepSize=1, DemJumpDown=false, DemJumpUp=true, DemPreDebounceName=DEM_PRE_DEBOUNCE_COUNTER_BASED
        CANSM_E_MODE_CHANGE_NETWORK_1: DemEventID=21, DemEventKind=DEM_EVENT_KIND_BSW, DemDTCClassRef=DtcClass6
          DemEventClass:
            DemEventPriority = 0
            DemFFPrestorageSupported = false
            DemHealingAllowed = false
            DemHealingCycleCounter = 1
            DemHealingCycleRef = (unset)
            DemOperationCycleRef = DEM_IGNITION
            DemPredebounceAlgorithmClass
              DemPreDebounceCounterBased: DemCountInStepSize=1, DemCountOutStepSize=1, DemJumpDown=false, DemJumpUp=true, DemPreDebounceName=DEM_PRE_DEBOUNCE_COUNTER_BASED
        CANSM_E_BUSOFF_NETWORK_1: DemEventID=23, DemEventKind=DEM_EVENT_KIND_BSW, DemDTCClassRef=DtcClass8
          DemEventClass:
            DemEventPriority = 0
            DemFFPrestorageSupported = false
            DemHealingAllowed = false
            DemHealingCycleCounter = 1
            DemHealingCycleRef = (unset)
            DemOperationCycleRef = DEM_IGNITION
            DemPredebounceAlgorithmClass
              DemPreDebounceCounterBased: DemCountInStepSize=1, DemCountOutStepSize=1, DemJumpDown=false, DemJumpUp=true, DemPreDebounceName=DEM_PRE_DEBOUNCE_COUNTER_BASED
        CANSM_E_SETTRANSCEIVERMODE_NETWORK_1: DemEventID=24, DemEventKind=DEM_EVENT_KIND_BSW, DemDTCClassRef=DtcClass9
          DemEventClass:
            DemEventPriority = 0
            DemFFPrestorageSupported = false
            DemHealingAllowed = false
            DemHealingCycleCounter = 1
            DemHealingCycleRef = (unset)
            DemOperationCycleRef = DEM_IGNITION
            DemPredebounceAlgorithmClass
              DemPreDebounceCounterBased: DemCountInStepSize=1, DemCountOutStepSize=1, DemJumpDown=false, DemJumpUp=true, DemPreDebounceName=DEM_PRE_DEBOUNCE_COUNTER_BASED
        LINSM_E_CONFIRMATION_TIMEOUT: DemEventID=25, DemEventKind=DEM_EVENT_KIND_BSW, DemDTCClassRef=DtcClass10
          DemEventClass:
            DemEventPriority = 0
            DemFFPrestorageSupported = false
            DemHealingAllowed = false
            DemHealingCycleCounter = 1
            DemHealingCycleRef = (unset)
            DemOperationCycleRef = DEM_IGNITION
            DemPredebounceAlgorithmClass
              DemPreDebounceCounterBased: DemCountInStepSize=1, DemCountOutStepSize=1, DemJumpDown=false, DemJumpUp=true, DemPreDebounceName=DEM_PRE_DEBOUNCE_COUNTER_BASED
        FLS_E_ERASE_FAILED: DemEventID=32, DemEventKind=DEM_EVENT_KIND_BSW, DemDTCClassRef=DtcClass17
          DemEventClass:
            DemEventPriority = 0
            DemFFPrestorageSupported = false
            DemHealingAllowed = false
            DemHealingCycleCounter = 1
            DemHealingCycleRef = (unset)
            DemOperationCycleRef = DEM_IGNITION
            DemPredebounceAlgorithmClass
              DemPreDebounceCounterBased: DemCountInStepSize=1, DemCountOutStepSize=1, DemJumpDown=false, DemJumpUp=true, DemPreDebounceName=DEM_PRE_DEBOUNCE_COUNTER_BASED
        FLS_E_WRITE_FAILED: DemEventID=33, DemEventKind=DEM_EVENT_KIND_BSW, DemDTCClassRef=DtcClass18
          DemEventClass:
            DemEventPriority = 0
            DemFFPrestorageSupported = false
            DemHealingAllowed = false
            DemHealingCycleCounter = 1
            DemHealingCycleRef = (unset)
            DemOperationCycleRef = DEM_IGNITION
            DemPredebounceAlgorithmClass
              DemPreDebounceCounterBased: DemCountInStepSize=1, DemCountOutStepSize=1, DemJumpDown=false, DemJumpUp=true, DemPreDebounceName=DEM_PRE_DEBOUNCE_COUNTER_BASED
        FLS_E_READ_FAILED: DemEventID=34, DemEventKind=DEM_EVENT_KIND_BSW, DemDTCClassRef=DtcClass19
          DemEventClass:
            DemEventPriority = 0
            DemFFPrestorageSupported = false
            DemHealingAllowed = false
            DemHealingCycleCounter = 1
            DemHealingCycleRef = (unset)
            DemOperationCycleRef = DEM_IGNITION
            DemPredebounceAlgorithmClass
              DemPreDebounceCounterBased: DemCountInStepSize=1, DemCountOutStepSize=1, DemJumpDown=false, DemJumpUp=true, DemPreDebounceName=DEM_PRE_DEBOUNCE_COUNTER_BASED
        FLS_E_COMPARE_FAILED: DemEventID=35, DemEventKind=DEM_EVENT_KIND_BSW, DemDTCClassRef=DtcClass20
          DemEventClass:
            DemEventPriority = 0
            DemFFPrestorageSupported = false
            DemHealingAllowed = false
            DemHealingCycleCounter = 1
            DemHealingCycleRef = (unset)
            DemOperationCycleRef = DEM_IGNITION
            DemPredebounceAlgorithmClass
              DemPreDebounceCounterBased: DemCountInStepSize=1, DemCountOutStepSize=1, DemJumpDown=false, DemJumpUp=true, DemPreDebounceName=DEM_PRE_DEBOUNCE_COUNTER_BASED
        FRIF_E_JLE_SYNC: DemEventID=36, DemEventKind=DEM_EVENT_KIND_BSW, DemDTCClassRef=DtcClass21
          DemEventClass:
            DemEventPriority = 0
            DemFFPrestorageSupported = false
            DemHealingAllowed = false
            DemHealingCycleCounter = 1
            DemHealingCycleRef = (unset)
            DemOperationCycleRef = DEM_IGNITION
            DemPredebounceAlgorithmClass
              DemPreDebounceCounterBased: DemCountInStepSize=1, DemCountOutStepSize=1, DemJumpDown=false, DemJumpUp=true, DemPreDebounceName=DEM_PRE_DEBOUNCE_COUNTER_BASED
        FRNM_E_INIT_FAILED: DemEventID=37, DemEventKind=DEM_EVENT_KIND_BSW, DemDTCClassRef=DtcClass22
          DemEventClass:
            DemEventPriority = 0
            DemFFPrestorageSupported = false
            DemHealingAllowed = false
            DemHealingCycleCounter = 1
            DemHealingCycleRef = (unset)
            DemOperationCycleRef = DEM_IGNITION
            DemPredebounceAlgorithmClass
              DemPreDebounceCounterBased: DemCountInStepSize=1, DemCountOutStepSize=1, DemJumpDown=false, DemJumpUp=true, DemPreDebounceName=DEM_PRE_DEBOUNCE_COUNTER_BASED
        FRSM_E_CLUSTER_STARTUP: DemEventID=38, DemEventKind=DEM_EVENT_KIND_BSW, DemDTCClassRef=DtcClass23
          DemEventClass:
            DemEventPriority = 0
            DemFFPrestorageSupported = false
            DemHealingAllowed = false
            DemHealingCycleCounter = 1
            DemHealingCycleRef = (unset)
            DemOperationCycleRef = DEM_IGNITION
            DemPredebounceAlgorithmClass
              DemPreDebounceCounterBased: DemCountInStepSize=1, DemCountOutStepSize=1, DemJumpDown=false, DemJumpUp=true, DemPreDebounceName=DEM_PRE_DEBOUNCE_COUNTER_BASED
        FRTRCV_E_FR_NO_TRCV_CONTROL: DemEventID=39, DemEventKind=DEM_EVENT_KIND_BSW, DemDTCClassRef=DtcClass24
          DemEventClass:
            DemEventPriority = 0
            DemFFPrestorageSupported = false
            DemHealingAllowed = false
            DemHealingCycleCounter = 1
            DemHealingCycleRef = (unset)
            DemOperationCycleRef = DEM_IGNITION
            DemPredebounceAlgorithmClass
              DemPreDebounceCounterBased: DemCountInStepSize=1, DemCountOutStepSize=1, DemJumpDown=false, DemJumpUp=true, DemPreDebounceName=DEM_PRE_DEBOUNCE_COUNTER_BASED
      DEM_DTC_GROUP_EMISSION_REL_DTCS (DemGroupOfDTC): DemGroupDTCs=(unset)
      DEM_DTC_GROUP_POWERTRAIN_DTCS (DemGroupOfDTC): DemGroupDTCs=1
      CANTP_E_COMM (DemEventParameter):
        DemEventID = 45
        DemInitMonitorName = (unset)
        DemEventKind = DEM_EVENT_KIND_BSW
        DemImportedEvent = false
        DemExtendedDataRef = (unset)
        DemDTCClassRef = DtcClass44
        DemEventClass:
          DemEventPriority = 0
          DemFFPrestorageSupported = false
          DemHealingAllowed = false
          DemHealingCycleCounter = 1
          DemHealingCycleRef = (unset)
          DemOperationCycleRef = DEM_IGNITION
          DemPredebounceAlgorithmClass
            DemPreDebounceCounterBased: DemJumpUp=true, DemJumpDown=false, DemCountOutStepSize=1, DemCountInStepSize=1, DemPreDebounceName=DEM_PRE_DEBOUNCE_COUNTER_BASED
      DtcClass44 (DemDTCClass): DemDTC=0, DemDTCKind=DEM_DTC_KIND_ALL_DTCS, DemDTCSeverity=DEM_DTC_SEV_NO_SEVERITY, DemDTCFunctionalUnit=0, DemDTCSupportWarningIndicator=false
    DemGeneral:
      DemBswErrorBufferSize = 30
      DemDevErrorDetect = false
      DemDtcStatusAvailabilityMask = 255
      DemFFDataIDLength = 2
      DemMaxNumberEventEntryMir = 20
      DemMaxNumberEventEntryPrm = 35
      DemMaxNumberEventEntrySec = 0
      DemNvmAccessRetry = 0
      DemNvmAccessRetryTimeDelay = 0
      DemVersionInfoApi = true
      DemAddErrorBufferSize = 1
      DemSnapshotsPerDTC = 2
      DemUseRte = true
      DemPostbuildStartAddress = 0
      DemUseDcmCompatiblePorts = false
      DemUserConfigFile = (unset)
      DemVariantModeSelection = SIMPLE_ECU
      DemPreInitHasConfigParam = false
      DemSoftwareComponentName = Dem
      DemSupportGetEventIdApi = false
      DemMaxNumberPrestoredFF = 0
      DemTaskTime = 10
      DemTypeOfDTCSupported = 1
      DemTimeBasedDebouncingDataType = TIME_BASED_DEBOUNCING_16_BIT
      EpasFailed (DemIndicator): DemIndicatorID=0
      NvM_NVM_BLOCK_DEM (DemNvramBlockId): DemNvramBlockIdUsageType=DEM_NVRAM_BLOCK_CORE, DemNvramBlockIdRef=NvM/NvM_NVM_BLOCK_DEM
      4 x DemOperationCycleTgt:
        DEM_IGNITION: DemOperationCycle=DEM_IGNITION
        DEM_OBD_DCY: DemOperationCycle=DEM_OBD_DCY
        DEM_POWER: DemOperationCycle=DEM_POWER
        DEM_WARMUP: DemOperationCycle=DEM_WARMUP
    VectorCommonData: BswmdVersion=2.14.00
  module config Dcm: implementation-config-variant=VARIANT-PRE-COMPILE, module-description=Dcm_Impl  # Configuration of the Dcm (Diagnostic Communications Manager) module.
    Diagnostic_Configuration (DcmDsd)
      CommonDiagnostics (DcmDsdServiceTable): DcmDiagnosticDatabase=..\..\..\Tools\AsrProject\Config\System\Haitec_LC.cdd, DcmDiagnosticVariant=CommonDiagnostics
    DcmDsl
      DcmDslDiagResp: DcmDslDiagRespForceRespPendEn=false, DcmDslDiagRespMaxNumRespPend=255
      DcmDslProtocol
        PROTOCOL_UDS_ON_CAN (DcmDslProtocolRow):
          DcmDslProtocolID = 1
          DcmDslProtocolIsParallelExecutab = (unset)
          DcmDslProtocolPreemptTimeout = 1
          DcmDslProtocolPriority = 0
          DcmDslProtocolBufferSize = 325
          DcmDiagnosticDatabase = (unset)
          DcmDslProtocolTransType = Type1
          DcmDslProtocolTimeLimit = DcmDslProtocolTiming/PROTOCOL_UDS_ON_CAN
          CAN00_EPAS (DcmDslConnection): DcmConnectionProtocolType=UDS
            DcmDslMainConnection
              DcmDslProtocolRx_1 (DcmDslProtocolRx): DcmDslProtocolRxAddrType=PHYSICAL_TYPE, DcmDslProtocolRxPduRef=PduCollection/DiagPhysReqToEPAS__CAN00
              DcmDslProtocolTx: DcmDslProtocolTxPduRef=PduCollection/DiagRespFromEPAS__CAN00
              DcmDslProtocolRx_0 (DcmDslProtocolRx): DcmDslProtocolRxAddrType=FUNCTIONAL_TYPE, DcmDslProtocolRxPduRef=PduCollection/DiagFuncReqFT__CAN00
      DcmDslProtocolTiming
        PROTOCOL_UDS_ON_CAN (DcmDslProtocolTimingRow):
          DcmTimStrP2ServerMax = 0.050000002374872565
          DcmTimStrP2ServerMin = (unset)
          DcmTimStrP2StarServerMax = 5.0000002374872565
          DcmTimStrP2StarServerMin = 2.5000001187436283
          DcmTimStrS3Server = 5.0000002374872565
    DcmGeneral:
      DcmRespondAllRequest = true
      DcmDevErrorDetect = true
      DcmRequestIndicationEnabled = false
      DcmTaskTime = 0.010000000474974513
      DcmVersionInfoApi = true
      DcmUseRte = true
      DcmParallelRequestHandling = EXCLUSIVE_SILENT
      DcmMaxNumberParallelRequest = 3
      DcmRuntimeLimiter = 10
      DcmEcuResetDelayTime = 1000
      DcmUserConfigFile = (unset)
      DcmVariantModeSelection = SIMPLE_ECU
      DcmMaxMemoryGapSize = 0
      DcmAsr4StyleMemoryAccess = false
      DcmSupportMultiChannelFBL = false
      DcmSoftwareComponentName = Dcm
      DcmUnspecifiedServiceSupport = true
      DcmPeriodicTxType = Type_II
      DcmRoeTxType = Type_II
      DcmSplitMainFunctionEnabled = false
    DcmPageBufferCfg: DcmPagedBufferEnabled=false, DcmPagedBufferTimeout=0
    VectorCommonData: BswmdVersion=4.07.03
    DcmConfigSet: DcmActiveDsdServiceTableRef=CommonDiagnostics, DcmActiveDslProtocolRowRef=DcmDslProtocol/PROTOCOL_UDS_ON_CAN
  module config CanTp: implementation-config-variant=VARIANT-PRE-COMPILE, module-description=CanTp_Impl  # Configuration of the CanTp (CAN Transport Protocol) module.
    CanTpGeneral:
      CanTpDevErrorDetect = true
      CanTpMainFunctionPeriod = 0.010000000474974513
      CanTpTc = false
      CanTpPaddingActive = true
      CanTpHavePaddingByte = true
      CanTpPaddingPattern = 0
      CanTpVersionInfoApi = true
      CanTpMaxNumRxSdus = 2
      CanTpMaxNumTxSdus = 1
      CanTpPostbuildStartAddress = 0
      CanTpDynamicChannelAssignment = false
      CanTpMaxNumRxChannels = 3
      CanTpMaxNumRxChannels_PbLimit = 3
      CanTpMaxNumTxChannels = 3
      CanTpMaxNumTxChannels_PbLimit = 3
      CanTpProdErrorDetect = true
      CanTpOptimizeSingleConnection = false
      CanTpOptimizeSingleConnPrec = false
      CanTpEnableSplitMainFunction = false
      CanTpEnableExtendedApiSTMin = false
      CanTpEnableExtendedApiBs = false
      CanTpUserConfigFile = (unset)
      CanTpEnableRxNSduIdRemapping = false
      CanTpEnableTxNSduIdRemapping = false
      CanTpSupportFullBufferHandlingRx = true
      CanTpSupportFullBufferHandlingTx = true
      CanTpSupportStandardAddressing = true
      CanTpSupportExtendedAddressing = true
      CanTpSupportMixed11Addressing = false
      CanTpEnableAr40CompliantPduRApi = false
      CanTpFFProvide2RxBufferCalls = false
      CanTpSuppressPrePassIndication = false
      CanTpExtErrorDetect = false
      CanTpHasRxIndication = true
      CanTpHasTxConfirmation = true
      CanTpHasInitCfgPtr = false
      CanTpChangeParameterReqApi = false
      CanTpStrictRxCallSeq = false
      CanTpRc = false
      CanTpRcNotifyAlways = false
      CanTpTcNotifyAlways = false
      CanTpOperNotSupportedReportDem = false
      CanTpECommReportDem = true
      CanTpIgnoreFcWithReservedStMin = false
      CanTpIgnoreFcOvflAndInvalidFS = false
      CanTpIgnoreCfWithWrongSN = false
      CanTpEnableDcmRequestDetect = false
      CanTpEnableSynchronousTransmit = true
      CanTpEnableConstantBS = false
      CanTpUseOnlyFirstFc = false
      CanTpHandleFcWithReservedStMin = CANTP_ISO15765
    DiagFuncReqFT__CAN00 (CanTpRxNSdu):
      CanTpAddressingFormat = CANTP_STANDARD
      CanTpBs = 8
      CanTpNar = 0.02500000037252903
      CanTpNbr = 0.15000000596046448
      CanTpNcr = 0.15000000596046448
      CanTpRxChannel = (unset)
      CanTpRxDl = 8
      CanTpRxPaddingActivation = CANTP_ON
      CanTpRxTaType = CANTP_FUNCTIONAL
      CanTpRxWftMax = 15
      CanTpSTmin = 20
      CanTpCreatedByTool = false
      CanTpRxNSduRef = PduCollection/DiagFuncReqFT__CAN00
      DiagFuncReqFT_Tp__CAN00 (CanTpRxNPdu): CanTpRxNPduId=0, CanTpRxNPduRef=PduCollection/DiagFuncReqFT_Tp__CAN00
      CanTpTxFcNPdu: CanTpTxFcNPduRef=(unset)
    DiagRespFromEPAS__CAN00 (CanTpTxNSdu):
      CanTpAddressingMode = CANTP_STANDARD
      CanTpNas = 0.025000001187436283
      CanTpNbs = 0.075000003562308848
      CanTpNcs = 0.010000000474974513
      CanTpTxChannel = (unset)
      CanTpTxDl = 8
      CanTpTxNSduId = 0
      CanTpTxPaddingActivation = CANTP_ON
      CanTpTxTaType = CANTP_PHYSICAL
      CanTpCreatedByTool = false
      CanTpTxUpperLayerNSduId = 0
      CanTpTxTc = true
      CanTpTxNSduRef = PduCollection/DiagRespFromEPAS__CAN00
      CanTpNSa: CanTpNSa=(unset)
      CanTpNTa: CanTpNTa=(unset)
      DiagPhysReqToEPAS_Tp__CAN00 (CanTpRxFcNPdu): CanTpRxFcNPduId=1, CanTpRxFcNPduRef=PduCollection/DiagPhysReqToEPAS_Tp__CAN00
      DiagRespFromEPAS_Tp__CAN00_0 (CanTpTxNPdu): CanTpTxNPduRef=PduCollection/DiagRespFromEPAS_Tp__CAN00
    VectorCommonData: BswmdVersion=1.18.11
    CanTpConfigSet:
      CanTpActiveRxNSduRef = CanTp/DiagFuncReqFT__CAN00
      CanTpActiveRxNSduRef = DiagPhysReqToEPAS__CAN00_EPAS
      CanTpActiveTxNSduRef = CanTp/DiagRespFromEPAS__CAN00
    DiagPhysReqToEPAS__CAN00_EPAS (CanTpRxNSdu):
      CanTpAddressingFormat = CANTP_STANDARD
      CanTpBs = 0
      CanTpNar = 0.02500000037252903
      CanTpNbr = 0.010000000707805157
      CanTpNcr = 0.15000000596046448
      CanTpRxChannel = (unset)
      CanTpRxDl = 8
      CanTpRxPaddingActivation = CANTP_ON
      CanTpRxTaType = CANTP_PHYSICAL
      CanTpRxWftMax = 0
      CanTpSTmin = 20
      CanTpCreatedByTool = false
      CanTpRxNSduRef = PduCollection/DiagPhysReqToEPAS__CAN00
      DiagPhysReqToEPAS_Tp__CAN00_2 (CanTpRxNPdu): CanTpRxNPduId=1, CanTpRxNPduRef=PduCollection/DiagPhysReqToEPAS_Tp__CAN00
      DiagPhysReqToEPAS_Tp__CAN00_1 (CanTpTxFcNPdu): CanTpTxFcNPduRef=PduCollection/DiagRespFromEPAS_Tp__CAN00
  module config Mcu: implementation-config-variant=VARIANT-POST-BUILD, module-description=Mcu_Impl  # Configuration of the Mcu (Microcontroler Unit) module.
    McuGeneralConfiguration:
      McuBank0Pwr = ActiveMode
      McuBank1Pwr = ActiveMode
      McuBank{2..6}Pwr = SleepMode
      McuBank7Pwr = ActiveMode
      McuDevErrorDetect = false
      McuPerformResetApi = true
      McuVersionInfoApi = true
      McuDoParamCheck = true
      McuCheckParamConfig = true
      McuCheckParamMode = true
      McuCheckParamClock = true
      McuCheckParamRamSection = true
      McuCheckVersionInfo = true
      McuCheckUninit = true
      McuCheckPllStatus = true
      McuDevErrorReport = true
      McuErrorHook = Det_ReportError
      McuIncludeDet = Det.h
      McuProdErrorReport = true
      McuUseInitRamApi = false
      McuCopyTrimFromOtp = true
      McuSraEnabled = true
      McuSraOnlyForWrite = true
      McuSraOnlyForPrivModeRegs = true
      McuSraNotInInit = false
      McuErrataFmzPll17Workaround = false
      McuIrqHandling = SuspendAllInterrupts
      McuMemInit:
        McuInitMibSpiP1Ram = true
        McuInitMibSpiP3Ram = true
        McuInitMibSpiP5Ram = true
        McuInitDcan{1..3}Ram = true
        McuInitMibAdc1Ram = true
        McuInitMibAdc2Ram = true
        McuInitNhet1Ram = true
        McuInitNhet2Ram = true
        McuInitHetTu1Ram = true
        McuInitHetTu2Ram = true
        McuInitDmaRam = true
        McuInitVimRam = false
        McuInitFlexRayTuRam = true
      McuPeripheralSelect:
        McuUseMibSpiP1 = true
        McuUseSpiP2 = true
        McuUseMibSpiP3 = true
        McuUseSpiP4 = true
        McuUseMibSpiP5 = true
        McuUseLin = true
        McuUseSci = true
        McuUseDcan{1..3} = true
        McuUseI2c = true
        McuUseFlexRay = true
        McuUseFlexRayTu = true
        McuUseMibAdc1 = true
        McuUseMibAdc2 = true
        McuUseGio = true
        McuUseNhet1 = true
        McuUseNhet2 = true
        McuUseHetTu1 = true
        McuUseHetTu2 = true
        McuUseDmm = false
    McuModuleConfiguration: McuClockSrcFailureNotification=DISABLED
      McuClockSettingConfig
        McuClockReferencePoint: McuClockReferencePointFrequency=20
        McuLpo:
          McuLpoEnableBias = true
          McuLpoTrimLow = Trim100Comma00Percent
          McuLpoTrimHigh = Trim100Comma00Percent
          McuLpoLowref = 80
          McuLpoHighref = 100
          McuLpoLowfreq = 0.08
          McuLpoHighfreq = 10
        PLL (McuPllConfig):
          McuPllRefClkDiv = 6
          McuPllOdDiv = 2
          McuPllRDiv = 1
          McuPllMul = 96
          McuPllIntClk = 2.5
          McuPllOutputClk = 320
          McuPllFreq = 160
          McuPllFmBwadj = 8
          McuPllFmMode = FM_Disabled
          McuPllFmNs = 1
          McuPllFmFs = 1.667
          McuPllFmNv = 1
          McuPllFmDepth = 0
          McuPllResetOnPllSlip = true
          McuPllBypassOnPllSlip = true
          McuPllResetOnOsciFail = true
        PLL2 (McuPll2Config): McuPll2RefClkDiv=5, McuPll2OdDiv=5, McuPll2RDiv=1, McuPll2Mul=100, McuPll2IntClk=4, McuPll2OutputClk=400, McuPll2Freq=80
        ExtClkIn (McuExtClocks): McuExtClk1Freq=80, McuExtClk2Freq=80
        McuClocks
          McuClockSrc:
            McuUseOsciClk = true
            McuUsePllClk = true
            McuUse32KhzOsciClk = false
            McuUseExtClk1 = false
            McuUseLpoLow = true
            McuUseLpoHigh = true
            McuUsePll2Clk = false
            McuUseExtClk2 = false
            McuUseGclk = true
            McuUseHclk = true
            McuUseVclkp = true
            McuUseVclk2 = true
            McuUseVclka1 = true
            McuUseVclka2 = true
            McuUseRtiClk1 = true
            McuUseVclk3 = true
            McuUseVclka4 = true
            McuUseVclka4Pre = false
            McuVclka1 = Vclk
            McuVclka2 = Vclk
            McuVclka4 = Vclk
            McuVclka4r = DivderbyOne
            McuRti1Div = DivderbyOne
            McuAVclk1Freq = 80
            McuAVclk2Freq = 80
            McuAVclk4sFreq = 80
            McuAVclk4divrFreq = 80
            McuRTI1Freq = 80
            McuRti1Src = Vclk
          ClockDomains (McuClockDomains):
            McuEclkSelector = VCLK
            McuEclkPrescaler = 0
            McuEclkSuspendMode = true
            McuGclkFreq = 160
            McuHclkFreq = 160
            McuVclkFreq = 80
            McuVclk2Freq = 80
            McuVclk3Freq = 80
            McuFrdCntlAswsten = 1
            McuFrdCntlRwait = 3
            McuGhvwake = PLL
            McuHvlpm = PLL
            McuGhvsrc = PLL
            McuTreeVclkDiv = 2
            McuTreeVclk2Div = 2
            McuTreeVclk3Div = 2
      McuModeConf (McuModeSettingConf): McuPowerMode=DozeMode, McuMode=0
      McuRamConf (McuRamSectorSettingConf): McuRamDefaultValue=0, McuRamBaseAddress=134217728, McuRamSectionSize=81920, McuCopyRomToRam=false, McuRomBaseAddress=0
  module config Xcp: implementation-config-variant=VARIANT-PRE-COMPILE, module-description=Xcp_Impl
    XcpGeneral:
      XcpStationIdentifier = 
      XcpCommandParameterCheck = true
      XcpUseAsrFileNames = false
      XcpEventCodes = false
      XcpBootloaderDownload = false
      XcpMemoryWriteProtection = true
      XcpMemoryReadProtection = true
      XcpControl = false
      XcpGetDataPointer = false
      XcpOpenCommandInterface = false
      XcpUserConfigFile = ..\..\..\Tools\AsrProject\Config\User\Xcp_User.cfg
      XcpEEPROMReadAccess = false
      XcpEEPROMWriteAccess = false
      XcpSynchronousDataAquisition = true
      XcpSendQueue = true
      XcpMemorySize = 512
      XcpPrescaler = true
      XcpOverrunIndication = true
      XcpWriteDAQMultiple = true
      XcpDAQODTMessageHeader = false
      XcpResumeMode = false
      XcpGeneralInfo = true
      XcpResolutionInfo = true
      XcpSynchronousDataStimulation = false
      XcpNumberofODTsforSTIM = 255
      XcpEventInfo = true
      XcpDAQTimestamp = true
      XcpFixedTimestamp = false
      XcpTimestampUnit = DAQ_TIMESTAMP_UNIT_1US
      XcpTimestampTicksPerUnit = 1
      XcpCommunicationModeInfo = true
      XcpSeedKey = false
      XcpModifyBits = false
      XcpShortDownload = true
      XcpUserDefinedCommand = true
      XcpTransferMAPFilenames = false
      XcpTransportLayerCommand = false
      XcpBlockUpload = true
      XcpBlockDownload = true
      XcpMIN_STForBlockDownload = 40
      XcpChecksum = false
      XcpAUTOSARCRCModuleSupport = false
      XcpCRCCalculationMethod = ADD_12
      XcpCRCBlockSize = 256
      XcpPageSwitching = false
      XcpGeneralPagingInfo = true
      XcpCopyPage = false
      XcpFreezeMode = false
      XcpProgramming = true
      XcpMinStPgm = 0
      XcpProcessorAndSectorInfo = false
      XcpServiceRequestMessage = false
      XcpPrintf = false
      XcpEnableCalibration = true
      XcpProgrammingWriteProtection = false
      XcpTimeStampSize = TIMESTAMP_SIZE_WORD
      Xcp_ReadCCConfig = false
      Xcp_ExtAddrReadCCConfig = 253
      XcpDevelopmentErrorDetection = false
      XcpGenericMeasurement = false
    XcpSector_0 (XcpSector): XcpStartAddress=0, XcpEndAddress=0
    XcpEvent_0 (XcpEvent): XcpName=2ms_DAQ, XcpCycleTime=2, XcpEventInfoUnit=DAQ_TIMESTAMP_UNIT_1MS, XcpDAQ=true, XcpSTIM=false
  module config CanXcp: implementation-config-variant=VARIANT-PRE-COMPILE, module-description=CanXcp_Impl
    CanXcpGeneral:
      CanXcpConfigurationVariant = (unset)
      CanXcpVersionInfoApi = false
      CanXcpDevErrorDetect = true
      CanXcpProdErrorDetect = false
      CanXcpVariableDlc = false
      CanXcpMultiConnectionProtection = false
      CanXcpStartAddress = 0
      CanXcpUsePduInfoType = true
      CanXcpUserConfigFile = 
      CAN00 (CanXcpChannelConfig): CanXcpComMChannelRef=ComM/CAN00
    CanXcp_Config (CanXcpConfig): CanXcpEcuMConfigurationRef=EcuMConfiguration
      CAN00 (CanXcpChannel)
        XcpSlave__CAN00 (CanXcpPdu)
          CanXcpPduDirection
            CanXcpTxPdu: CanXcpPduRef=CanIfInitConfiguration/XcpSlave__CAN00
        XcpMaster__CAN00 (CanXcpPdu)
          CanXcpPduDirection
            CanXcpRxPdu: CanXcpPduRef=CanIfInitConfiguration/XcpMaster__CAN00
  module config EtDmpFw: implementation-config-variant=VARIANT-POST-BUILD  # Configuration of the Nexteer EtDmpFw module.
    EtDmpFwGeneral
    CommonPublishedInformation: ArMajorVersion=3, ArMinorVersion=2, ArPatchVersion=0, SwMajorVersion=0, SwMinorVersion=0, SwPatchVersion=0, ModuleId=0, VendorId=0
  module config BkCpPc: implementation-config-variant=VARIANT-POST-BUILD  # Configuration of the Nexteer BkCpPc module.
    BkCpPcGeneral: BkCpPcPwrDiscConfiguration=1
    CommonPublishedInformation: ArMajorVersion=3, ArMinorVersion=2, ArPatchVersion=0, SwMajorVersion=0, SwMinorVersion=0, SwPatchVersion=0, ModuleId=0, VendorId=0
  module config NvMMgr: implementation-config-variant=VARIANT-POST-BUILD  # Configuration of the Nexteer NvM Manager module.
    NvMMgrGeneral: EcuStartupApp=Ap_9, NvMandMemIfApp=Ap_9
    CommonPublishedInformation: ArMajorVersion=3, ArMinorVersion=2, ArPatchVersion=0, SwMajorVersion=0, SwMinorVersion=0, SwPatchVersion=0, ModuleId=0, VendorId=0
  module config DigMSB: implementation-config-variant=VARIANT-POST-BUILD  # Configuration of the Nexteer DigMSB module.
    DigMSBGeneral
    CommonPublishedInformation: ArMajorVersion=3, ArMinorVersion=2, ArPatchVersion=0, SwMajorVersion=0, SwMinorVersion=0, SwPatchVersion=0, ModuleId=0, VendorId=0
  module config DigHwTrqSENT: implementation-config-variant=VARIANT-POST-BUILD  # Configuration of the Nexteer DigHwTrqSENT module.
    DigHwTrqSENTGeneral
    CommonPublishedInformation: ArMajorVersion=3, ArMinorVersion=2, ArPatchVersion=0, SwMajorVersion=0, SwMinorVersion=0, SwPatchVersion=0, ModuleId=0, VendorId=0
  module config AbsHwPos: implementation-config-variant=VARIANT-POST-BUILD  # Configuration of the Nexteer AbsHwPos module.
    AbsHwPosGeneral
    CommonPublishedInformation: ArMajorVersion=3, ArMinorVersion=2, ArPatchVersion=0, SwMajorVersion=0, SwMinorVersion=0, SwPatchVersion=0, ModuleId=0, VendorId=0
  module config Sweep: implementation-config-variant=VARIANT-POST-BUILD  # Configuration of the Nexteer Sweep module.
    SweepGeneral
    CommonPublishedInformation: ArMajorVersion=3, ArMinorVersion=2, ArPatchVersion=0, SwMajorVersion=0, SwMinorVersion=0, SwPatchVersion=0, ModuleId=0, VendorId=0
  module config Sweep2: implementation-config-variant=VARIANT-POST-BUILD  # Configuration of the Nexteer Sweep2 module.
    Sweep2General
    CommonPublishedInformation: ArMajorVersion=3, ArMinorVersion=2, ArPatchVersion=0, SwMajorVersion=0, SwMinorVersion=0, SwPatchVersion=0, ModuleId=0, VendorId=0
  module config Vmm: implementation-config-variant=VARIANT-PRE-COMPILE, module-description=Vmm_Impl
    VmmGeneral: VmmDevErrorDetect=false, VmmEcuPassiveMode=false, VmmEcuMConfigurationRef=EcuMConfiguration
      CAN00 (VmmChannel): VmmNetworkHandle=ComM/CAN00
    VectorCommonData: BswmdVersion=1.06.01
  module config SpiNxt: implementation-config-variant=VARIANT-PRE-COMPILE  # Configuration of the Nexteer SPI handler driver module
    SpiNxtGeneral: SpiNxtUseWith=D_SPINXT_USEWITHDIGMSB, SpiNxtUseDMA=STD_ON
  module config ComplErr: implementation-config-variant=VARIANT-POST-BUILD  # Configuration of the Nexteer ComplErr module.
    ComplErrGeneral
    CommonPublishedInformation: ArMajorVersion=3, ArMinorVersion=2, ArPatchVersion=0, SwMajorVersion=0, SwMinorVersion=0, SwPatchVersion=0, ModuleId=0, VendorId=0
  module config VehDyn: implementation-config-variant=VARIANT-POST-BUILD  # Configuration of the Nexteer VehDyn module.
    VehDynGeneral
    CommonPublishedInformation: ArMajorVersion=3, ArMinorVersion=2, ArPatchVersion=0, SwMajorVersion=0, SwMinorVersion=0, SwPatchVersion=0, ModuleId=0, VendorId=0
  module config ApXcp: implementation-config-variant=VARIANT-POST-BUILD  # Configuration of the Nexteer Xcp module.
    XcpGeneral: ExternalEEPROMAccess=STD_OFF, XcpIncludes=NtWrap.h, XcpRteEvents=XcpEventChannel_2ms_DAQ_2
    XcpMemoryAccess
      Flash (InternalMemoryRng): IntMemRngLow=0, IntMemRngHigh=786431
      RAM (InternalMemoryRng): IntMemRngLow=134217728, IntMemRngHigh=134348799
    RamCopy
    TuneOnTheFly: TuneOnTheFlySupport=STD_OFF, RamBlockSize=4
      Seg0_Pers: Seg0Enable=STD_OFF, MaxPerCopy=1, CalConstNumOfPerSymbol=D_NUMOFPERS_CNT_U16, TuneOnTheFlyPersLkup=STD_OFF
      Seg1_Sets: Seg1Enable=STD_OFF, MaxSetCopy=1, CalConstNumOfSetSymbol=D_NUMOFTUNSETS_CNT_U16, TuneOnTheFlySetLkup=STD_OFF
      Seg2_Common: Seg2Enable=STD_OFF
      Seg3_SetAndPer: Seg3Enable=STD_OFF
      Seg4_SetAndPerAndCommon: Seg4Enable=STD_OFF
    CommonPublishedInformation: ArMajorVersion=3, ArMinorVersion=2, ArPatchVersion=0, SwMajorVersion=0, SwMinorVersion=0, SwPatchVersion=0, ModuleId=0, VendorId=0
  module config NvMProxy: implementation-config-variant=VARIANT-PRE-COMPILE  # Configuration of the NvM Proxy module
    NvMProxyConfigSet
      14 x NvMProxyBlock:
        ShCurrCal: NvmRamBlockDataAddressSecure=Rte_CmMtrCurr_ShCurrCal, InitBlockHandling=CRC16, InitCheckFailResponse=SetNTC_0x07_LoadROMDefaults, ROMDefault_Or_NotificationFunction_Symbol=T_ShCurrCalInit_Cnt_str, NvMRamGlobalShared=false, NvmBlockDescriptorRef=Rte_NvmBlock_CmMtrCurr_ShCurrCal
        TorqueCmdSF: NvmRamBlockDataAddressSecure=Rte_TrqCmdScl_TorqueCmdSF_Uls_f32, InitBlockHandling=Redundant, InitCheckFailResponse=SetNTC_0x07_LoadROMDefaults, ROMDefault_Or_NotificationFunction_Symbol=T_TorqueCmdSFInit_Uls_f32, NvMRamGlobalShared=false, NvmBlockDescriptorRef=Rte_NvmBlock_TrqCmdScl_TorqueCmdSF_Uls_f32
        Polarity: NvmRamBlockDataAddressSecure=Rte_Polarity_Polarity_Cnt_Str, InitBlockHandling=None, InitCheckFailResponse=N/A, ROMDefault_Or_NotificationFunction_Symbol=NULL_PTR, NvMRamGlobalShared=false, NvmBlockDescriptorRef=Rte_NvmBlock_Polarity_Polarity_Cnt_Str
        CloseCheckData: NvmRamBlockDataAddressSecure=CloseCheck_Cnt_u32, InitBlockHandling=None, InitCheckFailResponse=N/A, ROMDefault_Or_NotificationFunction_Symbol=NULL_PTR, NvMRamGlobalShared=false, NvmBlockDescriptorRef=Rte_NvmBlock_StaMd_CloseCheckData
        TypeHRamBuffer: NvmRamBlockDataAddressSecure=TypeHData_Cnt_u08, InitBlockHandling=None, InitCheckFailResponse=N/A, ROMDefault_Or_NotificationFunction_Symbol=NULL_PTR, NvMRamGlobalShared=true, NvmBlockDescriptorRef=Rte_NvmBlock_StaMd_TypeHRamBuffer
        CogTrqCal: NvmRamBlockDataAddressSecure=Rte_TrqCanc_CogTrqCal, InitBlockHandling=CRC16, InitCheckFailResponse=SetNTC_0x07_LoadROMDefaults, ROMDefault_Or_NotificationFunction_Symbol=T_CogTrqCalInit_Cnt_u16, NvMRamGlobalShared=false, NvmBlockDescriptorRef=Rte_NvmBlock_TrqCanc_CogTrqCal
        EOLNomMtrParam: NvmRamBlockDataAddressSecure=Rte_CurrParamComp_EOLNomMtrParam, InitBlockHandling=None, InitCheckFailResponse=N/A, ROMDefault_Or_NotificationFunction_Symbol=NULL_PTR, NvMRamGlobalShared=false, NvmBlockDescriptorRef=Rte_NvmBlock_CurrParamComp_EOLNomMtrParam
        DigTrqTrim: NvmRamBlockDataAddressSecure=Rte_DigHwTrqSENT_DigTrqTrim, InitBlockHandling=CRC16, InitCheckFailResponse=SetNTC_0x0A, ROMDefault_Or_NotificationFunction_Symbol=NULL_PTR, NvMRamGlobalShared=false, NvmBlockDescriptorRef=Rte_NvmBlock_DigHwTrqSENT_DigTrqTrim
        DigMSBEOLData: NvmRamBlockDataAddressSecure=Rte_DigMSB_DigMSBEOLData, InitBlockHandling=None, InitCheckFailResponse=SetNTC_0x0A, ROMDefault_Or_NotificationFunction_Symbol=NULL_PTR, NvMRamGlobalShared=false, NvmBlockDescriptorRef=Rte_NvmBlock_DigMSB_DigMSBEOLData
        EOLVehCntrOffset: NvmRamBlockDataAddressSecure=Rte_AbsHwPos_EOLVehCntrOffset, InitBlockHandling=CRC16, InitCheckFailResponse=SetNTC_0x08_LoadROMDefaults, ROMDefault_Or_NotificationFunction_Symbol=T_EOLVehCntrOffsetInit_Cnt_str, NvMRamGlobalShared=false, NvmBlockDescriptorRef=Rte_NvmBlock_AbsHwPos_EOLVehCntrOffset
        CogTrqRplComp: NvmRamBlockDataAddressSecure=Rte_TrqCanc_CogTrqRplComp, InitBlockHandling=CRC16, InitCheckFailResponse=SetNTC_0x07_LoadROMDefaults, ROMDefault_Or_NotificationFunction_Symbol=T_CogTrqRplCompInit_Cnt_u16, NvMRamGlobalShared=false, NvmBlockDescriptorRef=Rte_NvmBlock_TrqCanc_CogTrqRplComp
        CurrTempOffset: NvmRamBlockDataAddressSecure=Rte_CmMtrCurr_CurrTempOffset, InitBlockHandling=ZeroData, InitCheckFailResponse=N/A, ROMDefault_Or_NotificationFunction_Symbol=NULL_PTR, NvMRamGlobalShared=false, NvmBlockDescriptorRef=Rte_NvmBlock_CmMtrCurr_CurrTempOffset
        SteerAsstDefeat: NvmRamBlockDataAddressSecure=Rte_AstLmt_SteerAsstDefeat, InitBlockHandling=ZeroData, InitCheckFailResponse=N/A, ROMDefault_Or_NotificationFunction_Symbol=NULL_PTR, NvMRamGlobalShared=false, NvmBlockDescriptorRef=Rte_NvmBlock_AstLmt_SteerAsstDefeat
        MotPosReset: NvmRamBlockDataAddressSecure=Rte_VehDyn_MotPosReset, InitBlockHandling=None, InitCheckFailResponse=N/A, ROMDefault_Or_NotificationFunction_Symbol=NULL_PTR, NvMRamGlobalShared=false, NvmBlockDescriptorRef=Rte_NvmBlock_VehDyn_MotPosReset
    NvMProxyGeneral: NvMProxyIncludes=Ap_StaMd_Cfg.h, FailureAPI=NxtrDiagMgr10_ReportNTCStatus, NvMProxyDevErrorDetect=false
    CommonPublishedInformation: ArMajorVersion=1, ArMinorVersion=2, ArPatchVersion=0, SwMajorVersion=1, SwMinorVersion=0, SwPatchVersion=0, ModuleId=104, VendorId=0
