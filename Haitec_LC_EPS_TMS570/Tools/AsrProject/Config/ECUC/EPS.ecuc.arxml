[part 1 of 3: package /ActiveEcuC]
AUTOSAR XML (schema 3.0.2)
package /ActiveEcuC
  ecu configuration ActiveEcuC: ecu-extract=System, module=[Can, CanIf, CanSM, Com, PduR, EcuC, ComM, EcuM, GenyBaseEnv, Board, GenyAsrBase_Cfg, ActivePull, Assist, AssistFirewall, AstLmt, AvgFricLrn, BatteryVoltage, BVDiag, CmMtrCurr, Crc, CtrldDisShtdn, CtrlTemp, CurrCmd, CurrParamComp, Damping, DampingFirewall, DiagMgr, DigPhsReasDiag, Dio, ElePwr, EOTActuatorMng, Fee, FlsTst, FrqDepDmpnInrtCmp, Gpt, Gsod, HighFreqAssist, HiLoadStall, HwPwUp, HystComp, IoHwAb, LmtCod, LrnEOT, MemIf, MtrDrvDiag, MtrTempEst, MtrVel, MtrVel2, NvM, Os, OvrVoltMon, PeakCurrEst, PICurrCntrl, Polarity, Port, PwrLmtFuncCr, QuadDet, Return, ReturnFirewall, Rte, ShtdnMech, SignlCondn, StabilityComp, StabilityComp2, StaMd, StOpCtrl, ThrmlDutyCycle, TmprlMon, TmprlMon2, TqRsDg, TrqCanc, TrqCmdScl, TuningSelAuth, uDiag, VehPwrMd, VehSpdLmt, WdgIf, WdgM, Wdg_internal_TMS570LS3x, Dem, Dcm, CanTp, Mcu, Xcp, CanXcp, EtDmpFw, BkCpPc, NvMMgr, DigMSB, DigHwTrqSENT, AbsHwPos, Sweep, Sweep2, Vmm, SpiNxt, ComplErr, VehDyn, ApXcp, NvMProxy]
  module config Can: implementation-config-variant=VARIANT-PRE-COMPILE, module-description=Can_Impl  # This container holds the configuration of a single CAN Driver.
    CanConfigSet
      CAN00 (CanController):
        CanBusoffProcessing = INTERRUPT
        CanControllerActivation = true
        CanControllerBaudRate = 500
        CanControllerId = 0
        CanControllerPropSeg = 0
        CanControllerSeg1 = 13
        CanControllerSeg2 = 3
        CanControllerTimeQuanta = 0
        CanRxProcessing = POLLING
        CanTxProcessing = INTERRUPT
        CanWakeupProcessing = INTERRUPT
        CanWakeupSourceId = 0
        CANBaseAddress = 4294433792
        CanNumberOfBasicCANObjects = 2
        CanMailboxPerBasicCANObjects = 2
        CanCommonCAN = false
        CanPnControllerEnable = false
        CanFilterMask_0 (CanFilterMask): CanFilterMaskValue=0
        InitStructure_0 (CanInitStructure): CBT0=137, CBT1=43, CBT2=0, Baudrate=500000
          Filter_0 (CanAcceptanceFilter): IsLocked=false, Mask=0, Code=0
        CanFilterMask_RxFullcan (CanFilterMask): CanFilterMaskValue=0
      17 x CanHardwareObject, all with CanIdType=STANDARD, CanControllerRef=CanConfigSet/CAN00:
        CanHardwareObject_0: CanObjectId=0, CanObjectType=TRANSMIT, CanHandleType=FULL, CanIdValue=922
        CanHardwareObject_1: CanObjectId=1, CanObjectType=TRANSMIT, CanHandleType=FULL, CanIdValue=926
        CanHardwareObject_2: CanObjectId=2, CanObjectType=TRANSMIT, CanHandleType=FULL, CanIdValue=1765
        CanHardwareObject_3: CanObjectId=3, CanObjectType=TRANSMIT, CanHandleType=FULL, CanIdValue=1799
        CanHardwareObject_4: CanObjectId=4, CanObjectType=TRANSMIT, CanHandleType=FULL, CanIdValue=1970
        CanHardwareObject_5: CanObjectId=5, CanObjectType=TRANSMIT, CanHandleType=FULL, CanIdValue=2033
        CanHardwareObject_6: CanObjectId=6, CanObjectType=TRANSMIT, CanHandleType=BASIC, CanIdValue=0
        CanHardwareObject_7: CanObjectId=8, CanObjectType=RECEIVE, CanHandleType=FULL, CanIdValue=2032, CanFilterMaskRef=CanFilterMask_RxFullcan
        CanHardwareObject_8: CanObjectId=9, CanObjectType=RECEIVE, CanHandleType=FULL, CanIdValue=2000, CanFilterMaskRef=CanFilterMask_RxFullcan
        CanHardwareObject_9: CanObjectId=10, CanObjectType=RECEIVE, CanHandleType=FULL, CanIdValue=1906, CanFilterMaskRef=CanFilterMask_RxFullcan
        CanHardwareObject_10: CanObjectId=11, CanObjectType=RECEIVE, CanHandleType=FULL, CanIdValue=1792, CanFilterMaskRef=CanFilterMask_RxFullcan
        CanHardwareObject_11: CanObjectId=12, CanObjectType=RECEIVE, CanHandleType=FULL, CanIdValue=1685, CanFilterMaskRef=CanFilterMask_RxFullcan
        CanHardwareObject_12: CanObjectId=13, CanObjectType=RECEIVE, CanHandleType=FULL, CanIdValue=1056, CanFilterMaskRef=CanFilterMask_RxFullcan
        CanHardwareObject_13: CanObjectId=14, CanObjectType=RECEIVE, CanHandleType=FULL, CanIdValue=864, CanFilterMaskRef=CanFilterMask_RxFullcan
        CanHardwareObject_14: CanObjectId=15, CanObjectType=RECEIVE, CanHandleType=FULL, CanIdValue=790, CanFilterMaskRef=CanFilterMask_RxFullcan
        CanHardwareObject_15: CanObjectId=16, CanObjectType=RECEIVE, CanHandleType=BASIC, CanIdValue=0, CanFilterMaskRef=CanFilterMask_0
        CanHardwareObject_16: CanObjectId=16, CanObjectType=RECEIVE, CanHandleType=BASIC, CanIdValue=0, CanFilterMaskRef=CanFilterMask_0
    CanGeneral:
      CanDevErrorDetection = true
      CanHardwareCancellation = false
      CanIndex = 0
      CanMultiplexedTransmission = false
      CanTimeoutDurationFactor = 10000
      CanVersionInfoApi = false
      CanWakeupSupport = false
      CanProdErrorDetection = true
      CanGenericPrecopy = false
      CanDevTimeoutDetect = false
      CanHardwareLoopCheck = true
      CanSecureTempBuffer = false
      CanBaudrateQuartzFrequency = 80000
      CanRxFullCANSupport = true
      CanTxFullCANSupport = true
      CanRxBasicCANSupport = true
      CanUseNestedCANInterrupts = false
      CanHardwareCancelByAppl = false
      CanIndividualProcessing = false
      CanPowerDownModeSelect = Local
      CanGenericConfirmation = false
      CanRxQueue = false
      CanSupportMixedID = false
      CanRxQueueSize = 3
      CanMultipleBasicCANObjects = false
      CanHardwareHandleType = UINT8
      CanDynamicFullCANTxID = true
      CanOptimizeOneController = false
      CanErrata22Iterations = 255
      CanInterruptCategory = CATEGORY2
      CanGetStatus = true
      CanInterruptLock = DRIVER
      CanPnEnable = false
      CanRamCheck = None
      CanOverrunNotification = None
      CanReinitStart = false
      CanGenericPreTransmit = false
      CanIdenticalIdCancellation = true
      CanAmdRuntimeMeasurement = false
      CanUserConfigFile = 
    VectorCommonData: BswmdVersion=2.11.00
  module config CanIf: implementation-config-variant=VARIANT-PRE-COMPILE, module-description=CanIf_Impl  # This container includes all necessary configuration sub-containers according the CAN Interface configuration structure.
    CT_CAN00 (CanIfControllerConfig):
      CanIfWakeupSupport = NO_WAKEUP
      CanIf_DoubleHashRandom1 = 0
      CanIf_DoubleHashRandom2 = 0
      CanIfPnEnableChannelSpecific = false
      CanIfDriverNameRef = CanIfDriverConfig
      CanIfControllerIdRef = CanConfigSet/CAN00
      CanIfInitControllerRef = (unset)
      CanIfPnTxFilterWufRxNSduRef = (unset)
    CanIfDispatchConfig: CanIfBusOffNotification=CanSM_ControllerBusOff, CanIfWakeupNotification=EcuM_SetWakeupEvent
    CanIfDriverConfig:
      CanIfBusoffNotification = true
      CanIfReceiveIndication = true
      CanIfTransmitCancellation = false
      CanIfTxConfirmation = true
      CanIfWakeupNotification = true
      CanIfDriverNameRef = CanGeneral
      CanIfInitHohConfigRef = CanIfInitHohConfig
    CanIfInitConfiguration: CanIfConfigSet=initConfiguration, CanIfNumberOfCanRxPduIds=8, CanIfNumberOfCanTXPduIds=6, CanIfNumberOfDynamicCanTXPduIds=0
      CT_CAN00 (CanIfInitControllerConfig): CanIfControllerRefConfigSet=CanConfigSet/CAN00
      CanIfInitHohConfig: CanIfRefConfigSet=CanConfigSet
        7 x CanIfHthConfig, all with CanIfCanControllerIdRef=CanIf/CT_CAN00:
          CanIfHthConfig_{0..5}: CanIfHthType=FULL_CAN, CanIfHthIdSymRef=CanHardwareObject_{0..5}
          CanIfHthConfig_6: CanIfHthType=BASIC_CAN, CanIfHthIdSymRef=CanHardwareObject_6
        10 x CanIfHrhConfig, all with CanIfCanControllerHrhIdRef=CanIf/CT_CAN00:
          CanIfHrhConfig_{7..14}: CanIfSoftwareFilterHrh=false, CanIfHrhType=FULL_CAN, CanIfHrhIdSymRef=CanHardwareObject_{7..14}
          CanIfHrhConfig_15: CanIfSoftwareFilterHrh=true, CanIfHrhType=BASIC_CAN, CanIfHrhIdSymRef=CanHardwareObject_15
          CanIfHrhConfig_16: CanIfSoftwareFilterHrh=true, CanIfHrhType=BASIC_CAN, CanIfHrhIdSymRef=CanHardwareObject_16
      ABS2__CAN00 (CanIfRxPduConfig):
        CanIfCanRxPduCanId = 864
        CanIfCanRxPduDlc = 8
        CanIfCanRxPduId = 1
        CanIfReadRxPduData = false
        CanIfReadRxPduNotifyStatus = false
        CanIfRxPduIdCanIdType = STANDARD_CAN
        CanIfRxUserType = PDUR
        CanIfUserRxIndication = PduR_CanIfRxIndication
        CanIf_DlcCheck = true
        CanIf_FullCANLocked = true
        CanIfUserDlcErrorNotification = Appl_DlcErrorNotification
        CanIfCanRxPduHrhRef = CanIfHrhConfig_13
        PduIdRef = PduCollection/ABS2__CAN00
      EPAS1__CAN00 (CanIfTxPduConfig):
        CanIfCanTxPduId = 5
        CanIfCanTxPduIdCanId = 922
        CanIfCanTxPduIdDlc = 8
        CanIfCanTxPduType = STATIC
        CanIfReadTxPduNotifyStatus = false
        CanIfTxPduIdCanIdType = STANDARD_CAN
        CanIfTxUserType = PDUR
        CanIfUserTxConfirmation = PduR_CanIfTxConfirmation
        CanIfCanTxPduHthRef = CanIfHthConfig_0
        PduIdRef = PduCollection/EPAS1__CAN00
      4 x CanIfRxPduConfig, all with CanIfCanRxPduDlc=8, CanIfReadRxPduData=false, CanIfReadRxPduNotifyStatus=false, CanIfRxPduIdCanIdType=STANDARD_CAN, CanIf_FullCANLocked=true, CanIfUserDlcErrorNotification=Appl_DlcErrorNotification:
        BCM1__CAN00: CanIfCanRxPduCanId=1056, CanIfCanRxPduId=0, CanIfRxUserType=PDUR, CanIfUserRxIndication=PduR_CanIfRxIndication, CanIf_DlcCheck=true, CanIfCanRxPduHrhRef=CanIfHrhConfig_12, PduIdRef=PduCollection/BCM1__CAN00
        ECM1__CAN00: CanIfCanRxPduCanId=790, CanIfCanRxPduId=2, CanIfRxUserType=PDUR, CanIfUserRxIndication=PduR_CanIfRxIndication, CanIf_DlcCheck=true, CanIfCanRxPduHrhRef=CanIfHrhConfig_14, PduIdRef=PduCollection/ECM1__CAN00
        DiagFuncReqFT_Tp__CAN00: CanIfCanRxPduCanId=2000, CanIfCanRxPduId=0, CanIfRxUserType=CAN_TP, CanIfUserRxIndication=CanTp_RxIndication, CanIf_DlcCheck=false, CanIfCanRxPduHrhRef=CanIfHrhConfig_8, PduIdRef=PduCollection/DiagFuncReqFT_Tp__CAN00
        DiagPhysReqToEPAS_Tp__CAN00: CanIfCanRxPduCanId=1906, CanIfCanRxPduId=1, CanIfRxUserType=CAN_TP, CanIfUserRxIndication=CanTp_RxIndication, CanIf_DlcCheck=false, CanIfCanRxPduHrhRef=CanIfHrhConfig_9, PduIdRef=PduCollection/DiagPhysReqToEPAS_Tp__CAN00
      3 x CanIfTxPduConfig, all with CanIfCanTxPduIdDlc=8, CanIfCanTxPduType=STATIC, CanIfReadTxPduNotifyStatus=false, CanIfTxPduIdCanIdType=STANDARD_CAN:
        EPAS2__CAN00: CanIfCanTxPduId=4, CanIfCanTxPduIdCanId=926, CanIfTxUserType=PDUR, CanIfUserTxConfirmation=PduR_CanIfTxConfirmation, CanIfCanTxPduHthRef=CanIfHthConfig_1, PduIdRef=PduCollection/EPAS2__CAN00
        XcpSlave__CAN00: CanIfCanTxPduId=3, CanIfCanTxPduIdCanId=1765, CanIfTxUserType=APPL, CanIfUserTxConfirmation=CanXcp_TxConfirmation, CanIfCanTxPduHthRef=CanIfHthConfig_2, PduIdRef=PduCollection/XcpSlave__CAN00
        DiagRespFromEPAS_Tp__CAN00: CanIfCanTxPduId=1, CanIfCanTxPduIdCanId=1970, CanIfTxUserType=CAN_TP, CanIfUserTxConfirmation=CanTp_TxConfirmation, CanIfCanTxPduHthRef=CanIfHthConfig_4, PduIdRef=PduCollection/DiagRespFromEPAS_Tp__CAN00
      GliwaMaster__CAN00 (CanIfRxPduConfig):
        CanIfCanRxPduCanId = 2032
        CanIfCanRxPduDlc = 8
        CanIfRxPduIdCanIdType = STANDARD_CAN
        CanIfRxUserType = APPL
        CanIfCanRxPduId = 0
        CanIfReadRxPduData = false
        CanIfReadRxPduNotifyStatus = false
        CanIfUserRxIndication = GliwaT1_MsgProcess_RxT1HostToTarget
        CanIf_DlcCheck = true
        CanIfUserDlcErrorNotification = Appl_DlcErrorNotification
        CanIf_FullCANLocked = true
        CanIfCanRxPduHrhRef = CanIfHrhConfig_7
        PduIdRef = PduCollection/GliwaMaster__CAN00
      GliwaSlave__CAN00 (CanIfTxPduConfig):
        CanIfCanTxPduIdCanId = 2033
        CanIfCanTxPduIdDlc = 8
        CanIfCanTxPduType = STATIC
        CanIfTxPduIdCanIdType = STANDARD_CAN
        CanIfTxUserType = APPL
        CanIfCanTxPduId = 0
        CanIfReadTxPduNotifyStatus = false
        CanIfCanTxPduHthRef = CanIfHthConfig_5
        PduIdRef = PduCollection/GliwaSlave__CAN00
      XcpMaster__CAN00 (CanIfRxPduConfig):
        CanIfCanRxPduCanId = 1685
        CanIfCanRxPduDlc = 8
        CanIfRxPduIdCanIdType = STANDARD_CAN
        CanIfRxUserType = APPL
        CanIfCanRxPduId = 0
        CanIfReadRxPduData = false
        CanIfReadRxPduNotifyStatus = false
        CanIfUserRxIndication = CanXcp_RxIndication
        CanIf_DlcCheck = true
        CanIfUserDlcErrorNotification = Appl_DlcErrorNotification
        CanIf_FullCANLocked = true
        CanIfCanRxPduHrhRef = CanIfHrhConfig_11
        PduIdRef = PduCollection/XcpMaster__CAN00
      NMmBCM__CAN00 (CanIfRxPduConfig):
        CanIfCanRxPduCanId = 1792
        CanIfCanRxPduDlc = 8
        CanIfRxPduIdCanIdType = STANDARD_CAN
        CanIfRxUserType = APPL
        CanIfCanRxPduId = 0
        CanIfReadRxPduData = false
        CanIfReadRxPduNotifyStatus = false
        CanIfUserRxIndication = SrlComOutput_RxNM
        CanIf_DlcCheck = true
        CanIfUserDlcErrorNotification = Appl_DlcErrorNotification
        CanIf_FullCANLocked = true
        CanIfCanRxPduHrhRef = CanIfHrhConfig_10
        PduIdRef = PduCollection/NMmBCM__CAN00
      NMmEPAS__CAN00 (CanIfTxPduConfig):
        CanIfCanTxPduIdCanId = 1799
        CanIfCanTxPduIdDlc = 8
        CanIfCanTxPduType = STATIC
        CanIfTxPduIdCanIdType = STANDARD_CAN
        CanIfTxUserType = APPL
        CanIfCanTxPduId = 2
        CanIfReadTxPduNotifyStatus = false
        CanIfUserTxConfirmation = SrlComOutput_TxNM
        CanIfCanTxPduHthRef = CanIfHthConfig_3
        PduIdRef = PduCollection/NMmEPAS__CAN00
    CanIfPrivateConfiguration:
      CanIfDlcCheck = true
      CanIfNumberOfTxBuffers = 0
      CanIfNumberOfDynamicTxBuffers = 0
      CanIfSoftwareFilterType = LINEAR
      CanIf_TransceiverMapping = false
      CanIf_TransceiverHandling = false
      CanIf_SupportExtendedIds = false
      CanIf_UserConfigFile = 
      CanIf_TransmitCancellationAPI = true
      CanIf_SupportNmOsek = false
      CanIf_BusOffRecovery = false
      CanIf_ExtendedStateMachine = false
      CanIf_StartAddress = 0
      CanIf_MaxControllerTableSize = 0
      CanIf_Autosar21_ComM_Compliance = false
      CanIfDlcFailedReportDem = true
      CanIf_SupportConfigULPduIDCalc = false
      CanIf_AsrIfCan_IsLibrarySolution = true
      CanIfOptimizeOneController = false
      CanIf_DoubleHashAdjustCount = 0
      CanIf_DynamicTxBuffersApi = false
      CanIf_MaxNumberOfTxPDUs = 0
      CanIf_TxBufferAPI = None
      CanIfDlcCheckOptimization = false
    CanIfPublicConfiguration:
      CanIfDevErrorDetect = true
      CanIfMultipleDriverSupport = false
      CanIfNumberOfCanHwUnits = 1
      CanIfReadRxPduDataApi = false
      CanIfReadRxPduNotifyStatusApi = false
      CanIfReadTxPduNotifyStatusApi = false
      CanIfSetDynamicTxIdApi = false
      CanIfVersionInfoApi = true
      CanIfWakeupEventApi = true
      CanIfProdErrorDetect = true
      CanIfPnEnable = false
    VectorCommonData: BswmdVersion=2.17.04
    5 x CanIf_TxConfirmationFunction:
      CanIf_TxConfirmationFunction_0: CanIf_TxConfirmationFunctionName=NULL_PTR
      CanIf_TxConfirmationFunction_1: CanIf_TxConfirmationFunctionName=PduR_CanIfTxConfirmation
      CanIf_TxConfirmationFunction_2: CanIf_TxConfirmationFunctionName=CanTp_TxConfirmation
      CanIf_TxConfirmationFunction_3: CanIf_TxConfirmationFunctionName=CanXcp_TxConfirmation
      CanIf_TxConfirmationFunction_4: CanIf_TxConfirmationFunctionName=SrlComOutput_TxNM
    6 x CanIf_RxIndicationFunction, all with CanIf_AutoCalculateRxPduIds=true:
      CanIf_RxIndicationFunction_0: CanIf_RxIndicationFunctionType=TYPE_I_STANDARD, CanIf_RxIndicationFunctionName=NULL_PTR
      CanIf_RxIndicationFunction_1: CanIf_RxIndicationFunctionType=TYPE_I_STANDARD, CanIf_RxIndicationFunctionName=PduR_CanIfRxIndication
      CanIf_RxIndicationFunction_2: CanIf_RxIndicationFunctionType=TYPE_II_ADVANCED, CanIf_RxIndicationFunctionName=CanTp_RxIndication
      CanIf_RxIndicationFunction_3: CanIf_RxIndicationFunctionType=TYPE_II_ADVANCED, CanIf_RxIndicationFunctionName=CanXcp_RxIndication
      CanIf_RxIndicationFunction_4: CanIf_RxIndicationFunctionType=TYPE_I_STANDARD, CanIf_RxIndicationFunctionName=GliwaT1_MsgProcess_RxT1HostToTarget
      CanIf_RxIndicationFunction_5: CanIf_RxIndicationFunctionType=TYPE_I_STANDARD, CanIf_RxIndicationFunctionName=SrlComOutput_RxNM
    TrcvConfig_CAN00 (CanIfTransceiverDrvConfig): CanIfTrcvWakeupNotification=false
  module config CanSM: implementation-config-variant=VARIANT-PRE-COMPILE, module-description=CanSM_Impl  # Configuration of the CanSM module
    CanStateManagerConfiguration:
      CanSMBorCounterL1ToL2 = 5
      CanSMBorCounterL2Err = 8
      CanSMBorDisableRxDlMonitoring = false
      CanSMBorTimeL1 = 1
      CanSMBorTimeL2 = 3
      CanSMBorTimeTxEnsured = 5
      CanSMDevErrorDetect = true
      CanSMProdErrorDetect = true
      CanSMMainFctCycleTime = 0.01
      CanSMVersionInfoApi = true
      CanSMPostBuildConfigStartAddress = 0
      CanSMHwRepetition = 5
      CanSMEcuPassiveMode = false
      CanSMBusOffNotification = true
      CanSMDisableDMInSilentCom = true
      CanSMPartialNetwork = false
      CanSMBswMComModeIndication = false
      CanSMUserConfigurationFile = (unset)
      CAN00 (CanStateManagerNetworks):
        CanSMBorCounterL1ToL2Ch = 1
        CanSMBorCounterL2ErrCh = 2
        CanSMBorTimeL1Ch = 5
        CanSMBorTimeL2Ch = 5
        CanSMBorTimeTxEnsuredCh = 10
        CanSMBorDisableRxDlMonitoringCh = false
        CanSMDisableRxPduGroup = false
        CanSMDisableTxPduGroup = false
        CanSMInitializeTxPduData = false
        CanSMInitializeRxPduData = false
        CanSMIsPartialNetworkChannel = false
        CanSMNetworkHandle = ComM/CAN00
        CanSMRxPduGroupId = PduGrp_EPAS__CAN00_Rx
        CanSMTxPduGroupId = PduGrp_EPAS__CAN00_Tx
        CanSMTransceiverId = (unset)
        CT_CAN00 (CanStateManagerControllers): CanSMControllerId=CanConfigSet/CAN00
    VectorCommonData: BswmdVersion=1.13.02
  module config Com: implementation-config-variant=VARIANT-PRE-COMPILE, module-description=Com_Impl  # Configuration of the Com module.
    ComConfig: ComConfigurationId=0
      Pdu_ABS2__CAN00 (ComIPdu):
        ComIPduRxHandleId = 0
        ComIPduSignalProcessing = DEFERED
        ComIPduSize = 8
        ComIpduDirection = RECEIVE
        ComGenerate = true
        ComIPduGroupRef = PduGrp_EPAS__CAN00_Rx
        ComIPduSignalRef = ComConfig/Com_VehSpeed__ABS2__CAN00
        PduIdRef = PduCollection/ABS2__CAN00
      PduGrp_EPAS__CAN00_Rx (ComIPduGroup): ComIPduGroupHandleId=0
      Com_BCM_Key_Sta__BCM1__CAN00 (ComSignal):
        ComBitPosition = 7
        ComBitSize = 2
        ComFirstTimeoutFactor = 0
        ComHandleId = 0
        ComNotification = Appl_COMCbk_Com_BCM_Key_Sta__BCM1__CAN00
        ComRxDataTimeoutAction = NONE
        ComSignalEndianess = BIG_ENDIAN
        ComSignalInitValue = 0
        ComSignalType = UINT8
        ComTimeoutFactor = 0
        ComNotificationFlag = false
        ComTimeoutNotificationFlag = false
        ComStateOnFlag = false
        ComTransferProperty = PENDING
        ComIssmSignal = false
        ComInternal = false
        SystemTemplateSystemSignalRef = BCM_Key_Sta
        Com_BCM_Key_Sta__BCM1__CAN00 (ComFilter): ComFilterAlgorithm=ALWAYS, ComFilterMask=4294967295, ComFilterMax=0, ComFilterMin=0, ComFilterX=0
      4 x ComIPdu, all with ComIPduSignalProcessing=DEFERED, ComIPduSize=8, ComGenerate=true:
        Pdu_BCM1__CAN00: ComIPduRxHandleId=1, ComIpduDirection=RECEIVE, ComIPduGroupRef=PduGrp_EPAS__CAN00_Rx, ComIPduSignalRef=ComConfig/Com_BCM_Key_Sta__BCM1__CAN00, PduIdRef=PduCollection/BCM1__CAN00
        Pdu_ECM1__CAN00: ComIPduRxHandleId=2, ComIpduDirection=RECEIVE, ComIPduGroupRef=PduGrp_EPAS__CAN00_Rx, ComIPduSignalRef=ComConfig/Com_CAN_N__ECM1__CAN00, ComIPduSignalRef=ComConfig/Com_LV_CAN_N_ERR__ECM1__CAN00, PduIdRef=PduCollection/ECM1__CAN00
        Pdu_EPAS1__CAN00: ComIPduCallout=Appl_COMCout_Pdu_EPAS1__CAN00, ComIpduDirection=SEND, ComIPduGroupRef=PduGrp_EPAS__CAN00_Tx, ComIPduSignalRef=Com_SAS_Angle__EPAS1__CAN00, ComIPduSignalRef=Com_SAS_CAL__EPAS1__CAN00, ComIPduSignalRef=Com_SAS_CheckSum__EPAS1__CAN00, ComIPduSignalRef=Com_SAS_Init__EPAS1__CAN00, ComIPduSignalRef=Com_SAS_MsgCount__EPAS1__CAN00, ComIPduSignalRef=Com_SAS_OK__EPAS1__CAN00, PduIdRef=PduCollection/EPAS1__CAN00
          ComTxIPdu: ComTxIPduMinimumDelayTimeFactor=0, ComTxIPduUnusedAreasDefault=0, ComTxIPduTimeoutContext=COM_TRANSMIT
            ComTxModeFalse
              ComTxModeFalseFalse (ComTxMode): ComTxModeMode=PERIODIC, ComTxModeTimeOffsetFactor=0, ComTxModeTimePeriodFactor=10
            ComTxModeTrue
              ComTxModeTrueTrue (ComTxMode): ComTxModeMode=PERIODIC, ComTxModeNumberOfRepetitions=0, ComTxModeRepetitionPeriodFactor=0, ComTxModeTimeOffsetFactor=0, ComTxModeTimePeriodFactor=10
        Pdu_EPAS2__CAN00: ComIpduDirection=SEND, ComIPduGroupRef=PduGrp_EPAS__CAN00_Tx, ComIPduSignalRef=Com_Elect_PWR_Consumpt__EPAS2__CAN00, ComIPduSignalRef=Com_EpasFailed__EPAS2__CAN00, ComIPduSignalRef=Com_Steering_Torque__EPAS2__CAN00, ComIPduSignalRef=Com_Steering_Torque_V__EPAS2__CAN00, PduIdRef=PduCollection/EPAS2__CAN00, ComIPduSignalRef=Com_Rel_Steer_Wheel_Ang__EPAS2__CAN00, ComIPduSignalRef=Com_Rel_Steer_Wheel_Ang_Validity__EPAS2__CAN00
          ComTxIPdu: ComTxIPduMinimumDelayTimeFactor=0, ComTxIPduUnusedAreasDefault=0, ComTxIPduTimeoutContext=COM_TRANSMIT
            ComTxModeFalse
              ComTxModeFalseFalse (ComTxMode): ComTxModeMode=PERIODIC, ComTxModeTimeOffsetFactor=0, ComTxModeTimePeriodFactor=10
            ComTxModeTrue
              ComTxModeTrueTrue (ComTxMode): ComTxModeMode=PERIODIC, ComTxModeNumberOfRepetitions=0, ComTxModeRepetitionPeriodFactor=0, ComTxModeTimeOffsetFactor=0, ComTxModeTimePeriodFactor=10
      PduGrp_EPAS__CAN00_Tx (ComIPduGroup): ComIPduGroupHandleId=1
      15 x ComSignal, all with ComSignalEndianess=BIG_ENDIAN, ComTimeoutFactor=0, ComTransferProperty=PENDING, ComIssmSignal=false, ComInternal=false:
        Com_CAN_N__ECM1__CAN00: ComBitPosition=23, ComBitSize=16, ComFirstTimeoutFactor=0, ComHandleId=1, ComNotification=Appl_COMCbk_Com_CAN_N__ECM1__CAN00, ComRxDataTimeoutAction=NONE, ComSignalInitValue=0, ComSignalType=UINT16, ComNotificationFlag=false, ComTimeoutNotificationFlag=false, ComStateOnFlag=false, SystemTemplateSystemSignalRef=CAN_N
          Com_CAN_N__ECM1__CAN00 (ComFilter): ComFilterAlgorithm=ALWAYS, ComFilterMask=4294967295, ComFilterMax=0, ComFilterMin=0, ComFilterX=0
        Com_Elect_PWR_Consumpt__EPAS2__CAN00: ComBitPosition=7, ComBitSize=8, ComHandleId=4, ComSignalInitValue=0, ComSignalType=UINT8, SystemTemplateSystemSignalRef=Elect_PWR_Consumpt
        Com_EpasFailed__EPAS2__CAN00: ComBitPosition=15, ComBitSize=1, ComHandleId=5, ComSignalInitValue=0, ComSignalType=BOOLEAN, SystemTemplateSystemSignalRef=EpasFailed
        Com_LV_CAN_N_ERR__ECM1__CAN00: ComBitPosition=1, ComBitSize=1, ComFirstTimeoutFactor=0, ComHandleId=2, ComRxDataTimeoutAction=NONE, ComSignalInitValue=0, ComSignalType=BOOLEAN, ComNotificationFlag=false, ComTimeoutNotificationFlag=false, ComStateOnFlag=false, SystemTemplateSystemSignalRef=LV_CAN_N_ERR
          Com_LV_CAN_N_ERR__ECM1__CAN00 (ComFilter): ComFilterAlgorithm=ALWAYS, ComFilterMask=4294967295, ComFilterMax=0, ComFilterMin=0, ComFilterX=0
        Com_SAS_Angle__EPAS1__CAN00: ComBitPosition=7, ComBitSize=16, ComHandleId=8, ComSignalInitValue=9001, ComSignalType=UINT16, SystemTemplateSystemSignalRef=SAS_Angle
        Com_SAS_CAL__EPAS1__CAN00: ComBitPosition=25, ComBitSize=1, ComHandleId=9, ComSignalInitValue=0, ComSignalType=BOOLEAN, SystemTemplateSystemSignalRef=SAS_CAL
        Com_SAS_CheckSum__EPAS1__CAN00: ComBitPosition=35, ComBitSize=4, ComHandleId=10, ComSignalInitValue=0, ComSignalType=UINT8, SystemTemplateSystemSignalRef=SAS_CheckSum
        Com_SAS_Init__EPAS1__CAN00: ComBitPosition=47, ComBitSize=1, ComHandleId=11, ComSignalInitValue=0, ComSignalType=BOOLEAN, SystemTemplateSystemSignalRef=SAS_Init
        Com_SAS_MsgCount__EPAS1__CAN00: ComBitPosition=39, ComBitSize=4, ComHandleId=12, ComSignalInitValue=0, ComSignalType=UINT8, SystemTemplateSystemSignalRef=SAS_MsgCount
        Com_SAS_OK__EPAS1__CAN00: ComBitPosition=24, ComBitSize=1, ComHandleId=13, ComSignalInitValue=1, ComSignalType=BOOLEAN, SystemTemplateSystemSignalRef=SAS_OK
        Com_Steering_Torque__EPAS2__CAN00: ComBitPosition=23, ComBitSize=8, ComHandleId=15, ComSignalInitValue=128, ComSignalType=UINT8, SystemTemplateSystemSignalRef=Steering_Torque
        Com_Steering_Torque_V__EPAS2__CAN00: ComBitPosition=8, ComBitSize=1, ComHandleId=14, ComSignalInitValue=0, ComSignalType=BOOLEAN, SystemTemplateSystemSignalRef=Steering_Torque_V
        Com_VehSpeed__ABS2__CAN00: ComBitPosition=7, ComBitSize=12, ComFirstTimeoutFactor=0, ComHandleId=3, ComNotification=Appl_COMCbk_Com_VehSpeed__ABS2__CAN00, ComRxDataTimeoutAction=NONE, ComSignalInitValue=0, ComSignalType=UINT16, ComNotificationFlag=false, ComTimeoutNotificationFlag=false, ComStateOnFlag=false, SystemTemplateSystemSignalRef=VehSpeed
          Com_VehSpeed__ABS2__CAN00 (ComFilter): ComFilterAlgorithm=ALWAYS, ComFilterMask=4294967295, ComFilterMax=0, ComFilterMin=0, ComFilterX=0
        Com_Rel_Steer_Wheel_Ang__EPAS2__CAN00: ComBitPosition=47, ComBitSize=16, ComHandleId=7, ComSignalInitValue=20000, ComSignalType=UINT16, ComNotification=Appl_COMCbkTAck_Com_Rel_Steer_Wheel_Ang__EPAS2__CAN00, SystemTemplateSystemSignalRef=Rel_Steer_Wheel_Ang
        Com_Rel_Steer_Wheel_Ang_Validity__EPAS2__CAN00: ComBitPosition=14, ComBitSize=1, ComHandleId=6, ComSignalInitValue=0, ComSignalType=UINT8, SystemTemplateSystemSignalRef=Rel_Steer_Wheel_Ang_Validity
    ComGeneral:
      ComProtectIndicationFlags = true
      ComResetTimeoutFlags = false
      ComProtectTimeoutFlags = true
      ComEnableRx = true
      ComEnableTx = true
      ComMissingSourceValueHandling = false
      ComEnableSignalInterface = true
      ComGwTriggerTxOnInvalidation = false
      ComGwInvalidateTxOnRxTimeout = false
      ComQueueFailedTransmitRequests = true
      ComGwCanMost = false
      ComGwStopTxOnRxTimeout = false
      ComLargeComIPdus = true
      ComBAC21Compatibility = false
      ComGw03ConsistencyCheck = true
      ComGetConfigurationStringPtrApi = true
      ComMainFunctionTxApi = true
      ComMainFunctionRxApi = true
      ComShowError0005AsWarning = true
      ComVStdLibMemApi = false
      ComTriggerTransmissionByCom = true
      ComOptimizeIdTypes = true
      ComRxSignalWriteAccess = true
      ComTsiTestCode = false
      ComIPduGroupTransmit = false
      ComEnableLoTxConfirmation = true
      ComTmsSupport = true
      ComLargeSignalSupport = true
      ComTransportProtocolSupport = true
      ComEnableTimeoutFlags = false
      ComEnableIndicationFlags = false
      ComEnableStateOnFlags = false
      ComSignalConversionInterface = false
      ComIsLibrary = false
      ComEnableUpdateBitSupport = true
      ComEnableSignalGroupInterface = true
      ComConfigurationTimeBase = 0.001
      ComConfigurationRxTimeBase = 0.01
      ComConfigurationTxTimeBase = 0.01
      ComConfigurationUseDet = true
      ComVersionInfoApi = true
      ComConfigurationUseDem = true
      ComUseRte = true
      ComSignalAccessMacroApi = false
      ComTriggerTransmitApi = true
      ComTriggerIPDUSendApi = true
      ComGetConfigurationIdApi = true
      ComGetStatusApi = true
      ComReceptionDMApi = true
      ComDeInitApi = true
      ComSignalInvalidationApi = true
      ComPBStartAddress = 0
      ComMaxNumberOfRxIPdus = 1
      ComMaxNumberOfTxIPdus = 1
      ComMaxNumberOfRxUpdateBits = 1
      ComBufferSize = 0
      ComGwSuspendIsrPerPdu = true
      ComMaxRxIPduLength = 8
      ComEnableReceptionFiltering = true
      ComMaxNumberOfTxSignalGroups = 1
      ComTxTimeoutForTxModeNoneSupport = false
      ComMultipleIPduGroupRefSupport = true
      ComUsePduInfoType = false
      ComDynamicDlcSupport = false
      ComNotiFctRxPrefix = Appl_COMCbk_
      ComNotiFctTxPrefix = Appl_COMCbkTAck_
      ComTimeoutNotiFctRxPrefix = Appl_COMCbkTOut_
      ComInvalidNotiFctRxPrefix = Appl_COMCbkInv_
      ComErrorNotiFctTxPrefix = Appl_COMCbkTErr_
      ComIpduCalloutFctPrefix = Appl_COMCout_
      ComIndicationFlagPostfix = IndicationFlag
      ComTimeoutFlagPostfix = TimeoutFlag
      ComStateOnFlagPostfix = StateOnFlag
      ComTimeoutNotiFctTxPrefix = Appl_COMCbkTOut_
      ComUserConfigFile = 
      ComConfigurationString = 
    VectorCommonData: BswmdVersion=3.15.01
  module config PduR: implementation-config-variant=VARIANT-PRE-COMPILE, module-description=PduR_Impl  # Configuration of the PduR (PDU Router) module.
    CanIf (PduRBswModules):
      PduRCommunicationInterface = true
      PduRLowerModule = true
      PduRTransportProtocol = false
      PduRTriggertransmit = false
      PduRUpperModule = false
      PduRCancelReceive = false
      PduRCancelTransmit = false
      PduRChangeParameterRequestApi = false
    PduRGeneral:
      PduRCanIfSupport = true
      PduRCanTpSupport = true
      PduRMostTpSupport = false
      PduRMostIfSupport = false
      PduRComSupport = true
      PduRDcmSupport = true
      PduRDevErrorDetect = true
      PduRFifoTxBufferSupport = false
      PduRFrIfSupport = false
      PduRFrTpSupport = false
      PduRGatewayOperation = false
      PduRIpduMSupport = false
      PduRLinIfSupport = false
      PduRLinTpSupport = false
      PduRMemorySize = 0
      PduRMulticastFromIfSupport = false
      PduRMulticastFromTpSupport = false
      PduRMulticastToIfSupport = false
      PduRMulticastToTpSupport = false
      PduRSbTxBufferSupport = false
      PduRVersionInfoApi = true
      PduRZeroCostOperation = false
      PduRPBStartAddress = 0
      PduRProdErrorDetect = true
      PduRRouting2CSFSupport = false
      PduRMaxNumberOfRxCanTpPdus = 1
      PduRMaxNumberOfRxFrTpPdus = 1
      PduRJ1939Support = false
      PduRApplIfSupport = false
      PduRApplTpSupport = false
      PduRSoAdSupport = false
      PduRApplTpReceiveCancellation = false
      PduRDcmReceiveCancellation = false
      PduRFrTpReceiveCancellation = false
      PduRCanTpReceiveCancellation = false
      PduRLinTpReceiveCancellation = false
      PduRApplTpTransmitCancellation = false
      PduRDcmTransmitCancellation = false
      PduRFrTpTransmitCancellation = false
      PduRCanTpTransmitCancellation = false
      PduRLinTpTransmitCancellation = false
      PduRCanNmSupport = false
      PduRNmOsekSupport = false
      PduRFrNmSupport = false
      PduRMaxRoutingPathGroups = 1
      PduRMaxRoutingPathsInRPGs = 1
      PduRRoutingPathGroupSupport = false
      PduRFrTp2ProvideRxBufferCalls = false
      PduRCanTp2ProvideRxBufferCalls = false
      PduRUsePduInfoType = false
      PduRBalanceRoutingTime = false
      PduRDynamicDlcSupport = false
      PduRUserConfigurationFile = (unset)
    PduRGlobalConfig: PduRConfigurationId=0
      PduRRoutingTable
        8 x PduRRoutingPath:
          Derived_PduRRoutingPath_F7F2477B
            PT_ABS2_1 (PduRDestPdu): PduRCddDobtSwitch=false, DestPduRef=PduCollection/ABS2__CAN00
            ABS2__CAN00 (PduRSrcPdu): HandleId=1, PduRCddDobtSwitch=false, SrcPduRef=PduCollection/ABS2__CAN00
          Derived_PduRRoutingPath_EE382C03
            PT_BCM1_1 (PduRDestPdu): PduRCddDobtSwitch=false, DestPduRef=PduCollection/BCM1__CAN00
            BCM1__CAN00 (PduRSrcPdu): HandleId=0, PduRCddDobtSwitch=false, SrcPduRef=PduCollection/BCM1__CAN00
          Derived_PduRRoutingPath_EE0F1F45
            PT_DiagFuncReqFT_1 (PduRDestPdu): PduRCddDobtSwitch=false, DestPduRef=PduCollection/DiagFuncReqFT__CAN00
            DiagFuncReqFT__CAN00 (PduRSrcPdu): HandleId=0, PduRCddDobtSwitch=false, SrcPduRef=PduCollection/DiagFuncReqFT__CAN00
          Derived_PduRRoutingPath_A8DF6196
            PT_DiagPhysReqToEPAS_1 (PduRDestPdu): PduRCddDobtSwitch=false, DestPduRef=PduCollection/DiagPhysReqToEPAS__CAN00
            DiagPhysReqToEPAS__CAN00 (PduRSrcPdu): HandleId=1, PduRCddDobtSwitch=false, SrcPduRef=PduCollection/DiagPhysReqToEPAS__CAN00
          Derived_PduRRoutingPath_9D51CC1F
            PT_DiagRespFromEPAS_1 (PduRDestPdu): PduRCddDobtSwitch=false, DestPduRef=PduCollection/DiagRespFromEPAS__CAN00
            DiagRespFromEPAS__CAN00 (PduRSrcPdu): HandleId=0, PduRCddDobtSwitch=false, SrcPduRef=PduCollection/DiagRespFromEPAS__CAN00
          Derived_PduRRoutingPath_17C82725
            PT_ECM1_1 (PduRDestPdu): PduRCddDobtSwitch=false, DestPduRef=PduCollection/ECM1__CAN00
            ECM1__CAN00 (PduRSrcPdu): HandleId=2, PduRCddDobtSwitch=false, SrcPduRef=PduCollection/ECM1__CAN00
          Derived_PduRRoutingPath_208725B6
            PT_EPAS1_1 (PduRDestPdu): PduRCddDobtSwitch=false, DestPduRef=PduCollection/EPAS1__CAN00
            EPAS1__CAN00 (PduRSrcPdu): HandleId=1, PduRCddDobtSwitch=false, SrcPduRef=PduCollection/EPAS1__CAN00
          Derived_PduRRoutingPath_6F1AA480
            PT_EPAS2_1 (PduRDestPdu): PduRCddDobtSwitch=false, DestPduRef=PduCollection/EPAS2__CAN00
            EPAS2__CAN00 (PduRSrcPdu): HandleId=0, PduRCddDobtSwitch=false, SrcPduRef=PduCollection/EPAS2__CAN00
      PduRTpBufferTable: PduRMaxTpBufferNumber=0
    VectorCommonData: BswmdVersion=3.16.10
    3 x PduRBswModules, all with PduRTriggertransmit=false, PduRCancelReceive=false, PduRCancelTransmit=false, PduRChangeParameterRequestApi=false:
      Com: PduRCommunicationInterface=true, PduRLowerModule=false, PduRTransportProtocol=false, PduRUpperModule=true
      CanTp: PduRCommunicationInterface=false, PduRLowerModule=true, PduRTransportProtocol=true, PduRUpperModule=false
      Dcm: PduRCommunicationInterface=false, PduRLowerModule=false, PduRTransportProtocol=true, PduRUpperModule=true
  module config EcuC
    PduCollection
      17 x Pdu:
        ABS2__CAN00: PduLength=64
        BCM1__CAN00: PduLength=64
        DiagFuncReqFT__CAN00: PduLength=64
        DiagPhysReqToEPAS__CAN00: PduLength=64
        DiagRespFromEPAS__CAN00: PduLength=64
        ECM1__CAN00: PduLength=64
        EPAS1__CAN00: PduLength=64
        EPAS2__CAN00: PduLength=64
        XcpSlave__CAN00: PduLength=64
        XcpMaster__CAN00: PduLength=64
        DiagFuncReqFT_Tp__CAN00
        DiagPhysReqToEPAS_Tp__CAN00
        DiagRespFromEPAS_Tp__CAN00
        GliwaMaster__CAN00: PduLength=64
        GliwaSlave__CAN00: PduLength=64
        NMmBCM__CAN00: PduLength=64
        NMmEPAS__CAN00: PduLength=64
  module config ComM: implementation-config-variant=VARIANT-PRE-COMPILE, module-description=ComM_Impl  # Configuration of the ComM (Communications Manager) module.
    CAN00 (ComMChannel):
      ComMBusType = COMM_BUS_TYPE_CAN
      ComMChannelId = 0
      ComMMainFunctionPeriod = 0.02
      ComMNoCom = false
      ComMNoFullCom = false
      ComMNoWakeup = false
      ComMChannelWakeUpPortPrefix = CW_
      ComMChannelLimitPortPrefix = CL_
      ComMNvmBlockDescriptor = (unset)
      ComMNetworkManagement: ComMNmLightTimeout=10, ComMNmVariant=NONE
      ComMUser_CAN00 (ComMUserPerChannel): ComMUserChannel=ComM/ComMUser_CAN00
    ComMGeneral:
      ComMDevErrorDetect = true
      ComMEcuGroupClassification = 3
      ComMModeLimitationEnabled = false
      ComMNoCom = false
      ComMResetAfterForcingNoComm = false
      ComMSynchronousWakeUp = false
      ComMTMinFullComModeDuration = 0
      ComMVersionInfoApi = true
      ComMWakeupInhibitionEnabled = false
      ComMSoftwareComponentName = ComM
      ComMProdErrorDetect = true
      ComMReqModePortPrefix = UR_
      ComMUseRte = true
      ComMCurrentModePortPrefix = UM_
      ComMUserConfigurationFilePath = (unset)
      ComMGlobalNvmBlockDescString = 
      ComMGlobalNvmBlockDescriptor = (unset)
    VectorCommonData: BswmdVersion=2.13.05
    ComMConfig
      CAN00 (ComMNetworks): ComMNetworkHandle=ComM/CAN00
    ComMUser_CAN00 (ComMUser): ComMUserIdentifier=0, ComMModeNotification=false
  module config GenyBaseEnv: module-description=GenyBaseEnv_Impl
    GenyBaseEnvGeneral: GenyBaseEnvUserConfigFile=..\..\..\Tools\AsrProject\Config\User\Can_User.cfg, ProjectType=0, NumberOfSubProjects=1
  module config Board: implementation-config-variant=VARIANT-PRE-COMPILE, module-description=Board_Impl  # Contains all controller-specific parameters for the generator
    BoardGeneral:
      BoardOscillator = 20
      BoardPinsetting = Pin_144
      BoardAtomicBitAccessInBitfield = false
      BoardAtomicVariableAccess = Atomic32BitAccess
      BoardWidthOfPointer = 4
      BoardStructAlignment = Auto
      BoardArrayAlignment = Byte
      BoardStructInArrayAlignment = Byte
      BoardAlignmentFillPattern = 0
      BoardSizeOfPduIdType = Two_Byte
      BoardSizeOfPduLengthType = Two_Byte
      BoardSizeOfEnum = One_Byte
      BoardSizeOfIdType = Two_Byte
      BoardMinObjectSize = 1
      BoardGlobalGPageBehaviour = false
      BoardUseExtendedAsrVersionCheck = false
      BoardPCAndLTCRCCheck = false
      systemVersion = (unset)
      ecuExtractVersion = (unset)
      BoardOsType = Autosar
      BoardDummyFunction = false
      BoardDummyStatement = true
      BoardConditionalGenerating = true
      BoardEnableSnvPrefixes = false
      BoardNhetUnitUsed = NHET1
    InterruptFunctionality: BoardIncludeIsrList=Os.h, BoardUseSchm=true, BoardGlobalReEnableCat1=(unset), BoardGlobalReEnableCat2=(unset)
      4 x InterruptFunctionSet:
        SuspendAllInterrupts: BoardGlobalSuspend=SuspendAllInterrupts(), BoardGlobalRestore=ResumeAllInterrupts(), BoardIncludeFile=Os.h
        SuspendOSInterrupts: BoardGlobalSuspend=SuspendOSInterrupts(), BoardGlobalRestore=ResumeOSInterrupts(), BoardIncludeFile=Os.h
        DisableAllInterrupts: BoardGlobalSuspend=DisableAllInterrupts(), BoardGlobalRestore=EnableAllInterrupts(), BoardIncludeFile=Os.h
        NoCriticalSectionHandling: BoardGlobalSuspend=(unset), BoardGlobalRestore=(unset), BoardIncludeFile=(unset)
  module config GenyAsrBase_Cfg: definition=GenTool_GenyAsrBase_Def, module-description=GenyAsrBase_Impl
    General: AsrBaseMaxShortnameLength=L32
  module config ActivePull: implementation-config-variant=VARIANT-PRE-COMPILE  # Configuration of the Nexteer ActivePull module.
    ActivePullGeneral
    CommonPublishedInformation: ArMajorVersion=3, ArMinorVersion=2, ArPatchVersion=0, SwMajorVersion=0, SwMinorVersion=0, SwPatchVersion=0, ModuleId=0, VendorId=0
  module config Assist: implementation-config-variant=VARIANT-PRE-COMPILE  # Configuration of the Nexteer Assist module.
    AssistGeneral
    CommonPublishedInformation: ArMajorVersion=3, ArMinorVersion=2, ArPatchVersion=0, SwMajorVersion=0, SwMinorVersion=0, SwPatchVersion=0, ModuleId=0, VendorId=0
  module config AssistFirewall: implementation-config-variant=VARIANT-PRE-COMPILE  # Configuration of the Nexteer AssistFirewall module.
    AssistFirewallGeneral
    CommonPublishedInformation: ArMajorVersion=3, ArMinorVersion=2, ArPatchVersion=0, SwMajorVersion=0, SwMinorVersion=0, SwPatchVersion=0, ModuleId=0, VendorId=0
  module config AstLmt: implementation-config-variant=VARIANT-PRE-COMPILE  # Configuration of the Nexteer AstLmt module.
    AstLmtGeneral
    CommonPublishedInformation: ArMajorVersion=3, ArMinorVersion=2, ArPatchVersion=0, SwMajorVersion=0, SwMinorVersion=0, SwPatchVersion=0, ModuleId=0, VendorId=0
  module config AvgFricLrn: implementation-config-variant=VARIANT-PRE-COMPILE  # Configuration of the Nexteer AvgFricLrn module.
    AvgFricLrnGeneral
    CommonPublishedInformation: ArMajorVersion=3, ArMinorVersion=2, ArPatchVersion=0, SwMajorVersion=0, SwMinorVersion=0, SwPatchVersion=0, ModuleId=0, VendorId=0
  module config BatteryVoltage: implementation-config-variant=VARIANT-PRE-COMPILE  # Configuration of the Nexteer BatteryVoltage module.
    BatteryVoltageGeneral
    CommonPublishedInformation: ArMajorVersion=3, ArMinorVersion=2, ArPatchVersion=0, SwMajorVersion=0, SwMinorVersion=0, SwPatchVersion=0, ModuleId=0, VendorId=0
  module config BVDiag: implementation-config-variant=VARIANT-PRE-COMPILE  # Configuration of the Nexteer BVDiag module.
    BVDiagGeneral: BC_B1_BATTVOLTDIAG=STD_OFF, BC_B1_BATTVOLTDIAG_ELPW=STD_OFF, BC_B0_BATTVOLTDIAG_ELPW=STD_OFF
    CommonPublishedInformation: ArMajorVersion=3, ArMinorVersion=2, ArPatchVersion=0, SwMajorVersion=0, SwMinorVersion=0, SwPatchVersion=0, ModuleId=0, VendorId=0
  module config CmMtrCurr: implementation-config-variant=VARIANT-PRE-COMPILE  # Configuration of the Nexteer CmMtrCurr module.
    CmMtrCurrGeneral
    CommonPublishedInformation: ArMajorVersion=3, ArMinorVersion=2, ArPatchVersion=0, SwMajorVersion=0, SwMinorVersion=0, SwPatchVersion=0, ModuleId=0, VendorId=0
    CmMtrCurrPhaseConfig: CmMtrCurrConfig=MTRCURRPHASEBA
  module config Crc: implementation-config-variant=VARIANT-PRE-COMPILE, module-description=Bswmd_Crc  # Configuration of the Crc (Crc routines) module.
    CrcPublishedInformation: CrcInitialValue8=0, CrcInitialValue16=65535, CrcInitialValue32=4294967295
    CrcGeneral: Crc8Mode=CRC_8_RUNTIME, Crc16Mode=CRC_16_RUNTIME, Crc32Mode=CRC_32_RUNTIME, CrcVersionInfoApi=true
  module config CtrldDisShtdn: implementation-config-variant=VARIANT-PRE-COMPILE  # Configuration of the Nexteer CtrldDisShtdn module.
    CtrldDisShtdnGeneral
    CommonPublishedInformation: ArMajorVersion=3, ArMinorVersion=2, ArPatchVersion=0, SwMajorVersion=0, SwMinorVersion=0, SwPatchVersion=0, ModuleId=0, VendorId=0
  module config CtrlTemp: implementation-config-variant=VARIANT-PRE-COMPILE  # Configuration of the Nexteer CtrlTemp module.
    CtrlTempGeneral
    CommonPublishedInformation: ArMajorVersion=3, ArMinorVersion=2, ArPatchVersion=0, SwMajorVersion=0, SwMinorVersion=0, SwPatchVersion=0, ModuleId=0, VendorId=0
  module config CurrCmd: implementation-config-variant=VARIANT-PRE-COMPILE  # Configuration of the Nexteer CurrCmd module.
    CurrCmdGeneral
    CommonPublishedInformation: ArMajorVersion=3, ArMinorVersion=2, ArPatchVersion=0, SwMajorVersion=0, SwMinorVersion=0, SwPatchVersion=0, ModuleId=0, VendorId=0
  module config CurrParamComp: implementation-config-variant=VARIANT-PRE-COMPILE  # Configuration of the Nexteer CurrParamComp module.
    CurrParamCompGeneral
    CommonPublishedInformation: ArMajorVersion=3, ArMinorVersion=2, ArPatchVersion=0, SwMajorVersion=0, SwMinorVersion=0, SwPatchVersion=0, ModuleId=0, VendorId=0
  module config Damping: implementation-config-variant=VARIANT-PRE-COMPILE  # Configuration of the Nexteer Damping module.
    DampingGeneral
    CommonPublishedInformation: ArMajorVersion=3, ArMinorVersion=2, ArPatchVersion=0, SwMajorVersion=0, SwMinorVersion=0, SwPatchVersion=0, ModuleId=0, VendorId=0
  module config DampingFirewall: implementation-config-variant=VARIANT-PRE-COMPILE  # Configuration of the Nexteer DampingFirewall module.
    DampingFirewallGeneral
    CommonPublishedInformation: ArMajorVersion=3, ArMinorVersion=2, ArPatchVersion=0, SwMajorVersion=0, SwMinorVersion=0, SwPatchVersion=0, ModuleId=0, VendorId=0
  module config DiagMgr: implementation-config-variant=VARIANT-PRE-COMPILE  # Configuration of the Nexteer DiagMgr (Diagnostic Event Manager) module.
    DiagMgrConfigSet
      97 x DiagMgrEventParameter, all with DiagMgrEventID=(unset):
        NTC_Num_FlashWrapperLgcFlt: DiagMgrNTC=1, DiagMgrEventKind=DIAGMGR_EVENT_KIND_SWC, OsApplicationRef=Ap_10
        NTC_Num_FlashECCCorr: DiagMgrNTC=2, DiagMgrEventKind=DIAGMGR_EVENT_KIND_SWC, OsApplicationRef=Ap_10
        NTC_Num_FlashECCMemFlt: DiagMgrNTC=3, DiagMgrEventKind=DIAGMGR_EVENT_KIND_SWC, OsApplicationRef=Ap_10
        NTC_Num_FlashCRCMemFault: DiagMgrNTC=4, DiagMgrEventKind=DIAGMGR_EVENT_KIND_BSW, OsApplicationRef=Ap_10
        NTC_Num_NvMBlkDftActA: DiagMgrNTC=6, DiagMgrEventKind=DIAGMGR_EVENT_KIND_BSW, OsApplicationRef=Ap_10
        NTC_Num_NvMBlkDftActB: DiagMgrNTC=7, DiagMgrEventKind=DIAGMGR_EVENT_KIND_BSW, OsApplicationRef=Ap_10
        NTC_Num_NvMBlkDftActC: DiagMgrNTC=8, DiagMgrEventKind=DIAGMGR_EVENT_KIND_BSW, OsApplicationRef=Ap_10
        NTC_Num_EEPROMDiag: DiagMgrNTC=10, DiagMgrEventKind=DIAGMGR_EVENT_KIND_BSW, OsApplicationRef=Ap_10
        NTC_Num_EEPROMDiagMtrStr: DiagMgrNTC=11, DiagMgrEventKind=DIAGMGR_EVENT_KIND_SWC, OsApplicationRef=Ap_10
        NTC_Num_PriSnsrTrqStorFlt: DiagMgrNTC=12, DiagMgrEventKind=DIAGMGR_EVENT_KIND_SWC, OsApplicationRef=Ap_10
        NTC_Num_EEPROMDiagPolarityStr: DiagMgrNTC=15, DiagMgrEventKind=DIAGMGR_EVENT_KIND_SWC, OsApplicationRef=Ap_10
        NTC_Num_RAMDiag_GeneralFlt: DiagMgrNTC=16, DiagMgrEventKind=DIAGMGR_EVENT_KIND_SWC, OsApplicationRef=Ap_10
        NTC_Num_RAMDiag_WrprLgcFlt: DiagMgrNTC=17, DiagMgrEventKind=DIAGMGR_EVENT_KIND_SWC, OsApplicationRef=Ap_10
        NTC_Num_RAMDiag_ECCCorrIndFlt: DiagMgrNTC=18, DiagMgrEventKind=DIAGMGR_EVENT_KIND_SWC, OsApplicationRef=Ap_10
        NTC_Num_RAMDiag_ECCMemFlt: DiagMgrNTC=19, DiagMgrEventKind=DIAGMGR_EVENT_KIND_SWC, OsApplicationRef=Ap_10
        NTC_Num_RAMDiag_VIMRamFlt: DiagMgrNTC=23, DiagMgrEventKind=DIAGMGR_EVENT_KIND_SWC, OsApplicationRef=Ap_10
        NTC_Num_RAMDiag_NHET1RamFlt: DiagMgrNTC=24, DiagMgrEventKind=DIAGMGR_EVENT_KIND_SWC, OsApplicationRef=Ap_10
        NTC_Num_RAMDiag_NHET2RamFlt: DiagMgrNTC=25, DiagMgrEventKind=DIAGMGR_EVENT_KIND_SWC, OsApplicationRef=Ap_10
        NTC_Num_RAMDiag_ADC1RamFlt: DiagMgrNTC=26, DiagMgrEventKind=DIAGMGR_EVENT_KIND_SWC, OsApplicationRef=Ap_10
        NTC_Num_RAMDiag_DCANRamFault: DiagMgrNTC=27, DiagMgrEventKind=DIAGMGR_EVENT_KIND_SWC, OsApplicationRef=Ap_10
        NTC_Num_RAMDiag_ADC2RamFlt: DiagMgrNTC=28, DiagMgrEventKind=DIAGMGR_EVENT_KIND_SWC, OsApplicationRef=Ap_10
        NTC_Num_RAMDiag_HETTU1RamFlt: DiagMgrNTC=29, DiagMgrEventKind=DIAGMGR_EVENT_KIND_BSW, OsApplicationRef=Ap_10
        NTC_Num_RAMDiag_HETTU2RamFlt: DiagMgrNTC=30, DiagMgrEventKind=DIAGMGR_EVENT_KIND_SWC, OsApplicationRef=Ap_10
        NTC_Num_CPU_RegVer: DiagMgrNTC=32, DiagMgrEventKind=DIAGMGR_EVENT_KIND_SWC, OsApplicationRef=Ap_10
        NTC_Num_CPU_CoreInitFlt: DiagMgrNTC=33, DiagMgrEventKind=DIAGMGR_EVENT_KIND_BSW, OsApplicationRef=Ap_10
        NTC_Num_CPU_CoreRunTimeFlt: DiagMgrNTC=34, DiagMgrEventKind=DIAGMGR_EVENT_KIND_SWC, OsApplicationRef=Ap_10
        NTC_Num_CPU_ClockMon: DiagMgrNTC=35, DiagMgrEventKind=DIAGMGR_EVENT_KIND_SWC, OsApplicationRef=Ap_10
        NTC_Num_CPU_eFuseFlt: DiagMgrNTC=36, DiagMgrEventKind=DIAGMGR_EVENT_KIND_SWC, OsApplicationRef=Ap_10
        NTC_Num_CPU_MPUViolation: DiagMgrNTC=37, DiagMgrEventKind=DIAGMGR_EVENT_KIND_SWC, OsApplicationRef=Ap_10
        NTC_Num_CPU_FactPrcsErr: DiagMgrNTC=40, DiagMgrEventKind=DIAGMGR_EVENT_KIND_SWC, OsApplicationRef=Ap_10
        NTC_Num_PrgFlwDeadlnFlt: DiagMgrNTC=42, DiagMgrEventKind=DIAGMGR_EVENT_KIND_BSW, OsApplicationRef=Ap_10
        NTC_Num_PropExeDiag_RunTimeDiag: DiagMgrNTC=43, DiagMgrEventKind=DIAGMGR_EVENT_KIND_SWC, OsApplicationRef=Ap_10
        NTC_Num_PropExeDiag_COPTimeout: DiagMgrNTC=44, DiagMgrEventKind=DIAGMGR_EVENT_KIND_SWC, OsApplicationRef=Ap_10
        NTC_Num_PropExeDiag_PrefetchAbort: DiagMgrNTC=48, DiagMgrEventKind=DIAGMGR_EVENT_KIND_SWC, OsApplicationRef=Ap_10
        NTC_Num_PropExeDiag_DataAbort: DiagMgrNTC=49, DiagMgrEventKind=DIAGMGR_EVENT_KIND_SWC, OsApplicationRef=Ap_10
        NTC_Num_PerDiag_ADC1Flt: DiagMgrNTC=50, DiagMgrEventKind=DIAGMGR_EVENT_KIND_SWC, OsApplicationRef=Ap_10
        NTC_Num_PerDiag_ADC2Flt: DiagMgrNTC=51, DiagMgrEventKind=DIAGMGR_EVENT_KIND_SWC, OsApplicationRef=Ap_10
        NTC_Num_PerDiag_IllegalAccess: DiagMgrNTC=53, DiagMgrEventKind=DIAGMGR_EVENT_KIND_SWC, OsApplicationRef=Ap_10
        NTC_Num_PerDiag_DMAFlt: DiagMgrNTC=54, DiagMgrEventKind=DIAGMGR_EVENT_KIND_SWC, OsApplicationRef=Ap_10
        NTC_Num_PeripheralStartupFlt: DiagMgrNTC=55, DiagMgrEventKind=DIAGMGR_EVENT_KIND_SWC, OsApplicationRef=Ap_10
        NTC_Num_TmpMonFunc: DiagMgrNTC=64, DiagMgrEventKind=DIAGMGR_EVENT_KIND_SWC, OsApplicationRef=Ap_10
        NTC_Num_TmpMonRunTimeFlt: DiagMgrNTC=65, DiagMgrEventKind=DIAGMGR_EVENT_KIND_SWC, OsApplicationRef=Ap_10
        NTC_Num_PowerRelayInitFlt: DiagMgrNTC=66, DiagMgrEventKind=DIAGMGR_EVENT_KIND_SWC, OsApplicationRef=Ap_9
        NTC_Num_PrechargeFailure: DiagMgrNTC=67, DiagMgrEventKind=DIAGMGR_EVENT_KIND_SWC, OsApplicationRef=Ap_9
        NTC_Num_PowerRelayRunFlt: DiagMgrNTC=68, DiagMgrEventKind=DIAGMGR_EVENT_KIND_SWC, OsApplicationRef=Ap_9
        NTC_Num_Thermistor: DiagMgrNTC=69, DiagMgrEventKind=DIAGMGR_EVENT_KIND_SWC, OsApplicationRef=Ap_9
        NTC_Num_RefSupplyVltg: DiagMgrNTC=70, DiagMgrEventKind=DIAGMGR_EVENT_KIND_SWC, OsApplicationRef=Ap_10
        NTC_Num_CPUSupplyOvervoltage: DiagMgrNTC=72, DiagMgrEventKind=DIAGMGR_EVENT_KIND_SWC, OsApplicationRef=Ap_10
        NTC_Num_GateDrvFltInProcess: DiagMgrNTC=76, DiagMgrEventKind=DIAGMGR_EVENT_KIND_SWC, OsApplicationRef=Ap_10
        NTC_Num_GateDrvFlt: DiagMgrNTC=77, DiagMgrEventKind=DIAGMGR_EVENT_KIND_SWC, OsApplicationRef=Ap_10
        NTC_Num_OnStateSingleFET: DiagMgrNTC=78, DiagMgrEventKind=DIAGMGR_EVENT_KIND_SWC, OsApplicationRef=Ap_10
        NTC_Num_OnStateMultiFET: DiagMgrNTC=79, DiagMgrEventKind=DIAGMGR_EVENT_KIND_SWC, OsApplicationRef=Ap_10
        NTC_Num_DigPhaseVoltageVerf: DiagMgrNTC=82, DiagMgrEventKind=DIAGMGR_EVENT_KIND_SWC, OsApplicationRef=Ap_10
        NTC_Num_CurrentMeasCrossChk: DiagMgrNTC=86, DiagMgrEventKind=DIAGMGR_EVENT_KIND_SWC, OsApplicationRef=Ap_10
        NTC_Num_T1vsT2: DiagMgrNTC=101, DiagMgrEventKind=DIAGMGR_EVENT_KIND_SWC, OsApplicationRef=Ap_10
        NTC_Num_T1OutofRange: DiagMgrNTC=102, DiagMgrEventKind=DIAGMGR_EVENT_KIND_SWC, OsApplicationRef=Ap_10
        NTC_Num_T2OutofRange: DiagMgrNTC=103, DiagMgrEventKind=DIAGMGR_EVENT_KIND_SWC, OsApplicationRef=Ap_10
        NTC_Num_PriMSB_SinCosCorr: DiagMgrNTC=112, DiagMgrEventKind=DIAGMGR_EVENT_KIND_SWC, OsApplicationRef=Ap_10
        NTC_Num_SecMSB_SinCosCorr: DiagMgrNTC=113, DiagMgrEventKind=DIAGMGR_EVENT_KIND_SWC, OsApplicationRef=Ap_10
        NTC_Num_PriVsSec_SinCosCorr: DiagMgrNTC=114, DiagMgrEventKind=DIAGMGR_EVENT_KIND_SWC, OsApplicationRef=Ap_10
        NTC_Num_HWAtoMtrAngleCorr: DiagMgrNTC=117, DiagMgrEventKind=DIAGMGR_EVENT_KIND_SWC, OsApplicationRef=Ap_10
        NTC_Num_TurnCntr_PosLoss: DiagMgrNTC=128, DiagMgrEventKind=DIAGMGR_EVENT_KIND_SWC, OsApplicationRef=Ap_10
        NTC_Num_TurnCntr_MainResets: DiagMgrNTC=133, DiagMgrEventKind=DIAGMGR_EVENT_KIND_SWC, OsApplicationRef=Ap_10
        NTC_Num_KinematicIntDiag: DiagMgrNTC=144, DiagMgrEventKind=DIAGMGR_EVENT_KIND_SWC, OsApplicationRef=Ap_10
        NTC_Num_HighFriction: DiagMgrNTC=145, DiagMgrEventKind=DIAGMGR_EVENT_KIND_SWC, OsApplicationRef=Ap_9
        NTC_Num_DutyCycleExceeded: DiagMgrNTC=148, DiagMgrEventKind=DIAGMGR_EVENT_KIND_SWC, OsApplicationRef=Ap_9
        NTC_Num_AbsTempThermLimit: DiagMgrNTC=149, DiagMgrEventKind=DIAGMGR_EVENT_KIND_SWC, OsApplicationRef=Ap_9
        NTC_Num_LatchActive: DiagMgrNTC=160, DiagMgrEventKind=DIAGMGR_EVENT_KIND_SWC, OsApplicationRef=Ap_9
        NTC_Num_CurrentReas: DiagMgrNTC=169, DiagMgrEventKind=DIAGMGR_EVENT_KIND_SWC, OsApplicationRef=Ap_10
        NTC_Num_OpVoltage: DiagMgrNTC=176, DiagMgrEventKind=DIAGMGR_EVENT_KIND_SWC, OsApplicationRef=Ap_9
        NTC_Num_ReducedAsstLowVoltage: DiagMgrNTC=178, DiagMgrEventKind=DIAGMGR_EVENT_KIND_SWC, OsApplicationRef=Ap_10
        NTC_Num_OpVoltageOvrMax: DiagMgrNTC=181, DiagMgrEventKind=DIAGMGR_EVENT_KIND_SWC, OsApplicationRef=Ap_9
        NTC_Num_BattTransOverVolt: DiagMgrNTC=182, DiagMgrEventKind=DIAGMGR_EVENT_KIND_BSW, OsApplicationRef=Ap_9
        NTC_Num_TurnCntr_LowBattery: DiagMgrNTC=185, DiagMgrEventKind=DIAGMGR_EVENT_KIND_SWC, OsApplicationRef=Ap_10
        NTC_Num_EEPROMCloseFailed: DiagMgrNTC=191, DiagMgrEventKind=DIAGMGR_EVENT_KIND_SWC, OsApplicationRef=Ap_10
        NTC_Num_SigPath1CrossChk: DiagMgrNTC=192, DiagMgrEventKind=DIAGMGR_EVENT_KIND_SWC, OsApplicationRef=Ap_10
        NTC_Num_DampingFWReached: DiagMgrNTC=197, DiagMgrEventKind=DIAGMGR_EVENT_KIND_SWC, OsApplicationRef=Ap_10
        NTC_Num_AssistFWReached: DiagMgrNTC=198, DiagMgrEventKind=DIAGMGR_EVENT_KIND_SWC, OsApplicationRef=Ap_10
        NTC_Num_ReturnFWReached: DiagMgrNTC=199, DiagMgrEventKind=DIAGMGR_EVENT_KIND_SWC, OsApplicationRef=Ap_10
        NTC_Num_DampingFWFltMode: DiagMgrNTC=200, DiagMgrEventKind=DIAGMGR_EVENT_KIND_SWC, OsApplicationRef=Ap_10
        NTC_Num_AssistFWFltMode: DiagMgrNTC=201, DiagMgrEventKind=DIAGMGR_EVENT_KIND_SWC, OsApplicationRef=Ap_10
        NTC_Num_VBICFltMode: DiagMgrNTC=202, DiagMgrEventKind=DIAGMGR_EVENT_KIND_SWC, OsApplicationRef=Ap_10
        NTC_Num_StaMdsSysC: DiagMgrNTC=203, DiagMgrEventKind=DIAGMGR_EVENT_KIND_SWC, OsApplicationRef=Ap_8
        NTC_NUM_SysFailureForRotVel: DiagMgrNTC=204, DiagMgrEventKind=DIAGMGR_EVENT_KIND_BSW, OsApplicationRef=Ap_10
        NTC_NUM_SysFailForRedntRotVel: DiagMgrNTC=205, DiagMgrEventKind=DIAGMGR_EVENT_KIND_BSW, OsApplicationRef=Ap_8
        NTC_NUM_SysFailureForCtrlVolt: DiagMgrNTC=209, DiagMgrEventKind=DIAGMGR_EVENT_KIND_SWC, OsApplicationRef=Ap_9
        NTC_Num_GlblSgnlOvrwrtDet: DiagMgrNTC=223, DiagMgrEventKind=DIAGMGR_EVENT_KIND_SWC, OsApplicationRef=Ap_10
        NTC_Num_BusOffCh1: DiagMgrNTC=256, DiagMgrEventKind=DIAGMGR_EVENT_KIND_SWC, OsApplicationRef=Ap_9
        NTC_Num_InvalidMsg_M: DiagMgrNTC=288, DiagMgrEventKind=DIAGMGR_EVENT_KIND_SWC, OsApplicationRef=Ap_9
        NTC_Num_MissingMsg_M: DiagMgrNTC=289, DiagMgrEventKind=DIAGMGR_EVENT_KIND_SWC, OsApplicationRef=Ap_9
        NTC_Num_InvalidMsg_N: DiagMgrNTC=296, DiagMgrEventKind=DIAGMGR_EVENT_KIND_SWC, OsApplicationRef=Ap_9
        NTC_Num_MissingMsg_N: DiagMgrNTC=297, DiagMgrEventKind=DIAGMGR_EVENT_KIND_SWC, OsApplicationRef=Ap_9
        NTC_Num_MissingMsg_O: DiagMgrNTC=305, DiagMgrEventKind=DIAGMGR_EVENT_KIND_SWC, OsApplicationRef=Ap_9
        NTC_Num_EOLVehTunNtPerf: DiagMgrNTC=501, DiagMgrEventKind=DIAGMGR_EVENT_KIND_SWC, OsApplicationRef=Ap_9
        NTC_Num_HWASensorNotTrimmed: DiagMgrNTC=504, DiagMgrEventKind=DIAGMGR_EVENT_KIND_SWC, OsApplicationRef=Ap_10
        NTC_Num_TrqSensorNotTrimmed: DiagMgrNTC=507, DiagMgrEventKind=DIAGMGR_EVENT_KIND_SWC, OsApplicationRef=Ap_10
        NTC_Num_TurnCntr_SensorPosFlt: DiagMgrNTC=130, DiagMgrEventKind=DIAGMGR_EVENT_KIND_SWC, OsApplicationRef=Ap_10
    DiagMgrGeneral:
      DiagMgrIsMtoProgram = false
      DiagMgrDevErrorDetect = true
      DiagMgrVersionInfoApi = false
      DiagMgrRecoverPeriod = 0.1
      DiagMgrFailPeriod = 0.002
      DiagMgrDemIfPeriod = 0.1
      NumOfDemEvents = 28
      DiagMgrDemIfOsAppRef = Ap_9
      DiagMgrFailActionOsAppRef = Ap_10
    CommonPublishedInformation: ArMajorVersion=3, ArMinorVersion=2, ArPatchVersion=0, SwMajorVersion=0, SwMinorVersion=0, SwPatchVersion=0, ModuleId=0, VendorId=0
  module config DigPhsReasDiag: implementation-config-variant=VARIANT-PRE-COMPILE  # Configuration of the Nexteer DigPhsReasDiag module.
    DigPhsReasDiagGeneral: NHETFREQUENCY_HZ=80000000, MAXPWMFREQ_HZ=18000
    CommonPublishedInformation: ArMajorVersion=3, ArMinorVersion=2, ArPatchVersion=0, SwMajorVersion=0, SwMinorVersion=0, SwPatchVersion=0, ModuleId=0, VendorId=0
  module config Dio: implementation-config-variant=VARIANT-LINK-TIME, module-description=Dio_Impl  # Configuration of the Dio (Digital IO) module.
    DioGeneral:
      DioDevErrorDetect = true
      DioVersionInfoApi = true
      DioMaskedWritePortApi = false
      DioCfgSupportGio = true
      DioCfgSupportCan = true
      DioCfgDoParamCheck = true
      DioCfgReportDet = true
      DioCfgChkParamChannel = true
      DioCfgChkParamPort = true
      DioCfgChkParamGroup = true
      DioCfgChkParamVinfo = true
      DioReportDet = Det_ReportError
      DioCfgIncludeDet = Det.h
      DioCfgChannelApi = true
      DioCfgPortApi = true
      DioCfgGroupApi = true
      DioSpecialRegisterAccessEnabled = true
      DioSpecialRegisterAccessOnlyForWrite = true
      DioSpecialRegisterAccessOnlyForPrivilegedModeRegisters = true
    DioVectorCommonData (VectorCommonData): BswmdVersion=2.01.00
    DioPackageMapping337 (DioPackageMapping): DioPackageName=Pin_337, DioPortDefMaskName=DIO_PORT_DEF_MASK_IN_PKG_A
    DioPortGioA (DioPortDefinition):
      DioPortDefName = GIOA
      DioPortDefPortId = 12046
      DioPortDefMaskInPkgA = 255
      DioPortDefMaskInPkgB = 231
      DioPortDefMaskInPkgC = 0
      DioPortDefMaskInPkgD = 0
      DioPortDefMaskInPkgE = 0
      DioPortDefMaskInPkgF = 0
      DioPortDefMaskInPkgG = 0
      DioPortDefMaskInPkgH = 0
      DioPortDefMaskInPkgI = 0
      DioPortDefMaskInPkgJ = 0
    NHet (DioPort): DioPortId=0, DioPortDefRef=DioPortNHet1
      NHet_Ch4 (DioChannel): DioChannelId=4
      DioChGrpNHet (DioChannelGroup): DioChannelGroupIdentification=&DioChGrpNHet, DioPortMask=1, DioPortOffset=0
      6 x DioChannel:
        NHet_Ch8: DioChannelId=8
        NHet_Ch15: DioChannelId=15
        NHet_Ch20: DioChannelId=20
        NHet_Ch22: DioChannelId=22
        NHet_Ch24: DioChannelId=24
        NHet_Ch26: DioChannelId=26
    DioPackageMapping144 (DioPackageMapping): DioPackageName=Pin_144, DioPortDefMaskName=DIO_PORT_DEF_MASK_IN_PKG_B
    23 x DioPortDefinition, all with DioPortDefMaskInPkgC=0, DioPortDefMaskInPkgD=0, DioPortDefMaskInPkgE=0, DioPortDefMaskInPkgF=0, DioPortDefMaskInPkgG=0, DioPortDefMaskInPkgH=0, DioPortDefMaskInPkgI=0, DioPortDefMaskInPkgJ=0:
      DioPortGioB: DioPortDefName=GIOB, DioPortDefPortId=12054, DioPortDefMaskInPkgA=255, DioPortDefMaskInPkgB=255
      DioPortNHet1: DioPortDefName=NHET1, DioPortDefPortId=11796, DioPortDefMaskInPkgA=4294967295, DioPortDefMaskInPkgB=4292870143
      DioPortNHet2: DioPortDefName=NHET2, DioPortDefPortId=11860, DioPortDefMaskInPkgA=393215, DioPortDefMaskInPkgB=2796171
      DioPortCan1Tx: DioPortDefName=CAN1, DioPortDefPortId=79736, DioPortDefMaskInPkgA=1, DioPortDefMaskInPkgB=1
      DioPortCan1Rx: DioPortDefName=CAN1, DioPortDefPortId=79737, DioPortDefMaskInPkgA=1, DioPortDefMaskInPkgB=1
      DioPortCan2Tx: DioPortDefName=CAN2, DioPortDefPortId=79864, DioPortDefMaskInPkgA=1, DioPortDefMaskInPkgB=1
      DioPortCan2Rx: DioPortDefName=CAN2, DioPortDefPortId=79865, DioPortDefMaskInPkgA=1, DioPortDefMaskInPkgB=1
      DioPortCan3Tx: DioPortDefName=CAN3, DioPortDefPortId=79992, DioPortDefMaskInPkgA=1, DioPortDefMaskInPkgB=1
      DioPortCan3Rx: DioPortDefName=CAN3, DioPortDefPortId=79993, DioPortDefMaskInPkgA=1, DioPortDefMaskInPkgB=1
      DioPortAdc1: DioPortDefName=ADC1, DioPortDefPortId=274496, DioPortDefMaskInPkgA=1, DioPortDefMaskInPkgB=1
      DioPortAdc2: DioPortDefName=ADC2, DioPortDefPortId=274624, DioPortDefMaskInPkgA=1, DioPortDefMaskInPkgB=1
      DioPortLin: DioPortDefName=LIN, DioPortDefPortId=14609, DioPortDefMaskInPkgA=6, DioPortDefMaskInPkgB=6
      DioPortSci: DioPortDefName=SCI, DioPortDefPortId=14673, DioPortDefMaskInPkgA=6, DioPortDefMaskInPkgB=6
      DioPortIic: DioPortDefName=IIC, DioPortDefPortId=13588, DioPortDefMaskInPkgA=3, DioPortDefMaskInPkgB=3
      DioPortSpi1: DioPortDefName=SPI1, DioPortDefPortId=15623, DioPortDefMaskInPkgA=33689407, DioPortDefMaskInPkgB=33689399
      DioPortSpi2: DioPortDefName=SPI2, DioPortDefPortId=15751, DioPortDefMaskInPkgA=3843, DioPortDefMaskInPkgB=0
      DioPortSpi3: DioPortDefName=SPI3, DioPortDefPortId=15879, DioPortDefMaskInPkgA=3903, DioPortDefMaskInPkgB=3903
      DioPortSpi4: DioPortDefName=SPI4, DioPortDefPortId=16007, DioPortDefMaskInPkgA=3841, DioPortDefMaskInPkgB=3841
      DioPortSpi5: DioPortDefName=SPI5, DioPortDefPortId=16135, DioPortDefMaskInPkgA=235802383, DioPortDefMaskInPkgB=3841
      DioPortRtp: DioPortDefName=RTP, DioPortDefPortId=147087, DioPortDefMaskInPkgA=524287, DioPortDefMaskInPkgB=0
      DioPortEclk: DioPortDefName=SYS, DioPortDefPortId=147394, DioPortDefMaskInPkgA=1, DioPortDefMaskInPkgB=1
      DioPortDmm: DioPortDefName=DMMDATA, DioPortDefPortId=146909, DioPortDefMaskInPkgA=524287, DioPortDefMaskInPkgB=36224
      DioPortEsm: DioPortDefName=ESMEPSR, DioPortDefPortId=146761, DioPortDefMaskInPkgA=1, DioPortDefMaskInPkgB=1
    5 x DioPort, all with DioPortId=0:
      Adc1: DioPortDefRef=DioPortAdc1
        ADC1_Ch0 (DioChannel): DioChannelId=0
        DioChannelGroupAdc1 (DioChannelGroup): DioChannelGroupIdentification=&DioChannelGroupAdc1, DioPortMask=1, DioPortOffset=0
      Spi3: DioPortDefRef=DioPortSpi3
        SPI3_NCS1 (DioChannel): DioChannelId=1
        DioChannelGroupSpi3 (DioChannelGroup): DioChannelGroupIdentification=&DioChannelGroupSpi3, DioPortMask=1, DioPortOffset=0
      CAN3_Rx: DioPortDefRef=DioPortCan3Rx
        Can3Rx (DioChannel): DioChannelId=0
        DioChannelGroupCan3Rx (DioChannelGroup): DioChannelGroupIdentification=&DioChannelGroupCan3Rx, DioPortMask=1, DioPortOffset=0
      CAN3_Tx: DioPortDefRef=DioPortCan3Tx
        Can3Tx (DioChannel): DioChannelId=0
        DioChannelGroupCan3Tx (DioChannelGroup): DioChannelGroupIdentification=&DioChannelGroupCanTx, DioPortMask=1, DioPortOffset=0
      Esm: DioPortDefRef=DioPortEsm
        nERROR (DioChannel): DioChannelId=0
        DioChannelGroupEsm (DioChannelGroup): DioChannelGroupIdentification=&DioChannelGroupEsm, DioPortMask=1, DioPortOffset=0
  module config ElePwr: implementation-config-variant=VARIANT-PRE-COMPILE  # Configuration of the Nexteer ElePwr module.
    ElePwrGeneral
    CommonPublishedInformation: ArMajorVersion=3, ArMinorVersion=2, ArPatchVersion=0, SwMajorVersion=0, SwMinorVersion=0, SwPatchVersion=0, ModuleId=0, VendorId=0
  module config EOTActuatorMng: implementation-config-variant=VARIANT-PRE-COMPILE  # Configuration of the Nexteer EOTActuatorMng module.
    EOTActuatorMngGeneral
    CommonPublishedInformation: ArMajorVersion=3, ArMinorVersion=2, ArPatchVersion=0, SwMajorVersion=0, SwMinorVersion=0, SwPatchVersion=0, ModuleId=0, VendorId=0
  module config Fee: implementation-config-variant=VARIANT-PRE-COMPILE, module-description=Fee_Implementation  # Flash EEPROM Emulation Configuration
    FeePublishedInformation:
      FeeBlockOverhead = 24
      FeeMaximumBlockingTime = 600
      FeePageOverhead = 0
      FeeVirtualSectorOverhead = 16
      FeeIncludeFile = Fee.h
      FeeSetModeApi = Fee_SetMode
      FeeReadApi = Fee_Read
      FeeWriteApi = Fee_Write
      FeeCancelApi = Fee_Cancel
      FeeGetStatusApi = Fee_GetStatus
      FeeGetJobResultApi = Fee_GetJobResult
      FeeEraseImmediateBlockApi = Fee_EraseImmediateBlock
      FeeInvalidateBlockApi = Fee_InvalidateBlock
    FeeGeneral:
      FeeDevErrorDetect = false
      FeeDeviceIndex = 0
      FeeNvmJobEndNotification = NvM_JobEndNotification
      FeeNvmJobErrorNotification = NvM_JobErrorNotification
      FeePollingMode = true
      FeeVersionInfoApi = false
      FeeEnableErrorCorrection = true
      FeeVirtualPageSize = 8
      FeeFrequency = 160
      FeeCRCEnable = false
      FeeWriteCounterSave = false
      FeeNumberOfVirtualSectors = 4
      FeeNumberOfVirtualSectorsEEP1 = 2
      FeeNumberOfUnconfiguredBlocksToCopy = 0
      FeeNumberOfEightByteWrites = 128
      FeeCheckBank7Access = false
      FeeGenerateDeviceandvirtualsectorstruc = true
      FeeVirtualsectorSize = VS_16
      FeePhysicalsectorSize = PS_4
    FeeBlockConfiguration42 (FeeBlockConfiguration):
      FeeDataset = 2
      FeeBlockNumber = 32
      FeeBlockSize = 4
      FeeImmediateData = false
      FeeNumberOfWriteCycles = 1
      FeeBlockName = Fee_Block_ConfigBlock
      FeeDeviceIndex = 0
      FeeBlockConfiguration = 1
      FeeEEPNumber = 0
      Fee
        FeeBlockConfiguration: FeeNvmBlockName=ConfigBlock
    FeeTypes: FeeFlashErrCorrHandlingType=Fee_Fix
    FeeFlashConfiguration: FeeDeviceName=TMS570LS07xx
    44 x FeeBlockConfiguration, all with FeeDataset=1, FeeImmediateData=false, FeeNumberOfWriteCycles=1, FeeDeviceIndex=0:
      FeeBlockConfiguration44: FeeBlockNumber=64, FeeBlockSize=4102, FeeBlockName=Fee_Block_DigMSB_DigMSBEOLData, FeeBlockConfiguration=2, FeeEEPNumber=0
        Fee
          FeeBlockConfiguration: FeeNvmBlockName=Rte_NvmBlock_DigMSB_DigMSBEOLData
      FeeBlockConfiguration45: FeeBlockNumber=96, FeeBlockSize=5, FeeBlockName=Deprecated_Block_DigHwTrqSENT_DigTrqTrim, FeeBlockConfiguration=3, FeeEEPNumber=0
        Fee
          FeeBlockConfiguration: FeeNvmBlockName=Deprecated_NvmBlock_DigHwTrqSENT_DigTrqTrim
      FeeBlockConfiguration4: FeeBlockNumber=128, FeeBlockSize=4, FeeBlockName=Fee_Block_Polarity_Polarity_Cnt_Str, FeeBlockConfiguration=4, FeeEEPNumber=0
        Fee
          FeeBlockConfiguration: FeeNvmBlockName=Rte_NvmBlock_Polarity_Polarity_Cnt_Str
      FeeBlockConfiguration7: FeeBlockNumber=160, FeeBlockSize=4, FeeBlockName=Fee_Block_EpsDefeats, FeeBlockConfiguration=5, FeeEEPNumber=0
        Fee
          FeeBlockConfiguration: FeeNvmBlockName=NVM_BLOCK_EPSDEFEATS
      FeeBlockConfiguration54: FeeBlockNumber=192, FeeBlockSize=96, FeeBlockName=Fee_Block_CmMtrCurr_CurrTempOffset, FeeBlockConfiguration=6, FeeEEPNumber=0
        Fee
          FeeBlockConfiguration: FeeNvmBlockName=Rte_NvmBlock_CmMtrCurr_CurrTempOffset
      FeeBlockConfiguration12: FeeBlockNumber=224, FeeBlockSize=28, FeeBlockName=Deprecated_Block_CmMtrCurr_ShCurrCal, FeeBlockConfiguration=7, FeeEEPNumber=0
        Fee
          FeeBlockConfiguration: FeeNvmBlockName=Deprecated_NvmBlock_CmMtrCurr_ShCurrCal
      FeeBlockConfiguration13: FeeBlockNumber=256, FeeBlockSize=8, FeeBlockName=Fee_Block_CurrParamComp_EOLNomMtrParam, FeeBlockConfiguration=8, FeeEEPNumber=0
        Fee
          FeeBlockConfiguration: FeeNvmBlockName=Rte_NvmBlock_CurrParamComp_EOLNomMtrParam
      FeeBlockConfiguration15: FeeBlockNumber=288, FeeBlockSize=1024, FeeBlockName=Deprecated_Block_TrqCanc_CogTrqCal, FeeBlockConfiguration=9, FeeEEPNumber=0
        Fee
          FeeBlockConfiguration: FeeNvmBlockName=Deprecated_NvmBlock_TrqCanc_CogTrqCal
      FeeBlockConfiguration33: FeeBlockNumber=320, FeeBlockSize=1, FeeBlockName=Fee_Block_CMS_NxtrMEC, FeeBlockConfiguration=10, FeeEEPNumber=0
        Fee
          FeeBlockConfiguration: FeeNvmBlockName=NVM_BLOCK_CMS_NXTRMEC
      FeeBlockConfiguration34: FeeBlockNumber=352, FeeBlockSize=4, FeeBlockName=Fee_Block_CMS_EcuSrlNum, FeeBlockConfiguration=11, FeeEEPNumber=0
        Fee
          FeeBlockConfiguration: FeeNvmBlockName=NVM_BLOCK_CMS_ECUSRLNUM
      FeeBlockConfiguration35: FeeBlockNumber=384, FeeBlockSize=4, FeeBlockName=Fee_Block_CMS_EpsSrlNum, FeeBlockConfiguration=12, FeeEEPNumber=0
        Fee
          FeeBlockConfiguration: FeeNvmBlockName=NVM_BLOCK_CMS_EPSSRLNUM
      FeeBlockConfiguration36: FeeBlockNumber=416, FeeBlockSize=12, FeeBlockName=Fee_Block_CMS_EcuHwPN, FeeBlockConfiguration=13, FeeEEPNumber=0
        Fee
          FeeBlockConfiguration: FeeNvmBlockName=NVM_BLOCK_CMS_ECUHWPN
      FeeBlockConfiguration37: FeeBlockNumber=448, FeeBlockSize=64, FeeBlockName=Fee_Block_CMS_NxtrManufScratchpad, FeeBlockConfiguration=14, FeeEEPNumber=0
        Fee
          FeeBlockConfiguration: FeeNvmBlockName=NVM_BLOCK_CMS_NXTRMANUFSCRATCHPAD
      FeeBlockConfiguration38: FeeBlockNumber=480, FeeBlockSize=2, FeeBlockName=Fee_Block_CMS_IgnCntr, FeeBlockConfiguration=15, FeeEEPNumber=1
        Fee
          FeeBlockConfiguration: FeeNvmBlockName=NVM_BLOCK_CMS_IGNCNTR
      FeeBlockConfiguration6: FeeBlockNumber=512, FeeBlockSize=60, FeeBlockName=Fee_Block_DiagMgr_NTCStrg, FeeBlockConfiguration=16, FeeEEPNumber=1
        Fee
          FeeBlockConfiguration: FeeNvmBlockName=NVM_BLOCK_DIAGMGR_NTCSTRG
      FeeBlockConfiguration40: FeeBlockNumber=544, FeeBlockSize=192, FeeBlockName=Fee_Block_DiagMgr_Blackbox, FeeBlockConfiguration=17, FeeEEPNumber=1
        Fee
          FeeBlockConfiguration: FeeNvmBlockName=NVM_BLOCK_DIAGMGR_BLACKBOX
      FeeBlockConfiguration10: FeeBlockNumber=576, FeeBlockSize=4, FeeBlockName=Deprecated_Block_TrqCmdScl_TorqueCmdSF_Uls_f32, FeeBlockConfiguration=18, FeeEEPNumber=1
        Fee
          FeeBlockConfiguration: FeeNvmBlockName=Deprecated_NvmBlock_TrqCmdScl_TorqueCmdSF_Uls_f32
      FeeBlockConfiguration14: FeeBlockNumber=608, FeeBlockSize=10, FeeBlockName=Deprecated_Block_LrnEOT_LearnedEOT, FeeBlockConfiguration=19, FeeEEPNumber=1
        Fee
          FeeBlockConfiguration: FeeNvmBlockName=Deprecated_NvmBlock_LrnEOT_LearnedEOT
      FeeBlockConfiguration41: FeeBlockNumber=640, FeeBlockSize=203, FeeBlockName=Deprecated_Block_AvgFricLrn_AvgFricLrnData, FeeBlockConfiguration=20, FeeEEPNumber=1
        Fee
          FeeBlockConfiguration: FeeNvmBlockName=Deprecated_NvmBlock_AvgFricLrn_AvgFricLrnData
      FeeBlockConfiguration43: FeeBlockNumber=672, FeeBlockSize=6, FeeBlockName=Fee_Block_BatteryVoltage_OvervoltageData, FeeBlockConfiguration=21, FeeEEPNumber=1
        Fee
          FeeBlockConfiguration: FeeNvmBlockName=Rte_NvmBlock_BatteryVoltage_OvervoltageData
      FeeBlockConfiguration39: FeeBlockNumber=704, FeeBlockSize=4, FeeBlockName=Fee_Block_StaMd_CloseCheckData, FeeBlockConfiguration=22, FeeEEPNumber=1
        Fee
          FeeBlockConfiguration: FeeNvmBlockName=Rte_NvmBlock_StaMd_CloseCheckData
      FeeBlockConfiguration9: FeeBlockNumber=736, FeeBlockSize=100, FeeBlockName=Fee_Block_StaMd_TypeHRamBuffer, FeeBlockConfiguration=23, FeeEEPNumber=1
        Fee
          FeeBlockConfiguration: FeeNvmBlockName=Rte_NvmBlock_StaMd_TypeHRamBuffer
      FeeBlockConfiguration66: FeeBlockNumber=768, FeeBlockSize=245, FeeBlockName=Deprecated_Block_Dem, FeeBlockConfiguration=24, FeeEEPNumber=1
        Fee
          FeeBlockConfiguration: FeeNvmBlockName=Deprecated_NVM_BLOCK_DEM
      FeeBlockConfiguration48: FeeBlockNumber=800, FeeBlockSize=5, FeeBlockName=Deprecated_Block_AbsHwPos_EOLVehCntrOffset, FeeBlockConfiguration=25, FeeEEPNumber=1
        Fee
          FeeBlockConfiguration: FeeNvmBlockName=Deprecated_NvmBlock_AbsHwPos_EOLVehCntrOffset
      FeeBlockConfiguration47: FeeBlockNumber=832, FeeBlockSize=2, FeeBlockName=Fee_Block_DiagSvc_TuningSetSelect, FeeBlockConfiguration=26, FeeEEPNumber=0
        Fee
          FeeBlockConfiguration: FeeNvmBlockName=Rte_NvmBlock_DiagSvc_TuningSetSelectData
      FeeBlockConfiguration46: FeeBlockNumber=864, FeeBlockSize=6, FeeBlockName=Deprecated_Block_AbsHwPos_EOLVehCntrOffset1, FeeBlockConfiguration=27, FeeEEPNumber=1
        Fee
          FeeBlockConfiguration: FeeNvmBlockName=Deprecated_NvmBlock_AbsHwPos_EOLVehCntrOffset1
      FeeBlockConfiguration49: FeeBlockNumber=896, FeeBlockSize=18, FeeBlockName=Deprecated_Block_TrqCanc_CogTrqRplComp, FeeBlockConfiguration=28, FeeEEPNumber=0
        Fee
          FeeBlockConfiguration: FeeNvmBlockName=Deprecated_NvmBlock_TrqCanc_CogTrqRplComp
      FeeBlockConfiguration58: FeeBlockNumber=928, FeeBlockSize=1, FeeBlockName=Fee_Block_AstLmt_SteerAsstDefeat, FeeBlockConfiguration=29, FeeEEPNumber=0
        Fee
          FeeBlockConfiguration: FeeNvmBlockName=Rte_NvmBlock_AstLmt_SteerAsstDefeat
      FeeBlockConfiguration51: FeeBlockNumber=960, FeeBlockSize=4, FeeBlockName=Fee_Block_ThrmlDutyCycle_FltStVal, FeeBlockConfiguration=30, FeeEEPNumber=1
        Fee
          FeeBlockConfiguration: FeeNvmBlockName=Rte_NvmBlock_ThrmlDutyCycle_ThrmlDutyCycle_FltStVal
      FeeBlockConfiguration52: FeeBlockNumber=992, FeeBlockSize=16, FeeBlockName=Fee_Block_DiagMgr_LatchCntrs, FeeBlockConfiguration=31, FeeEEPNumber=1
        Fee
          FeeBlockConfiguration: FeeNvmBlockName=NVM_BLOCK_DIAGMGR_LATCHCNTRS
      FeeBlockConfiguration53: FeeBlockNumber=1024, FeeBlockSize=10, FeeBlockName=Fee_Block_DigHwTrqSENT_DigTrqTrim, FeeBlockConfiguration=32, FeeEEPNumber=0
        Fee
          FeeBlockConfiguration: FeeNvmBlockName=Rte_NvmBlock_DigHwTrqSENT_DigTrqTrim
      FeeBlockConfiguration11: FeeBlockNumber=1056, FeeBlockSize=98, FeeBlockName=Deprecated_Block_CmMtrCurr_CurrTempOffset, FeeBlockConfiguration=33, FeeEEPNumber=0
        Fee
          FeeBlockConfiguration: FeeNvmBlockName=Deprecated_NvmBlock_CmMtrCurr_CurrTempOffset
      FeeBlockConfiguration55: FeeBlockNumber=1088, FeeBlockSize=30, FeeBlockName=Fee_Block_CmMtrCurr_ShCurrCal, FeeBlockConfiguration=34, FeeEEPNumber=0
        Fee
          FeeBlockConfiguration: FeeNvmBlockName=Rte_NvmBlock_CmMtrCurr_ShCurrCal
      FeeBlockConfiguration56: FeeBlockNumber=1120, FeeBlockSize=1026, FeeBlockName=Fee_Block_TrqCanc_CogTrqCal, FeeBlockConfiguration=35, FeeEEPNumber=0
        Fee
          FeeBlockConfiguration: FeeNvmBlockName=Rte_NvmBlock_TrqCanc_CogTrqCal
      FeeBlockConfiguration57: FeeBlockNumber=1152, FeeBlockSize=20, FeeBlockName=Fee_Block_TrqCanc_CogTrqRplComp, FeeBlockConfiguration=36, FeeEEPNumber=0
        Fee
          FeeBlockConfiguration: FeeNvmBlockName=Rte_NvmBlock_TrqCanc_CogTrqRplComp
      FeeBlockConfiguration50: FeeBlockNumber=1184, FeeBlockSize=2, FeeBlockName=Deprecated_Block_AstLmt_SteerAsstDefeat, FeeBlockConfiguration=37, FeeEEPNumber=0
        Fee
          FeeBlockConfiguration: FeeNvmBlockName=Deprecated_NvmBlock_AstLmt_SteerAsstDefeat
      FeeBlockConfiguration59: FeeBlockNumber=1216, FeeBlockSize=8, FeeBlockName=Fee_Block_TrqCmdScl_TorqueCmdSF_Uls_f32, FeeBlockConfiguration=38, FeeEEPNumber=1
        Fee
          FeeBlockConfiguration: FeeNvmBlockName=Rte_NvmBlock_TrqCmdScl_TorqueCmdSF_Uls_f32
      FeeBlockConfiguration60: FeeBlockNumber=1248, FeeBlockSize=12, FeeBlockName=Fee_Block_LrnEOT_LearnedEOT, FeeBlockConfiguration=39, FeeEEPNumber=1
        Fee
          FeeBlockConfiguration: FeeNvmBlockName=Rte_NvmBlock_LrnEOT_LearnedEOT
      FeeBlockConfiguration61: FeeBlockNumber=1280, FeeBlockSize=205, FeeBlockName=Fee_Block_AvgFricLrn_AvgFricLrnData, FeeBlockConfiguration=40, FeeEEPNumber=1
        Fee
          FeeBlockConfiguration: FeeNvmBlockName=Rte_NvmBlock_AvgFricLrn_AvgFricLrnData
      FeeBlockConfiguration62: FeeBlockNumber=1312, FeeBlockSize=10, FeeBlockName=Fee_Block_AbsHwPos_EOLVehCntrOffset, FeeBlockConfiguration=41, FeeEEPNumber=1
        Fee
          FeeBlockConfiguration: FeeNvmBlockName=Rte_NvmBlock_AbsHwPos_EOLVehCntrOffset
      FeeBlockConfiguration63: FeeBlockNumber=1344, FeeBlockSize=10, FeeBlockName=Fee_Block_DiagSvc_SupplierIdentifier, FeeBlockConfiguration=42, FeeEEPNumber=0
        Fee
          FeeBlockConfiguration: FeeNvmBlockName=Rte_NvmBlock_DiagSvc_SupplierIdentifierData
      FeeBlockConfiguration64: FeeBlockNumber=1376, FeeBlockSize=10, FeeBlockName=Fee_Block_DiagSvc_SparePartNumber, FeeBlockConfiguration=43, FeeEEPNumber=0
        Fee
          FeeBlockConfiguration: FeeNvmBlockName=Rte_NvmBlock_DiagSvc_SparePartNumberData
      FeeBlockConfiguration65: FeeBlockNumber=1408, FeeBlockSize=5, FeeBlockName=Fee_Block_VehDyn_MtrPosReset, FeeBlockConfiguration=44, FeeEEPNumber=1
        Fee
          FeeBlockConfiguration: FeeNvmBlockName=Rte_NvmBlock_VehDyn_MotPosReset
      FeeBlockConfiguration8: FeeBlockNumber=1440, FeeBlockSize=315, FeeBlockName=Fee_Block_Dem, FeeBlockConfiguration=45, FeeEEPNumber=1
        Fee
          FeeBlockConfiguration: FeeNvmBlockName=NvM_NVM_BLOCK_DEM
  module config FlsTst: implementation-config-variant=VARIANT-PRE-COMPILE  # Configuration of the Flash Test module
    Runtime (FlsTstConfigSet): FlsTstBlockNumberBgnd=2, FlsTstBlockNumberFgnd=0, FlsTstTestCompletedNotification=Appl_FlsTstCompletedNotif
      FlsTstBlockBgndConfigSet
        3 x FlsTstBlock, all with FlsTstBlockBaseAddress=(unset), FlsTstBlockIndex=(unset), FlsTstNumberOfTestedCells=(unset), FlsTstSignatureAddress=(unset), FlsTstTestAlgorithm=FLSTST_64BIT_CRC:
          Cal: FlsTstBlockBaseSymbol=CCT_Range_11_Start, FlsTstBlockSize=262136, FlsTstSignatureSymbol=CCT_Range_11_Address
          App: FlsTstBlockBaseSymbol=CCT_Range_10_Start, FlsTstBlockSize=475104, FlsTstSignatureSymbol=CCT_Range_10_Address
          Boot: FlsTstBlockBaseSymbol=BootCRC_Start, FlsTstBlockSize=49136, FlsTstSignatureSymbol=BootCRC_Address
    FlsTstConfigurationOfOptApiServices:
      FlsTstGetCurrentStateApi = false
      FlsTstGetErrorDetailsApi = false
      FlsTstGetTestResultBgndApi = false
      FlsTstGetTestResultFgndApi = false
      FlsTstGetTestSignatureBgndApi = false
      FlsTstGetTestSignatureFgndApi = false
      FlsTstStartFgndApi = false
      FlsTstSuspendResumeApi = true
      FlsTstTestEccApi = false
      FlsTstVersionInfoApi = false
    FlsTstDemEventParameterRefs:
      FLSTST_E_FLSTST_FAILURE = NTC_Num_FlashCRCMemFault
      FLSTST_E_FLSTST_INFO = 1
      FLSTST_E_SELFTEST_FAILURE = NTC_Num_CPU_CoreInitFlt
      FLSTST_E_SELFTEST_INFO = 8
      FLSTST_E_MPU_FAILURE = NTC_Num_PerDiag_DMAFlt
      FLSTST_E_MPU_INFO = 128
      FLSTST_E_UNEXPECTEDIRQ_FAILURE = NTC_Num_FlashCRCMemFault
      FLSTST_E_UNEXPECTEDIRQ_INFO = 1
      FlsTstDemInclude = Ap_DiagMgr.h
      FailureAPI = NxtrDiagMgr10_ReportNTCStatus
    FlsTstGeneral:
      FlsTstDevErrorDetect = false
      FlsTstNumberOfTestedCellsAtomic = 1
      FlsTstTestCompletedNotificationSupported = true
      FlsTstTestIntervalIdEndValue = 4294967295
      FlsTstTestResultSignature = false
    CommonPublishedInformation: ArMajorVersion=1, ArMinorVersion=2, ArPatchVersion=0, SwMajorVersion=1, SwMinorVersion=0, SwPatchVersion=0, ModuleId=104, VendorId=0
  module config FrqDepDmpnInrtCmp: implementation-config-variant=VARIANT-PRE-COMPILE  # Configuration of the Nexteer FrqDepDmpnInrtCmp module.
    FrqDepDmpnInrtCmpGeneral
    CommonPublishedInformation: ArMajorVersion=3, ArMinorVersion=2, ArPatchVersion=0, SwMajorVersion=0, SwMinorVersion=0, SwPatchVersion=0, ModuleId=0, VendorId=0
  module config Gpt: implementation-config-variant=VARIANT-POST-BUILD, module-description=Gpt_Impl  # Configuration of the Gpt (General Purpose Timer) module.
    Gpt_Runtime (GptChannelConfigSet):
      GptChannelPrescaleClk0 = 79
      GptChannelPrescaleClk1 = 79
      GptMcuVariant = McuModuleConfiguration
      GptMcuClockconfig = McuClockSettingConfig
      GptMainclock = RTICLK1
      GptClockFrequency = 80
      SystemTime_uS (GptChannelConfiguration):
        GptChannelClkSrc = 0
        GptChannelMode = GPT_MODE_CONTINUOUS
        GptChannelPrescale = 0
        GptEnableWakeup = false
        GptNotification = SystemTick
        GptHwChannel = 0
        GptChannelId = 0
        GptResolution = 1
        GptWakeupConfiguration
    GptConfigurationOfOptApiServices:
      GptDeinitApi = true
      GptEnableDisableNotificationApi = true
      GptTimeElapsedApi = true
      GptTimeRemainingApi = true
      GptVersionInfoApi = false
      GptWakeupFunctionalityApi = true
    GptDriverConfiguration:
      GptDevErrorDetect = false
      GptReportWakeupSource = true
      GptCfgWakeupInclude = EcuM_Cbk.h
      GptErrorhook = Det_ReportError
      GptCfgIncludeDet = Det.h
      GptCfgChkUninit = true
      GptCfgChkParamChl = false
      GptCfgChkParamMode = true
      GptCfgChkParamValue = true
      GptCfgChkParamVinfo = true
      GptCfgChkBusy = true
      GptCfgIncludeList = ApplCallbacks.h
      GptCfgChkParamConfig = true
      GptCfgDoParamChk = true
      GptCfgChkParamWakeupchl = false
      GptCfgChkNotifptr = true
      GptCfgDebugReporting = true
      GptCfgChkAlreadyInit = true
      GptCfgChkNotStarted = true
      GptSpecRegAccEnabled = true
      GptSpecRegAccOnlyForWrite = true
      GptSpecRegAccOnlyForPrivModeReg = true
      GptSpecRegAccNotInInit = false
      GptNativeIsr = GPT_ISR_CAT2
      GptIrqHandling = InterruptFunctionSet
  module config Gsod: implementation-config-variant=VARIANT-PRE-COMPILE  # Configuration of the Nexteer Gsod module.
    GsodGeneral
    CommonPublishedInformation: ArMajorVersion=3, ArMinorVersion=2, ArPatchVersion=0, SwMajorVersion=0, SwMinorVersion=0, SwPatchVersion=0, ModuleId=0, VendorId=0
  module config HighFreqAssist: implementation-config-variant=VARIANT-PRE-COMPILE  # Configuration of the Nexteer HighFreqAssist module.
    HighFreqAssistGeneral
    CommonPublishedInformation: ArMajorVersion=3, ArMinorVersion=2, ArPatchVersion=0, SwMajorVersion=0, SwMinorVersion=0, SwPatchVersion=0, ModuleId=0, VendorId=0
  module config HiLoadStall: implementation-config-variant=VARIANT-PRE-COMPILE  # Configuration of the Nexteer HiLoadStall module.
    HiLoadStallGeneral
    CommonPublishedInformation: ArMajorVersion=3, ArMinorVersion=2, ArPatchVersion=0, SwMajorVersion=0, SwMinorVersion=0, SwPatchVersion=0, ModuleId=0, VendorId=0
  module config HwPwUp: implementation-config-variant=VARIANT-PRE-COMPILE  # Configuration of the Nexteer HwPwUp module.
    HwPwUpGeneral: HwPwUpPgmSpecMask=0
    CommonPublishedInformation: ArMajorVersion=3, ArMinorVersion=2, ArPatchVersion=0, SwMajorVersion=0, SwMinorVersion=0, SwPatchVersion=0, ModuleId=0, VendorId=0
  module config HystComp: implementation-config-variant=VARIANT-PRE-COMPILE  # Configuration of the Nexteer HystComp module.
    HystCompGeneral
    CommonPublishedInformation: ArMajorVersion=3, ArMinorVersion=2, ArPatchVersion=0, SwMajorVersion=0, SwMinorVersion=0, SwPatchVersion=0, ModuleId=0, VendorId=0
  module config IoHwAb: definition=IoHwAbstraction, implementation-config-variant=VARIANT-PRE-COMPILE, module-description=IoHwAbstraction_Impl  # Configuration of IO HW Abstraction.
    IoHwAbCalSignals
      11 x IoHwAbDiscrete, all with IoHwAbCreateOpDiag=false, IoHwAbDcmAccess=false, IoHwAbCalSourceType=DioChannel, IoHwAbRequirementId=(unset):
        EpsEn: IoHwAbCreateOpSet=false, IoHwAbCreateOpGet=true, IoHwAbDcmDefaultValue=0, IoHwAbDioEntity=ADC1_Ch0
        PwrSwitchEn: IoHwAbCreateOpSet=false, IoHwAbCreateOpGet=true, IoHwAbDioEntity=NHet_Ch8
        FetDrvCntl: IoHwAbCreateOpSet=false, IoHwAbCreateOpGet=true, IoHwAbDioEntity=NHet_Ch4
        FetFlt2Clk: IoHwAbCreateOpSet=true, IoHwAbCreateOpGet=true, IoHwAbDioEntity=NHet_Ch26
        FetFlt1Data: IoHwAbCreateOpSet=false, IoHwAbCreateOpGet=true, IoHwAbDioEntity=NHet_Ch24
        SysFault2: IoHwAbCreateOpSet=true, IoHwAbCreateOpGet=true, IoHwAbDioEntity=NHet_Ch15
        WdMonitor: IoHwAbCreateOpSet=true, IoHwAbCreateOpGet=false, IoHwAbDioEntity=Can3Rx
        FetDrvReset: IoHwAbCreateOpSet=true, IoHwAbCreateOpGet=true, IoHwAbDioEntity=SPI3_NCS1
        WdReset: IoHwAbCreateOpSet=true, IoHwAbCreateOpGet=false, IoHwAbDioEntity=Can3Tx
        TODReset: IoHwAbCreateOpSet=true, IoHwAbCreateOpGet=false, IoHwAbDcmDefaultValue=0, IoHwAbDioEntity=NHet_Ch20
        OvrVoltFdbk: IoHwAbCreateOpSet=false, IoHwAbCreateOpGet=true, IoHwAbDioEntity=NHet_Ch22
    IoHwAbUserDefSignals
      IoHwAbPortConfig (IoHwAbUserDefPort)
        SetFetFlt2ToOutput (IoHwAbUserDefinedOp):
          IoHwAbAccess = Output
          IoHwAbDataType = IoHwAbBoolType
          IoHwAbUnit = None
          IoHwAbRangeMin = (unset)
          IoHwAbRangeMax = (unset)
          IoHwAbResolution = (unset)
          IoHwAbDcmAccess = false
          IoHwAbRequirementId = (unset)
          IoHwAbDcmDefaultValue = 0
      SysFault3 (IoHwAbUserDefPort)
        OP_GET (IoHwAbUserDefinedOp):
          IoHwAbAccess = Input
          IoHwAbDataType = IoHwAbBoolType
          IoHwAbUnit = None
          IoHwAbRangeMin = 0
          IoHwAbRangeMax = (unset)
          IoHwAbResolution = (unset)
          IoHwAbDcmAccess = false
          IoHwAbRequirementId = (unset)
        OP_SET (IoHwAbUserDefinedOp):
          IoHwAbAccess = Output
          IoHwAbDataType = IoHwAbBoolType
          IoHwAbUnit = None
          IoHwAbRangeMin = 0
          IoHwAbRangeMax = (unset)
          IoHwAbResolution = (unset)
          IoHwAbDcmAccess = false
          IoHwAbRequirementId = (unset)
    IoHwAbHandlers
    IoHwAbGeneral:
      IoHwAbDevErrorDetect = true
      IoHwAbDevErrorReport = true
      IoHwAbVersionInfoApi = true
      IoHwAbUseInitFunction = false
      IoHwAbUseRte = true
      IoHwAbUseServicePorts = false
      IoHwAbServiceComponentName = IoHwAbstraction
      IoHwAbErrorhook = Det_ReportError
      IoHwAbCfgIncludeDet = Det.h
      IoHwAbCfgIncludeList = Dio.h
      IoHwAbIrqHandling = SuspendAllInterrupts
      IoHwAbErrorChecks: IoHwAbCfgChkParamPointer=true
      IoHwAbDataTypeSizes:
        IoHwAbDiscreteGroupSize = IOHWAB_UINT8
        IoHwAbCurrentType = IOHWAB_UINT16
        IoHwAbVoltageType = IOHWAB_UINT16
        IoHwAbResistanceType = IOHWAB_UINT16
        IoHwAbSignalDiagnosisType = IOHWAB_UINT16
        IoHwAbPwxPeriodType = IOHWAB_UINT16
        IoHwAbPwxDutyCycleType = IOHWAB_UINT16
    VectorCommonData: BswmdVersion=1.04.06
  module config LmtCod: implementation-config-variant=VARIANT-PRE-COMPILE  # Configuration of the Nexteer LmtCod module.
    LmtCodGeneral
    CommonPublishedInformation: ArMajorVersion=3, ArMinorVersion=2, ArPatchVersion=0, SwMajorVersion=0, SwMinorVersion=0, SwPatchVersion=0, ModuleId=0, VendorId=0
  module config LrnEOT: implementation-config-variant=VARIANT-PRE-COMPILE  # Configuration of the Nexteer LrnEOT module.
    LrnEOTGeneral
    CommonPublishedInformation: ArMajorVersion=3, ArMinorVersion=2, ArPatchVersion=0, SwMajorVersion=0, SwMinorVersion=0, SwPatchVersion=0, ModuleId=0, VendorId=0
  module config MemIf: implementation-config-variant=VARIANT-PRE-COMPILE, module-description=MemIf_Impl  # Configuration of the MemIf (Memory Abstraction Interface) module.
    MemIfGeneral: MemIfDevErrorDetect=true, MemIfVersionInfoApi=true
    MemIfAdditional:
      MemIfCfgChkParamDevIndex = true
      MemIfCfgChkParamVInfo = true
      MemIfDebugReporting = true
      MemIfCfgIncludeDet = Det.h
      MemIfErrorhook = Det_ReportError
      MemIfCfgUseFctApi = true
  module config MtrDrvDiag: implementation-config-variant=VARIANT-PRE-COMPILE  # Configuration of the Nexteer MtrDrvDiag module.
    MtrDrvDiagGeneral
    CommonPublishedInformation: ArMajorVersion=3, ArMinorVersion=2, ArPatchVersion=0, SwMajorVersion=0, SwMinorVersion=0, SwPatchVersion=0, ModuleId=0, VendorId=0
  module config MtrTempEst: implementation-config-variant=VARIANT-PRE-COMPILE  # Configuration of the Nexteer MtrTempEst module.
    MtrTempEstGeneral
    CommonPublishedInformation: ArMajorVersion=3, ArMinorVersion=2, ArPatchVersion=0, SwMajorVersion=0, SwMinorVersion=0, SwPatchVersion=0, ModuleId=0, VendorId=0
  module config MtrVel: implementation-config-variant=VARIANT-PRE-COMPILE  # Configuration of the Nexteer MtrVel module.
    MtrVelGeneral
    CommonPublishedInformation: ArMajorVersion=3, ArMinorVersion=2, ArPatchVersion=0, SwMajorVersion=0, SwMinorVersion=0, SwPatchVersion=0, ModuleId=0, VendorId=0
  module config MtrVel2: implementation-config-variant=VARIANT-PRE-COMPILE  # Configuration of the Nexteer MtrVel2 module.
    MtrVel2General
    CommonPublishedInformation: ArMajorVersion=3, ArMinorVersion=2, ArPatchVersion=0, SwMajorVersion=0, SwMinorVersion=0, SwPatchVersion=0, ModuleId=0, VendorId=0
  module config NvM: implementation-config-variant=VARIANT-LINK-TIME, module-description=NvM_Impl  # Configuration of the NvM (NvRam Manager) module.
    Rte_NvmBlock_Polarity_Polarity_Cnt_Str (NvmBlockDescriptor):
      NvmNvramBlockIdentifier = 2
      NvmDeviceName = Fee
      NvmBlockManagementType = NVM_BLOCK_NATIVE
      NvmBlockUseCrc = true
      NvmBlockCRCType = NVM_CRC16
      NvmBlockUsedCrcType = NVM_CRC16
      NvmCalcRamBlockCrc = true
      NvmBlockJobPriority = 127
      NvmNvBlockLength = 2
      NvmNvBlockNum = 1
      NvmUseServicePorts = true
      NvmWriteBlockOnce = false
      NvmBlockWriteProt = false
      NvmResistantToChangedSw = true
      NvmSelectBlockForReadall = true
      NvmRamBlockDataAddress = Rte_Polarity_Polarity_Cnt_Str
      NvmRomBlockDataAddress = (unset)
      NvmUseInitCallback = false
      NvmInitBlockCallback = NULL_PTR
      NvmUseJobendCallback = false
      NvmJobendCbkAtReadAll = false
      NvmSingleBlockCallback = NULL_PTR
      NvmRequirementId = (unset)
      NvmTargetBlockReference
        NvmFeeRef: NvmNameOfFeeBlock=FeeBlockConfiguration4
    NvmCommon:
      NvmDevErrorDetect = true
      NvmApiConfigClass = NvmApiConfigClass3
      NvmVersionInfoApi = false
      NvmSetRamBlockStatusApi = true
      NvmDrvModeSwitch = true
      NvmPollingMode = true
      NvmDynamicConfiguration = true
      NvmJobPrioritization = false
      NvmCrcNumOfBytes = 65535
      NvmDatasetSelectionBits = 5
      NvmSizeImmediateJobQueue = 1
      NvmSizeStandardJobQueue = 8
      NvmMaxNoOfWriteRetries = 3
      NvmTotalNumOfNvramBlocks = 2
      NvmCompiledConfigId = 1
      NvmMultiBlockCallback = EcuM_CB_NfyNvMJobEnd
    Nvm_30_CommonVendorParams:
      NvmDebugReporting = true
      NvmCfgIncludeDet = Det.h
      NvmErrorhook = Det_ReportError
      NvmCfgChkStatusUninit = true
      NvmCfgChkRamBlockLengths = false
      NvmCfgChkRomBlockLengths = false
      NvmCfgChkBlockLengthStrict = true
      NvmCfgChkMngmtType = true
      NvmCfgChkBlockProtection = true
      NvmCfgChkBlockPending = false
      NvmCfgChkDoParamChk = true
      NvmCfgChkParamBlockid = true
      NvmCfgChkParamDataIndex = true
      NvmCfgChkParamPointer = true
      NvmCfgIncludeDem = Dem.h
      NvmSeterror = Dem_ReportErrorStatus
      NvmCfgCbkIncludeList = EcuM_Cbk.h
      NvmCfgCbkIncludeList = CDD_Data.h
      NvmCfgCbkIncludeList = Ap_StaMd_Cfg.h
      NvmCfgCbkIncludeList = Ap_DiagMgr.h
      NvmCfgCbkIncludeList = Dem.h
      NvmCfgCbkIncludeList = Dem_Lcfg.h
      NvmCfgCbkIncludeList = ApplCallbacks.h
      NvmCfgCbkIncludeList = Ap_DfltConfigData.h
      NvmCfgCbkIncludeList = EPS_DiagSrvcs_SrvcLUTbl.h
      NvmCfgCbkIncludeList = Crc.h
      NvmCfgCbkIncludeList = Cd_NvMProxy.h
      NvmMultiblockId = MultiBlockRequest
      NvmServiceComponentName = NvM
      Nvm_UseLongSwcNames = true
      NvmSrvPortInitBlockPrefix = Nvm_RpNotifyInit_
      NvmSrvPortJobEndPrefix = NvM_RpNotifyJobEnd_
      NvmCrcIntBuffer = true
      NvmCrcPreserveValue = true
      NvmKillWriteAllApi = true
      NvmLockSet = SuspendAllInterrupts
    ConfigBlock (NvmConfigBlockDescriptor):
      NvmNvramBlockIdentifier = 1
      NvmDeviceName = Fee
      NvmBlockManagementType = NVM_BLOCK_REDUNDANT
      NvmBlockUseCrc = true
      NvmBlockCRCType = NVM_CRC16
      NvmCalcRamBlockCrc = true
      NvmBlockJobPriority = 127
      NvmNvBlockLength = 2
      NvmNvBlockNum = 2
      NvmUseServicePorts = true
      NvmWriteBlockOnce = false
      NvmBlockWriteProt = false
      NvmResistantToChangedSw = true
      NvmSelectBlockForReadall = true
      NvmRomBlockDataAddress = NULL_PTR
      NvmUseInitCallback = false
      NvmInitBlockCallback = NULL_PTR
      NvmUseJobendCallback = false
      NvmJobendCbkAtReadAll = false
      NvmSingleBlockCallback = (unset)
      NvmRequirementId = (unset)
      NvmTargetBlockReference
        NvmFeeRef: NvmNameOfFeeBlock=FeeBlockConfiguration42
    43 x NvmBlockDescriptor, all with NvmDeviceName=Fee, NvmBlockManagementType=NVM_BLOCK_NATIVE, NvmBlockCRCType=NVM_CRC16, NvmCalcRamBlockCrc=false, NvmBlockJobPriority=127, NvmNvBlockNum=1, NvmWriteBlockOnce=false, NvmBlockWriteProt=false, NvmResistantToChangedSw=true, NvmUseJobendCallback=false, NvmSingleBlockCallback=NULL_PTR, NvmRequirementId=(unset):
      NVM_BLOCK_DIAGMGR_NTCSTRG: NvmNvramBlockIdentifier=3, NvmBlockUseCrc=false, NvmBlockUsedCrcType=NVM_NOCRC, NvmNvBlockLength=60, NvmUseServicePorts=true, NvmSelectBlockForReadall=true, NvmRamBlockDataAddress=NTCStrgArray_Cnt_str, NvmRomBlockDataAddress=(unset), NvmUseInitCallback=false, NvmInitBlockCallback=NULL_PTR, NvmJobendCbkAtReadAll=false
        NvmTargetBlockReference
          NvmFeeRef: NvmNameOfFeeBlock=FeeBlockConfiguration6
      NVM_BLOCK_EPSDEFEATS: NvmNvramBlockIdentifier=4, NvmBlockUseCrc=false, NvmBlockUsedCrcType=NVM_NOCRC, NvmNvBlockLength=4, NvmUseServicePorts=true, NvmSelectBlockForReadall=true, NvmRamBlockDataAddress=CDD_EOLSrlComSvcDft_Cnt_G_b32, NvmRomBlockDataAddress=(unset), NvmUseInitCallback=false, NvmInitBlockCallback=NULL_PTR, NvmJobendCbkAtReadAll=false
        NvmTargetBlockReference
          NvmFeeRef: NvmNameOfFeeBlock=FeeBlockConfiguration7
      Deprecated_NVM_BLOCK_DEM: NvmNvramBlockIdentifier=5, NvmBlockUseCrc=false, NvmBlockUsedCrcType=NVM_NOCRC, NvmNvBlockLength=245, NvmUseServicePorts=true, NvmSelectBlockForReadall=false, NvmRamBlockDataAddress=(unset), NvmRomBlockDataAddress=(unset), NvmUseInitCallback=false, NvmInitBlockCallback=NULL_PTR, NvmJobendCbkAtReadAll=false
        NvmTargetBlockReference
          NvmFeeRef: NvmNameOfFeeBlock=FeeBlockConfiguration66
      Rte_NvmBlock_StaMd_TypeHRamBuffer: NvmNvramBlockIdentifier=6, NvmBlockUseCrc=false, NvmBlockUsedCrcType=NVM_NOCRC, NvmNvBlockLength=100, NvmUseServicePorts=true, NvmSelectBlockForReadall=true, NvmRamBlockDataAddress=TypeHData_Cnt_u08, NvmRomBlockDataAddress=(unset), NvmUseInitCallback=false, NvmInitBlockCallback=NULL_PTR, NvmJobendCbkAtReadAll=false
        NvmTargetBlockReference
          NvmFeeRef: NvmNameOfFeeBlock=FeeBlockConfiguration9
      Deprecated_NvmBlock_TrqCmdScl_TorqueCmdSF_Uls_f32: NvmNvramBlockIdentifier=7, NvmBlockUseCrc=false, NvmBlockUsedCrcType=NVM_NOCRC, NvmNvBlockLength=4, NvmUseServicePorts=true, NvmSelectBlockForReadall=false, NvmRamBlockDataAddress=(unset), NvmRomBlockDataAddress=(unset), NvmUseInitCallback=false, NvmInitBlockCallback=NULL_PTR, NvmJobendCbkAtReadAll=false
        NvmTargetBlockReference
          NvmFeeRef: NvmNameOfFeeBlock=FeeBlockConfiguration10
      Deprecated_NvmBlock_CmMtrCurr_CurrTempOffset: NvmNvramBlockIdentifier=8, NvmBlockUseCrc=false, NvmBlockUsedCrcType=NVM_NOCRC, NvmNvBlockLength=98, NvmUseServicePorts=true, NvmSelectBlockForReadall=false, NvmRamBlockDataAddress=(unset), NvmRomBlockDataAddress=(unset), NvmUseInitCallback=false, NvmInitBlockCallback=NULL_PTR, NvmJobendCbkAtReadAll=false
        NvmTargetBlockReference
          NvmFeeRef: NvmNameOfFeeBlock=FeeBlockConfiguration11
      Deprecated_NvmBlock_CmMtrCurr_ShCurrCal: NvmNvramBlockIdentifier=9, NvmBlockUseCrc=false, NvmBlockUsedCrcType=NVM_NOCRC, NvmNvBlockLength=28, NvmUseServicePorts=true, NvmSelectBlockForReadall=false, NvmRamBlockDataAddress=(unset), NvmRomBlockDataAddress=(unset), NvmUseInitCallback=false, NvmInitBlockCallback=NULL_PTR, NvmJobendCbkAtReadAll=false
        NvmTargetBlockReference
          NvmFeeRef: NvmNameOfFeeBlock=FeeBlockConfiguration12
      Rte_NvmBlock_CurrParamComp_EOLNomMtrParam: NvmNvramBlockIdentifier=10, NvmBlockUseCrc=false, NvmBlockUsedCrcType=NVM_NOCRC, NvmNvBlockLength=8, NvmUseServicePorts=true, NvmSelectBlockForReadall=true, NvmRamBlockDataAddress=Rte_CurrParamComp_EOLNomMtrParam, NvmRomBlockDataAddress=(unset), NvmUseInitCallback=false, NvmInitBlockCallback=NULL_PTR, NvmJobendCbkAtReadAll=false
        NvmTargetBlockReference
          NvmFeeRef: NvmNameOfFeeBlock=FeeBlockConfiguration13
      Deprecated_NvmBlock_LrnEOT_LearnedEOT: NvmNvramBlockIdentifier=11, NvmBlockUseCrc=false, NvmBlockUsedCrcType=NVM_NOCRC, NvmNvBlockLength=10, NvmUseServicePorts=true, NvmSelectBlockForReadall=false, NvmRamBlockDataAddress=(unset), NvmRomBlockDataAddress=(unset), NvmUseInitCallback=false, NvmInitBlockCallback=NULL_PTR, NvmJobendCbkAtReadAll=false
        NvmTargetBlockReference
          NvmFeeRef: NvmNameOfFeeBlock=FeeBlockConfiguration14
      Deprecated_NvmBlock_TrqCanc_CogTrqCal: NvmNvramBlockIdentifier=12, NvmBlockUseCrc=false, NvmBlockUsedCrcType=NVM_NOCRC, NvmNvBlockLength=1024, NvmUseServicePorts=true, NvmSelectBlockForReadall=false, NvmRamBlockDataAddress=(unset), NvmRomBlockDataAddress=(unset), NvmUseInitCallback=false, NvmInitBlockCallback=NULL_PTR, NvmJobendCbkAtReadAll=false
        NvmTargetBlockReference
          NvmFeeRef: NvmNameOfFeeBlock=FeeBlockConfiguration15
      NVM_BLOCK_CMS_NXTRMEC: NvmNvramBlockIdentifier=13, NvmBlockUseCrc=false, NvmBlockUsedCrcType=NVM_NOCRC, NvmNvBlockLength=1, NvmUseServicePorts=true, NvmSelectBlockForReadall=true, NvmRamBlockDataAddress=Nvm_NMEC_Cnt_u8, NvmRomBlockDataAddress=(unset), NvmUseInitCallback=false, NvmInitBlockCallback=NULL_PTR, NvmJobendCbkAtReadAll=false
        NvmTargetBlockReference
          NvmFeeRef: NvmNameOfFeeBlock=FeeBlockConfiguration33
      NVM_BLOCK_CMS_ECUSRLNUM: NvmNvramBlockIdentifier=14, NvmBlockUseCrc=false, NvmBlockUsedCrcType=NVM_NOCRC, NvmNvBlockLength=4, NvmUseServicePorts=true, NvmSelectBlockForReadall=true, NvmRamBlockDataAddress=Nvm_EcuSrlNum_Cnt_u8, NvmRomBlockDataAddress=(unset), NvmUseInitCallback=false, NvmInitBlockCallback=NULL_PTR, NvmJobendCbkAtReadAll=false
        NvmTargetBlockReference
          NvmFeeRef: NvmNameOfFeeBlock=FeeBlockConfiguration34
      NVM_BLOCK_CMS_EPSSRLNUM: NvmNvramBlockIdentifier=15, NvmBlockUseCrc=false, NvmBlockUsedCrcType=NVM_NOCRC, NvmNvBlockLength=4, NvmUseServicePorts=true, NvmSelectBlockForReadall=true, NvmRamBlockDataAddress=Nvm_EpsSrlNum_Cnt_u8, NvmRomBlockDataAddress=(unset), NvmUseInitCallback=false, NvmInitBlockCallback=NULL_PTR, NvmJobendCbkAtReadAll=false
        NvmTargetBlockReference
          NvmFeeRef: NvmNameOfFeeBlock=FeeBlockConfiguration35
      NVM_BLOCK_CMS_ECUHWPN: NvmNvramBlockIdentifier=16, NvmBlockUseCrc=false, NvmBlockUsedCrcType=NVM_NOCRC, NvmNvBlockLength=12, NvmUseServicePorts=true, NvmSelectBlockForReadall=true, NvmRamBlockDataAddress=Nvm_EcuHwPn_Cnt_u8, NvmRomBlockDataAddress=(unset), NvmUseInitCallback=false, NvmInitBlockCallback=NULL_PTR, NvmJobendCbkAtReadAll=false
        NvmTargetBlockReference
          NvmFeeRef: NvmNameOfFeeBlock=FeeBlockConfiguration36
      NVM_BLOCK_CMS_NXTRMANUFSCRATCHPAD: NvmNvramBlockIdentifier=17, NvmBlockUseCrc=false, NvmBlockUsedCrcType=NVM_NOCRC, NvmNvBlockLength=64, NvmUseServicePorts=true, NvmSelectBlockForReadall=true, NvmRamBlockDataAddress=Nvm_NxtrManfScrpd_Cnt_u8, NvmRomBlockDataAddress=(unset), NvmUseInitCallback=false, NvmInitBlockCallback=NULL_PTR, NvmJobendCbkAtReadAll=false
        NvmTargetBlockReference
          NvmFeeRef: NvmNameOfFeeBlock=FeeBlockConfiguration37
      NVM_BLOCK_CMS_IGNCNTR: NvmNvramBlockIdentifier=18, NvmBlockUseCrc=false, NvmBlockUsedCrcType=NVM_NOCRC, NvmNvBlockLength=2, NvmUseServicePorts=true, NvmSelectBlockForReadall=true, NvmRamBlockDataAddress=Nvm_IgnCntr_Cnt_u16, NvmRomBlockDataAddress=(unset), NvmUseInitCallback=false, NvmInitBlockCallback=NULL_PTR, NvmJobendCbkAtReadAll=false
        NvmTargetBlockReference
          NvmFeeRef: NvmNameOfFeeBlock=FeeBlockConfiguration38
      Rte_NvmBlock_StaMd_CloseCheckData: NvmNvramBlockIdentifier=19, NvmBlockUseCrc=false, NvmBlockUsedCrcType=NVM_NOCRC, NvmNvBlockLength=4, NvmUseServicePorts=true, NvmSelectBlockForReadall=true, NvmRamBlockDataAddress=NvMP_CloseCheck_Cnt_u32, NvmRomBlockDataAddress=(unset), NvmUseInitCallback=false, NvmInitBlockCallback=NULL_PTR, NvmJobendCbkAtReadAll=false
        NvmTargetBlockReference
          NvmFeeRef: NvmNameOfFeeBlock=FeeBlockConfiguration39
      NVM_BLOCK_DIAGMGR_BLACKBOX: NvmNvramBlockIdentifier=20, NvmBlockUseCrc=false, NvmBlockUsedCrcType=NVM_NOCRC, NvmNvBlockLength=192, NvmUseServicePorts=true, NvmSelectBlockForReadall=true, NvmRamBlockDataAddress=NTCBlackBoxData_Cnt_str, NvmRomBlockDataAddress=(unset), NvmUseInitCallback=false, NvmInitBlockCallback=NULL_PTR, NvmJobendCbkAtReadAll=false
        NvmTargetBlockReference
          NvmFeeRef: NvmNameOfFeeBlock=FeeBlockConfiguration40
      Deprecated_NvmBlock_AvgFricLrn_AvgFricLrnData: NvmNvramBlockIdentifier=21, NvmBlockUseCrc=false, NvmBlockUsedCrcType=NVM_NOCRC, NvmNvBlockLength=203, NvmUseServicePorts=true, NvmSelectBlockForReadall=true, NvmRamBlockDataAddress=Rte_AvgFricLrn_AvgFricLrnData, NvmRomBlockDataAddress=(unset), NvmUseInitCallback=false, NvmInitBlockCallback=NULL_PTR, NvmJobendCbkAtReadAll=false
        NvmTargetBlockReference
          NvmFeeRef: NvmNameOfFeeBlock=FeeBlockConfiguration41
      Rte_NvmBlock_BatteryVoltage_OvervoltageData: NvmNvramBlockIdentifier=22, NvmBlockUseCrc=false, NvmBlockUsedCrcType=NVM_NOCRC, NvmNvBlockLength=6, NvmUseServicePorts=true, NvmSelectBlockForReadall=true, NvmRamBlockDataAddress=Rte_BatteryVoltage_OvervoltageData, NvmRomBlockDataAddress=(unset), NvmUseInitCallback=false, NvmInitBlockCallback=NULL_PTR, NvmJobendCbkAtReadAll=false
        NvmTargetBlockReference
          NvmFeeRef: NvmNameOfFeeBlock=FeeBlockConfiguration43
      Rte_NvmBlock_DigMSB_DigMSBEOLData: NvmNvramBlockIdentifier=23, NvmBlockUseCrc=false, NvmBlockUsedCrcType=NVM_NOCRC, NvmNvBlockLength=4102, NvmUseServicePorts=true, NvmSelectBlockForReadall=true, NvmRamBlockDataAddress=Rte_DigMSB_DigMSBEOLData, NvmRomBlockDataAddress=(unset), NvmUseInitCallback=false, NvmInitBlockCallback=NULL_PTR, NvmJobendCbkAtReadAll=false
        NvmTargetBlockReference
          NvmFeeRef: NvmNameOfFeeBlock=FeeBlockConfiguration44
      Deprecated_NvmBlock_DigHwTrqSENT_DigTrqTrim: NvmNvramBlockIdentifier=24, NvmBlockUseCrc=false, NvmBlockUsedCrcType=NVM_NOCRC, NvmNvBlockLength=5, NvmUseServicePorts=true, NvmSelectBlockForReadall=false, NvmRamBlockDataAddress=(unset), NvmRomBlockDataAddress=(unset), NvmUseInitCallback=false, NvmInitBlockCallback=NULL_PTR, NvmJobendCbkAtReadAll=false
        NvmTargetBlockReference
          NvmFeeRef: NvmNameOfFeeBlock=FeeBlockConfiguration45
      Deprecated_NvmBlock_AbsHwPos_EOLVehCntrOffset: NvmNvramBlockIdentifier=25, NvmBlockUseCrc=false, NvmBlockUsedCrcType=NVM_NOCRC, NvmNvBlockLength=5, NvmUseServicePorts=true, NvmSelectBlockForReadall=false, NvmRamBlockDataAddress=(unset), NvmRomBlockDataAddress=(unset), NvmUseInitCallback=false, NvmInitBlockCallback=NULL_PTR, NvmJobendCbkAtReadAll=false
        NvmTargetBlockReference
          NvmFeeRef: NvmNameOfFeeBlock=FeeBlockConfiguration48
      Rte_NvmBlock_DiagSvc_TuningSetSelectData: NvmNvramBlockIdentifier=26, NvmBlockUseCrc=false, NvmBlockUsedCrcType=NVM_NOCRC, NvmNvBlockLength=2, NvmUseServicePorts=true, NvmSelectBlockForReadall=true, NvmRamBlockDataAddress=Rte_DiagSvc_TuningSetSelectData, NvmRomBlockDataAddress=(unset), NvmUseInitCallback=false, NvmInitBlockCallback=NULL_PTR, NvmJobendCbkAtReadAll=false
        NvmTargetBlockReference
          NvmFeeRef: NvmNameOfFeeBlock=FeeBlockConfiguration47
      Deprecated_NvmBlock_AbsHwPos_EOLVehCntrOffset1: NvmNvramBlockIdentifier=27, NvmBlockUseCrc=false, NvmBlockUsedCrcType=NVM_NOCRC, NvmNvBlockLength=6, NvmUseServicePorts=true, NvmSelectBlockForReadall=false, NvmRamBlockDataAddress=(unset), NvmRomBlockDataAddress=(unset), NvmUseInitCallback=false, NvmInitBlockCallback=NULL_PTR, NvmJobendCbkAtReadAll=false
        NvmTargetBlockReference
          NvmFeeRef: NvmNameOfFeeBlock=FeeBlockConfiguration46
      Deprecated_NvmBlock_TrqCanc_CogTrqRplComp: NvmNvramBlockIdentifier=28, NvmBlockUseCrc=false, NvmBlockUsedCrcType=NVM_NOCRC, NvmNvBlockLength=18, NvmUseServicePorts=true, NvmSelectBlockForReadall=false, NvmRamBlockDataAddress=(unset), NvmRomBlockDataAddress=(unset), NvmUseInitCallback=false, NvmInitBlockCallback=NULL_PTR, NvmJobendCbkAtReadAll=false
        NvmTargetBlockReference
          NvmFeeRef: NvmNameOfFeeBlock=FeeBlockConfiguration49
      Deprecated_NvmBlock_AstLmt_SteerAsstDefeat: NvmNvramBlockIdentifier=29, NvmBlockUseCrc=false, NvmBlockUsedCrcType=NVM_NOCRC, NvmNvBlockLength=2, NvmUseServicePorts=true, NvmSelectBlockForReadall=false, NvmRamBlockDataAddress=(unset), NvmRomBlockDataAddress=(unset), NvmUseInitCallback=false, NvmInitBlockCallback=NULL_PTR, NvmJobendCbkAtReadAll=false
        NvmTargetBlockReference
          NvmFeeRef: NvmNameOfFeeBlock=FeeBlockConfiguration50
      Rte_NvmBlock_ThrmlDutyCycle_ThrmlDutyCycle_FltStVal: NvmNvramBlockIdentifier=30, NvmBlockUseCrc=false, NvmBlockUsedCrcType=NVM_NOCRC, NvmNvBlockLength=4, NvmUseServicePorts=true, NvmSelectBlockForReadall=true, NvmRamBlockDataAddress=Rte_ThrmlDutyCycle_ThrmlDutyCycle_FltStVal, NvmRomBlockDataAddress=(unset), NvmUseInitCallback=false, NvmInitBlockCallback=NULL_PTR, NvmJobendCbkAtReadAll=false
        NvmTargetBlockReference
          NvmFeeRef: NvmNameOfFeeBlock=FeeBlockConfiguration51
      NVM_BLOCK_DIAGMGR_LATCHCNTRS: NvmNvramBlockIdentifier=31, NvmBlockUseCrc=false, NvmBlockUsedCrcType=NVM_NOCRC, NvmNvBlockLength=16, NvmUseServicePorts=true, NvmSelectBlockForReadall=true, NvmRamBlockDataAddress=LatchCounter_Cnt_u16, NvmRomBlockDataAddress=(unset), NvmUseInitCallback=false, NvmInitBlockCallback=NULL_PTR, NvmJobendCbkAtReadAll=false
        NvmTargetBlockReference
          NvmFeeRef: NvmNameOfFeeBlock=FeeBlockConfiguration52
      Rte_NvmBlock_LrnEOT_LearnedEOT: NvmNvramBlockIdentifier=32, NvmBlockUseCrc=true, NvmBlockUsedCrcType=NVM_CRC16, NvmNvBlockLength=10, NvmUseServicePorts=true, NvmSelectBlockForReadall=true, NvmRamBlockDataAddress=Rte_LrnEOT_LearnedEOT, NvmRomBlockDataAddress=T_LearnedEOTInit_Cnt_str, NvmUseInitCallback=false, NvmInitBlockCallback=NULL_PTR, NvmJobendCbkAtReadAll=false
        NvmTargetBlockReference
          NvmFeeRef: NvmNameOfFeeBlock=FeeBlockConfiguration60
      Rte_NvmBlock_AvgFricLrn_AvgFricLrnData: NvmNvramBlockIdentifier=33, NvmBlockUseCrc=true, NvmBlockUsedCrcType=NVM_CRC16, NvmNvBlockLength=203, NvmUseServicePorts=true, NvmSelectBlockForReadall=true, NvmRamBlockDataAddress=Rte_AvgFricLrn_AvgFricLrnData, NvmRomBlockDataAddress=T_AvgFricLrnDataInit_Cnt_str, NvmUseInitCallback=false, NvmInitBlockCallback=NULL_PTR, NvmJobendCbkAtReadAll=false
        NvmTargetBlockReference
          NvmFeeRef: NvmNameOfFeeBlock=FeeBlockConfiguration61
      Rte_NvmBlock_DigHwTrqSENT_DigTrqTrim: NvmNvramBlockIdentifier=34, NvmBlockUseCrc=false, NvmBlockUsedCrcType=NVM_NOCRC, NvmNvBlockLength=5, NvmUseServicePorts=true, NvmSelectBlockForReadall=true, NvmRamBlockDataAddress=Rte_DigHwTrqSENT_DigTrqTrim, NvmRomBlockDataAddress=(unset), NvmUseInitCallback=false, NvmInitBlockCallback=NULL_PTR, NvmJobendCbkAtReadAll=false
        NvmTargetBlockReference
          NvmFeeRef: NvmNameOfFeeBlock=FeeBlockConfiguration53
      Rte_NvmBlock_CmMtrCurr_CurrTempOffset: NvmNvramBlockIdentifier=35, NvmBlockUseCrc=false, NvmBlockUsedCrcType=NVM_NOCRC, NvmNvBlockLength=96, NvmUseServicePorts=true, NvmSelectBlockForReadall=true, NvmRamBlockDataAddress=Rte_CmMtrCurr_CurrTempOffset, NvmRomBlockDataAddress=(unset), NvmUseInitCallback=false, NvmInitBlockCallback=NULL_PTR, NvmJobendCbkAtReadAll=false
        NvmTargetBlockReference
          NvmFeeRef: NvmNameOfFeeBlock=FeeBlockConfiguration54
      Rte_NvmBlock_CmMtrCurr_ShCurrCal: NvmNvramBlockIdentifier=36, NvmBlockUseCrc=false, NvmBlockUsedCrcType=NVM_NOCRC, NvmNvBlockLength=28, NvmUseServicePorts=true, NvmSelectBlockForReadall=true, NvmRamBlockDataAddress=Rte_CmMtrCurr_ShCurrCal, NvmRomBlockDataAddress=(unset), NvmUseInitCallback=false, NvmInitBlockCallback=NULL_PTR, NvmJobendCbkAtReadAll=false
        NvmTargetBlockReference
          NvmFeeRef: NvmNameOfFeeBlock=FeeBlockConfiguration55
      Rte_NvmBlock_TrqCanc_CogTrqCal: NvmNvramBlockIdentifier=37, NvmBlockUseCrc=false, NvmBlockUsedCrcType=NVM_NOCRC, NvmNvBlockLength=1024, NvmUseServicePorts=true, NvmSelectBlockForReadall=true, NvmRamBlockDataAddress=Rte_TrqCanc_CogTrqCal, NvmRomBlockDataAddress=(unset), NvmUseInitCallback=false, NvmInitBlockCallback=NULL_PTR, NvmJobendCbkAtReadAll=false
        NvmTargetBlockReference
          NvmFeeRef: NvmNameOfFeeBlock=FeeBlockConfiguration56
      Rte_NvmBlock_TrqCanc_CogTrqRplComp: NvmNvramBlockIdentifier=38, NvmBlockUseCrc=false, NvmBlockUsedCrcType=NVM_NOCRC, NvmNvBlockLength=18, NvmUseServicePorts=true, NvmSelectBlockForReadall=true, NvmRamBlockDataAddress=Rte_TrqCanc_CogTrqRplComp, NvmRomBlockDataAddress=(unset), NvmUseInitCallback=false, NvmInitBlockCallback=NULL_PTR, NvmJobendCbkAtReadAll=false
        NvmTargetBlockReference
          NvmFeeRef: NvmNameOfFeeBlock=FeeBlockConfiguration57
      Rte_NvmBlock_AstLmt_SteerAsstDefeat: NvmNvramBlockIdentifier=39, NvmBlockUseCrc=false, NvmBlockUsedCrcType=NVM_NOCRC, NvmNvBlockLength=1, NvmUseServicePorts=true, NvmSelectBlockForReadall=true, NvmRamBlockDataAddress=Rte_AstLmt_SteerAsstDefeat, NvmRomBlockDataAddress=(unset), NvmUseInitCallback=false, NvmInitBlockCallback=NULL_PTR, NvmJobendCbkAtReadAll=false
        NvmTargetBlockReference
          NvmFeeRef: NvmNameOfFeeBlock=FeeBlockConfiguration58
      Rte_NvmBlock_TrqCmdScl_TorqueCmdSF_Uls_f32: NvmNvramBlockIdentifier=40, NvmBlockUseCrc=false, NvmBlockUsedCrcType=NVM_NOCRC, NvmNvBlockLength=4, NvmUseServicePorts=true, NvmSelectBlockForReadall=true, NvmRamBlockDataAddress=Rte_TrqCmdScl_TorqueCmdSF_Uls_f32, NvmRomBlockDataAddress=(unset), NvmUseInitCallback=false, NvmInitBlockCallback=NULL_PTR, NvmJobendCbkAtReadAll=false
        NvmTargetBlockReference
          NvmFeeRef: NvmNameOfFeeBlock=FeeBlockConfiguration59
      Rte_NvmBlock_AbsHwPos_EOLVehCntrOffset: NvmNvramBlockIdentifier=41, NvmBlockUseCrc=false, NvmBlockUsedCrcType=NVM_NOCRC, NvmNvBlockLength=6, NvmUseServicePorts=true, NvmSelectBlockForReadall=true, NvmRamBlockDataAddress=Rte_AbsHwPos_EOLVehCntrOffset, NvmRomBlockDataAddress=(unset), NvmUseInitCallback=false, NvmInitBlockCallback=NULL_PTR, NvmJobendCbkAtReadAll=false
        NvmTargetBlockReference
          NvmFeeRef: NvmNameOfFeeBlock=FeeBlockConfiguration62
      Rte_NvmBlock_DiagSvc_SupplierIdentifierData: NvmNvramBlockIdentifier=42, NvmBlockUseCrc=false, NvmBlockUsedCrcType=NVM_NOCRC, NvmNvBlockLength=10, NvmUseServicePorts=true, NvmSelectBlockForReadall=true, NvmRamBlockDataAddress=Rte_DiagSvc_SupplierIdentifierData, NvmRomBlockDataAddress=(unset), NvmUseInitCallback=false, NvmInitBlockCallback=NULL_PTR, NvmJobendCbkAtReadAll=false
        NvmTargetBlockReference
          NvmFeeRef: NvmNameOfFeeBlock=FeeBlockConfiguration63
      Rte_NvmBlock_DiagSvc_SparePartNumberData: NvmNvramBlockIdentifier=43, NvmBlockUseCrc=false, NvmBlockUsedCrcType=NVM_NOCRC, NvmNvBlockLength=10, NvmUseServicePorts=true, NvmSelectBlockForReadall=true, NvmRamBlockDataAddress=Rte_DiagSvc_SparePartNumberData, NvmRomBlockDataAddress=(unset), NvmUseInitCallback=false, NvmInitBlockCallback=NULL_PTR, NvmJobendCbkAtReadAll=false
        NvmTargetBlockReference
          NvmFeeRef: NvmNameOfFeeBlock=FeeBlockConfiguration64
      Rte_NvmBlock_VehDyn_MotPosReset: NvmNvramBlockIdentifier=44, NvmBlockUseCrc=false, NvmBlockUsedCrcType=NVM_NOCRC, NvmNvBlockLength=5, NvmUseServicePorts=true, NvmSelectBlockForReadall=true, NvmRamBlockDataAddress=Rte_VehDyn_MotPosReset, NvmRomBlockDataAddress=(unset), NvmUseInitCallback=false, NvmInitBlockCallback=NULL_PTR, NvmJobendCbkAtReadAll=false
        NvmTargetBlockReference
          NvmFeeRef: NvmNameOfFeeBlock=FeeBlockConfiguration65
      NvM_NVM_BLOCK_DEM: NvmNvramBlockIdentifier=45, NvmBlockUseCrc=false, NvmBlockUsedCrcType=NVM_NOCRC, NvmNvBlockLength=315, NvmRomBlockDataAddress=(unset), NvmJobendCbkAtReadAll=true, NvmRamBlockDataAddress=Dem_NvData, NvmInitBlockCallback=Dem_NvDataInit, NvmSelectBlockForReadall=true, NvmUseServicePorts=false, NvmUseInitCallback=true
        NvmTargetBlockReference
          NvmFeeRef: NvmNameOfFeeBlock=FeeBlockConfiguration8
